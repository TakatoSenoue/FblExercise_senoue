AUTOSAR XML (schema 00053)
package /InitialEcuC
  ecuc value collection InitialEcuC
