AUTOSAR XML (schema 00053)
package /ActiveEcuC
  module config FblBm: implementation-config-variant=VARIANT-PRE-COMPILE, module-description=FblBm_Impl
    FblBmGeneral:
      FblBmFailsafeUpdater = false
      FblBmExecutionInstance = BootManager
      FblBmStandaloneMode = true
      FblBmSecureBoot = false
      FblBmIncludeOemConfiguration = false
      FblBmIncludeHardwareConfiguration = false
      FblBmHeaderAddress = 65504
      FblBmInitializeKeys = false
      FblBmInitializeMacOfBootloader = false
      FblBmFailsafeUpdaterUser = false
    FblBmBootOrder
      FblBmBootTarget_Appl (FblBmBootTarget): FblBmBootOrderId=0, FblBmBootTargetRef=Appl
