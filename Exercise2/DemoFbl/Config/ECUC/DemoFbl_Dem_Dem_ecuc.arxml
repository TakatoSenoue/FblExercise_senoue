AUTOSAR XML (schema 00049)
package /ActiveEcuC
  module config Dem: implementation-config-variant=VARIANT-PRE-COMPILE
    DemConfigSet
      DemEventParameter: DemEventAvailable=false, DemEventId=1, DemEventKind=DEM_EVENT_KIND_SWC
        DemEventClass: DemAgingAllowed=false, DemConsiderPtoStatus=false, DemEventPriority=1, DemFFPrestorageSupported=false, DemOperationCycleRef=DemOperationCycle
          DemDebounceAlgorithmClass
            DemDebounceMonitorInternal
    DemGeneral:
      DemAgingCycleCounterProcessing = DEM_PROCESS_AGINGCTR_INTERN
      DemAgingRequieresTestedCycle = false
      DemAvailabilitySupport = DEM_NO_AVAILABILITY
      DemBswErrorBufferSize = 0
      DemClearDTCBehavior = DEM_CLRRESP_VOLATILE
      DemClearDTCLimitation = DEM_ALL_SUPPORTED_DTCS
      DemDataElementDefaultEndianness = LITTLE_ENDIAN
      DemDebounceCounterBasedSupport = false
      DemDebounceTimeBasedSupport = false
      DemDevErrorDetect = false
      DemDtcStatusAvailabilityMask = 0
      DemEnableConditionSupport = false
      DemEventCombinationSupport = DEM_EVCOMB_DISABLED
      DemEventDisplacementStrategy = DEM_DISPLACEMENT_NONE
      DemEventMemoryEntryStorageTrigger = DEM_STORAGE_ON_TEST_FAILED
      DemGeneralInterfaceSupport = false
      DemMaxNumberEventEntryMirror = 0
      DemMaxNumberEventEntryPermanent = 0
      DemMaxNumberEventEntryPrimary = 1
      DemMaxNumberEventEntrySecondary = 0
      DemMaxNumberPrestoredFF = 0
      DemOBDSupport = DEM_OBD_NO_OBD_SUPPORT
      DemOccurrenceCounterProcessing = DEM_PROCESS_OCCCTR_TF
      DemOperationCycleStatusStorage = false
      DemPTOSupport = false
      DemResetConfirmedBitOnOverflow = true
      DemStatusBitHandlingTestFailedSinceLastClear = DEM_STATUS_BIT_NORMAL
      DemStatusBitStorageTestFailed = false
      DemStorageConditionSupport = false
      DemSuppressionSupport = DEM_NO_SUPPRESSION
      DemTaskTime = 0.001
      DemTriggerDcmReports = false
      DemTriggerDltReports = false
      DemTriggerFiMReports = false
      DemTriggerMonitorInitBeforeClearOk = false
      DemTypeOfDTCSupported = DEM_DTC_TRANSLATION_ISO14229_1
      DemTypeOfFreezeFrameRecordNumeration = DEM_FF_RECNUM_CALCULATED
      DemVersionInfoApi = false
      DemOperationCycle: DemOperationCycleAutomaticEnd=false, DemOperationCycleAutostart=false, DemOperationCycleType=DEM_OPCYC_IGNITION
      DemClient: DemClientId=0
