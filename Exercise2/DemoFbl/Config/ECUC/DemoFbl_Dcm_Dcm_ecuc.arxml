AUTOSAR XML (schema 00049)
package /ActiveEcuC
  module config Dcm: implementation-config-variant=VARIANT-PRE-COMPILE, module-description=Dcm_Impl
    DcmConfigSet
      DcmGeneral:
        DcmBaudrateSwitch = false
        DcmKeySlotMode = false
        DcmNwStatusRxBufferSize = 0
        DcmQueuedRequest = false
        DcmTaskTime = 0
        DcmRespondAllRequest = true
        DcmVersionInfoApi = false
        DcmCanHardwareLoopTimeout = 100
        DcmDevErrorDetect = true
        DcmEthIfPollingRate = 1
      DcmDsl
        DcmDslBuffer: DcmDslBufferSize=8
        DcmDslDiagResp: DcmDslDiagRespMaxNumOfDeclinedRequests=3, DcmDslDiagRespOnSecondDeclinedRequest=false
        DcmDslProtocol
          DcmDslProtocolRow_29812fbf (DcmDslProtocolRow): DcmDslProtocolID=DCM_UDS_ON_CAN
            DcmDslConnection_64d54b0f (DcmDslConnection)
              DcmDslMainConnection_e6feb00f (DcmDslMainConnection): DcmProgSessionResponseHandling=BOOTLOADER_RESPONSE, DcmDslProtocolRxTesterSourceAddr=257, DcmDslPayloadLimit=4095
                Demo_0_CAN_FD_Request_oDemoFBL_Vector_SLP3_20_797faa4e_Rx_26d06049 (DcmDslProtocolRx):
                  DcmDslProtocolRxAddrType = DCM_PHYSICAL_TYPE
                  DcmDslProtocolRxPduId = 0
                  DcmDslProtocolRxComMChannelRef = CN_DemoFBL_Vector_SLP3_abba4211
                  DcmDslProtocolRxPduRef = Demo_0_CAN_FD_Request_oDemoFBL_Vector_SLP3_20_797faa4e_Rx
                Demo_0_CAN_FD_Response_oDemoFBL_Vector_SLP3_20_fac2fc54_Tx_7966a2bf (DcmDslProtocolTx): DcmDslTxConfirmationPduId=0, DcmDslProtocolTxPduRef=Demo_0_CAN_FD_Response_oDemoFBL_Vector_SLP3_20_fac2fc54_Tx
                Functional_CAN_FD_oDemoFBL_Vector_SLP3_20_57859879_Rx_0f27df12 (DcmDslProtocolRx):
                  DcmDslProtocolRxAddrType = DCM_FUNCTIONAL_TYPE
                  DcmDslProtocolRxPduId = 1
                  DcmDslProtocolRxComMChannelRef = CN_DemoFBL_Vector_SLP3_abba4211
                  DcmDslProtocolRxPduRef = Functional_CAN_FD_oDemoFBL_Vector_SLP3_20_57859879_Rx
            DcmDslConnection_bcbd2a82 (DcmDslConnection)
              DcmDslMainConnection_0a68bfea (DcmDslMainConnection): DcmProgSessionResponseHandling=BOOTLOADER_RESPONSE, DcmDslProtocolRxTesterSourceAddr=514, DcmDslPayloadLimit=4095
                Demo_0_CAN_FD_Response_oDemoFBL_Vector_SLP3_01a35bfe_Tx_6ae15480 (DcmDslProtocolTx): DcmDslTxConfirmationPduId=1, DcmDslProtocolTxPduRef=Demo_0_CAN_FD_Response_oDemoFBL_Vector_SLP3_01a35bfe_Tx
                Functional_CAN_FD_oDemoFBL_Vector_SLP3_3cffe9e9_Rx_56b3eb44 (DcmDslProtocolRx):
                  DcmDslProtocolRxAddrType = DCM_FUNCTIONAL_TYPE
                  DcmDslProtocolRxPduId = 3
                  DcmDslProtocolRxComMChannelRef = CN_DemoFBL_Vector_SLP3_abba4211
                  DcmDslProtocolRxPduRef = Functional_CAN_FD_oDemoFBL_Vector_SLP3_3cffe9e9_Rx
                Demo_0_CAN_FD_Request_oDemoFBL_Vector_SLP3_67f6c3c9_Rx_2eeaac32 (DcmDslProtocolRx):
                  DcmDslProtocolRxAddrType = DCM_PHYSICAL_TYPE
                  DcmDslProtocolRxPduId = 2
                  DcmDslProtocolRxComMChannelRef = CN_DemoFBL_Vector_SLP3_abba4211
                  DcmDslProtocolRxPduRef = Demo_0_CAN_FD_Request_oDemoFBL_Vector_SLP3_67f6c3c9_Rx
      DcmDsp
        DcmDspSession
          DcmDspSessionRow: DcmDspSessionLevel=0, DcmDspSessionP2ServerMax=0, DcmDspSessionP2StarServerMax=0
      DcmGeneration:
        DcmInterfacesForDeactivatedData = false
        DcmReduceConstantData2Define = false
        DcmReduceNumericalDataByOffsetThreshold = 0
        DcmReferringKeysInComments = false
        DcmShortSymbols = false
