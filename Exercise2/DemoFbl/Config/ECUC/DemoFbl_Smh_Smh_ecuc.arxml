AUTOSAR XML (schema 00049)
package /ActiveEcuC
  module config Smh: implementation-config-variant=VARIANT-LINK-TIME, module-description=Smh_Impl
    SmhGeneral:
      SmhWatchdogCycleCount = 32
      SmhProvidevSecPrimRandomFunction = true
      SmhOperationMode = PRODUCTION
      SmhCryptographicKeysLocatedInRAM = false
      SmhSaveRestoreContext = false
      SmhCustomPrimitiveIds:
        SmhCustomFamilyIdMd5 = 191
        SmhCustomFamilyIdEccAnsi = 129
        SmhCustomFamilyIdEccSec = 130
        SmhCustomModeP224R1 = 148
        SmhCustomModeP256R1 = 128
        SmhCustomModeP384R1 = 131
        SmhCustomFamilyIdSlhDsa = 199
        SmhCustomMode128S = 201
    SmhSeedKey: SmhKeyTimeout=100, SmhCallCycle=10
      SmhKeyConfig: SmhKeyConstant=4294967295, SmhExternalComparison=false, SmhKeyType=HIS, SmhKeyLength=4, SmhSecretKeyLength=0, SmhExtendedApi=false, SmhAsymmetric=false
      SmhSeedConfig: SmhSeedLength=4, SmhSeedType=HIS
        SmhSeedGeneration
          SmhLcg: SmhMultiplier=2147001325, SmhIncrement=715136305
    SmhCrc: SmhCRCType=CRC_32
      SmhCrc32: SmhOptimization=SPEED, SmhInitialValue=4294967295, SmhPolynomial=3988292384, SmhMode=REFLECTED, SmhComplementValue=4294967295
    SmhCryptographicKeys: SmhElementIdRSAPublicExponent=161, SmhElementIdRSAModulus=160, SmhElementIdRSAPrivateExponent=162
      6 x SmhKey:
        AesKey: SmhDescription=Decryption key for security class AAA, SmhKeyValueRef=AesKeyValue, SmhKeyValueRef=AesIvValue
        ClassCCC_Ed25519Key: SmhDescription=Public key for Ed25519 signature check, SmhKeyValueRef=Ed25519KeyValue
        ClassC_Key: SmhDescription=Example key for asymmetric signature checks (CMAC or HMAC), SmhKeyValueRef=ClassCKeyValue
        ClassCCC_Rsa1024Key: SmhDescription=Public key for RSA (1024 Bits), SmhKeyValueRef=RsaKey1024ExpValue, SmhKeyValueRef=RsaKey1024ModValue
        ClassCCC_Rsa2048Key: SmhDescription=Public key for RSA (2048 Bits), SmhKeyValueRef=RsaKey2048ExpValue, SmhKeyValueRef=RsaKey2048ModValue
        ClassCCC_Rsa3072Key: SmhDescription=Public key for RSA (3072 Bits), SmhKeyValueRef=RsaKey3072ExpValue, SmhKeyValueRef=RsaKey3072ModValue
      10 x SmhKeyValue, all with SmhDescription=:
        AesKeyValue: SmhValue=00112233445566778899aabbccddeeff, SmhSuffix=Key, SmhCryptoKeyElementRef=Crypto_30_LibCv_Fbl_Decrypt_Aes128_Key
        ClassCKeyValue: SmhValue=00112233445566778899aabbccddeeff, SmhSuffix=, SmhCryptoKeyElementRef=Crypto_30_LibCv_Fbl_Signature_ClassC
        Ed25519KeyValue: SmhValue=6f0987676525dfd7b7cc1a7363190dc136d7fae7dc39e18afffc74484b05734a, SmhSuffix=, SmhCryptoKeyElementRef=Crypto_30_LibCv_Fbl_Signature_Ed25519
        RsaKey1024ExpValue: SmhSuffix=Exp, SmhValue=00009d85, SmhCryptoKeyElementRef=Crypto_30_LibCv_Fbl_Signature_Rsa1024_Exp
        RsaKey1024ModValue: SmhSuffix=Mod, SmhValue=f7242f3bb8697ee5c3acaf800ba1c84e3c89ea373987073d971e91f83ad436f609bbbb8fbf250398860bb20c630ba124d9348be0ba61f9436621205e0289ae238ddabd16ebb715ea85ddb988cc31d374d7c5800a74f6da681106d0a63d50ba1fea4fc202950f582e12e0baf6ffe0f4c5e276a5aadae7b8773476d09b0b883a83, SmhCryptoKeyElementRef=Crypto_30_LibCv_Fbl_Signature_Rsa1024_Mod
        RsaKey2048ExpValue: SmhSuffix=Exp, SmhValue=00010001, SmhCryptoKeyElementRef=Crypto_30_LibCv_Fbl_Signature_Rsa2048_Exp
        RsaKey2048ModValue: SmhSuffix=Mod, SmhValue=B1C5BE469A4F56098B1B4EC0B51502B0E89C147A8F769708078D3AA395EC97CD76848C9D9A6E00C3F2C1CBE35AA5FFD9C06CAAFDE16A61BF06E415BDA6D52B5737188B01B609292F08AF9760ED62316E006655631A7EF9B23DBDD4A5F4F6F6C87B6575DC40D05E75451DD394583D89C92380AFB598C77564D135281CA69B725CD272DAB478FE330DF9D3136D57597F7F40E965EDF327C72986D80286063CC9AA165BBDCE00DC0E67445A62554D66C75775174F575CA9E2F648EBA97F0B261BA6DF918C535C0430AF045BAD7F41BE01EE8F891825D541434D8F429FA74FAC7AF4A00D95F07D1C7F5DFAE94A468CD5351E1B0C15E9F52FA8F101B17CF784632D75, SmhCryptoKeyElementRef=Crypto_30_LibCv_Fbl_Signature_Rsa2048_Mod
        RsaKey3072ExpValue: SmhSuffix=Exp, SmhValue=00010001, SmhCryptoKeyElementRef=Crypto_30_LibCv_Fbl_Signature_Rsa3072_Exp
        RsaKey3072ModValue: SmhSuffix=Mod, SmhValue=D27DA65AF1BE1B2938258AC85EA5ABBCBE39296923562764F65EB017998D17105DF62D9D8070F44622BB7488D19F65A6EF829FD59CF02A702C3216C097BED86665FE9252797982B9FE2F168A23EA16AA7DEF98E1DC0A75DB23ED625F506478D1879887A40B8C762E6E7693E70B4642F863594842DE66539ABA12B80EBDA19D99D94F9EC6A18E9EDC2EAF381D6A695DF49E3006EB2F739467BA5D34070E95DC618BA712D816C47A0D2470B7189ACC403FC6E2572CAD7E1E40DE7158586EF34A806D2528BD481B30E79D430052103BE5A44C31C3E4EBF23708FA4F0428C9FD14429014CB6486008B44A2A8A1CC146296AA99CC2E7B4D3CF78E7103379890545FF105CE50E82AC5FEF0A5DF43CB34625427BA57E7F174BC1E3ADA54D5F02B8A7EBDDB13C88A91C1F8FAFDDB0C67F17005194A7849AFD9149115A529F882D16429AC07F216B5648EBCEB07ADEE0FE53237BBE9224A9D21B353C15A2F03F454F902CE18D89F3B4C64186FC41D9FB2D2DB1F425A8CDB7D9093800A0BBD3639975BD1FF, SmhCryptoKeyElementRef=Crypto_30_LibCv_Fbl_Signature_Rsa3072_Mod
        AesIvValue: SmhSuffix=IV, SmhValue=00000000000000000000000000000000, SmhCryptoKeyElementRef=Crypto_30_LibCv_Fbl_Decrypt_Aes128_IV
      SmhKeyOperations: SmhAccessKeyElementApis=false, SmhCopyKeyElementApi=false, SmhCopyKeyApi=false
    4 x SmhJob:
      SmhJob_AesDecryption: SmhJobId=0
        SmhJob_AesDecryption (SmhDecryption): SmhCryptographicKeyRef=AesKey, SmhCsmJobRef=CsmJob_DecryptionAes128NoneCbc
      SmhJob_Verify_ClassC: SmhJobId=1
        SmhJob_Verify_ClassC (SmhMacVerify): SmhMacSize=SEC_SIZE_HASH_SHA1, SmhCryptographicKeyRef=ClassC_Key, SmhCsmJobRef=CsmJob_Signature_Class_C
      SmhJob_Verify_ClassCCC: SmhJobId=2
        SmhJob_Verify_ClassCCC (SmhSignatureVerify): SmhSignatureSize=SEC_SIZE_SIG_RSA1024, SmhCryptographicKeyRef=ClassCCC_Rsa1024Key, SmhCsmJobRef=CsmJob_SigAsymVer_RsaV15Sha1
      SmhJob_Verify_DummySha512: SmhJobId=3
        SmhJob_Verify_DummySha512 (SmhHash): SmhHashSize=SEC_SIZE_HASH_SHA512, SmhCsmJobRef=CsmJob_SigAsymVer_DummySha512
    SmhEncryption: SmhDecryptionDefaultConfig=SmhDecryptionConfig
      SmhDecryptionConfig: SmhFunctionName=DecryptAes128, SmhJobRef=SmhJob_AesDecryption/SmhJob_AesDecryption
    SmhVerification
      SmhMonolithicVerification:
        SmhCRCTotal = false
        SmhCRCWritten = false
        SmhMemoryAccessMode = ADDRESS
        SmhExportVerificationWrapper = false
        SmhOperationCountOfWrapper = 4
        SmhCheckAddressRangeOverflow = false
        SmhAssertReadCount = false
        SmhReadBufferSize = 64
        SmhCRCWrittenGet = false
        SmhDefaultMonolithicVerificationConfig = SmhSecurityClassCCC/SmhSecurityClassCCCConfig
        SmhSecurityClassDDD: SmhDefaultSecurityClassDDDConfig=SmhSecurityClassDDD/SmhSecurityClassDDDConfig
          SmhSecurityClassDDDConfig:
            SmhFunctionName = SecM_VerificationClassDDD
            SmhIncludeAddressAndLengthInSignature = false
            SmhSignatureOffset = 0
            SmhCRCOffset = 0
            SmhStreamVerificationConfig = SmhSecurityClassDDD/SmhSecurityClassDDDConfig
        SmhSecurityClassC: SmhDefaultSecurityClassCConfig=SmhSecurityClassC/SmhSecurityClassCConfig
          SmhSecurityClassCConfig:
            SmhFunctionName = SecM_Verification_ClassC
            SmhIncludeAddressAndLengthInSignature = true
            SmhSignatureOffset = 0
            SmhCRCOffset = 0
            SmhStreamVerificationConfig = SmhSecurityClassC/SmhSecurityClassCConfig
        SmhSecurityClassCCC: SmhDefaultSecurityClassCCCConfig=SmhSecurityClassCCC/SmhSecurityClassCCCConfig
          SmhSecurityClassCCCConfig:
            SmhFunctionName = SecM_Verification_ClassCCC
            SmhIncludeAddressAndLengthInSignature = true
            SmhSignatureOffset = 0
            SmhCRCOffset = 0
            SmhStreamVerificationConfig = SmhSecurityClassCCC/SmhSecurityClassCCCConfig
      SmhStreamVerification: SmhDefaultStreamVerificationConfig=SmhSecurityClassCCC/SmhSecurityClassCCCConfig
        SmhSecurityClassDDD: SmhDefaultSecurityClassDDDConfig=SmhSecurityClassDDD/SmhSecurityClassDDDConfig
          SmhSecurityClassDDDConfig: SmhFunctionName=SecM_VerifyClass_DDD, SmhUpdateLengthOfHashedData=false, SmhComputationOnly=false
            SmhSecurityClassDDDType
              SmhCrc: SmhCrcRef=SmhCrc32
        SmhSecurityClassC: SmhDefaultSecurityClassCConfig=SmhSecurityClassC/SmhSecurityClassCConfig
          SmhSecurityClassCConfig:
            SmhFunctionName = SecM_Verify_ClassC
            SmhUpdateLengthOfHashedData = false
            SmhComputationOnly = false
            SmhContextBufferSize = 0
            SmhJobRef = SmhJob_Verify_ClassC/SmhJob_Verify_ClassC
        SmhSecurityClassCCC: SmhDefaultSecurityClassCCCConfig=SmhSecurityClassCCC/SmhSecurityClassCCCConfig
          SmhSecurityClassCCCConfig:
            SmhFunctionName = SecM_VerifyClass_CCC
            SmhUpdateLengthOfHashedData = false
            SmhContextBufferSize = 0
            SmhJobRef = SmhJob_Verify_ClassCCC/SmhJob_Verify_ClassCCC
