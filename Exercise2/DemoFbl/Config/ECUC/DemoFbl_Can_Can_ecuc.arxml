AUTOSAR XML (schema 00049)
package /ActiveEcuC
  module config Can: implementation-config-variant=VARIANT-PRE-COMPILE, module-description=Can_Impl
    CanConfigSet
      CT_DemoFBL_Vector_SLP3_216858f6 (CanController):
        CanControllerActivation = true
        CanBusoffProcessing = POLLING
        CanControllerBaseAddress = 4291821568
        CanControllerId = 0
        CanRxProcessing = POLLING
        CanTxProcessing = POLLING
        CanWakeupProcessing = POLLING
        CanWakeupSupport = false
        CanWakeupSourceId = 0
        CanPhysController = CAN0
        CanRxFullCanAllocation = 16
        CanRxBasicCanAllocation = 1
        CanRxFifoProcessCount = 255
        CanControllerDefaultBaudrate = CanControllerBaudrateConfig
        CanControllerSystemRef = CT_DemoFBL_Vector_SLP3
        CanWakeupSourceRef = CN_DemoFBL_Vector_SLP3_abba4211
        CanCpuClockRef = McuClockReferencePoint
        CanControllerBaudrateConfig:
          CanControllerBaudRate = 500
          CanControllerBaudRateConfigID = 0
          CanControllerPropSeg = 7
          CanControllerSeg1 = 4
          CanControllerSeg2 = 4
          CanControllerSyncJumpWidth = 4
          CanBaudrateClock = 40000
          CanBaudratePrescaler = 5
        CanFilterMask: CanFilterMaskValue=0, CanFilterCodeValue=0, IsLocked=false
        CanControllerFdBaudrateConfig (CanControllerBaudrateConfig):
          CanControllerBaudRate = 500
          CanControllerBaudRateConfigID = 1
          CanControllerPropSeg = 7
          CanControllerSeg1 = 4
          CanControllerSeg2 = 4
          CanControllerSyncJumpWidth = 4
          CanBaudrateClock = 40000
          CanBaudratePrescaler = 5
          CanControllerFdBaudrateConfig:
            CanControllerFdBaudRate = 1000
            CanControllerPropSeg = 3
            CanControllerSeg1 = 2
            CanControllerSeg2 = 2
            CanControllerSyncJumpWidth = 2
            CanControllerTxBitRateSwitch = true
            CanBaudratePrescaler = 5
      CN_DemoFBL_Vector_SLP3_abba4211_Tx (CanHardwareObject):
        CanHandleType = BASIC
        CanIdValue = 0
        CanObjectType = TRANSMIT
        CanIdType = STANDARD
        CanObjectId = 0
        CanHwProcessing = true
        CanObjectHwSize = 1
        CanObjectHwHandle = 0
        CanMaxDataLen = 64
        CanFdPaddingValue = 0
        CanObjectMultiplexedTransmission = false
        CanObjectHwFifo = false
        CanControllerRef = CT_DemoFBL_Vector_SLP3_216858f6
      CN_DemoFBL_Vector_SLP3_dfd96cca_Rx (CanHardwareObject):
        CanHandleType = BASIC
        CanIdType = STANDARD
        CanIdValue = 0
        CanObjectType = RECEIVE
        CanObjectId = 1
        CanHwProcessing = true
        CanObjectHwSize = 4
        CanObjectHwHandle = 0
        CanMaxDataLen = 64
        CanFdPaddingValue = 0
        CanObjectMultiplexedTransmission = false
        CanObjectHwFifo = false
        CanControllerRef = CT_DemoFBL_Vector_SLP3_216858f6
        CanFilterMaskRef = CanFilterMask
    CanGeneral:
      CanIndex = 0
      CanChangeBaudrateApi = false
      CanDevErrorDetection = true
      CanHardwareCancellation = false
      CanIdenticalIdCancellation = false
      CanMainFunctionBusoffPeriod = 0.01
      CanMainFunctionModePeriod = 0.01
      CanMainFunctionWakeupPeriod = 0.01
      CanMultiplexedTransmission = false
      CanSetBaudrateApi = false
      CanTimeoutDuration = 0.01
      CanVersionInfoApi = false
      CanGenericPrecopy = false
      CanHardwareLoopCheck = true
      CanRxFullCANSupport = false
      CanTxFullCANSupport = false
      CanRxBasicCANSupport = true
      CanUseNestedCANInterrupts = false
      CanHardwareCancelByAppl = true
      CanIndividualProcessing = false
      CanGenericConfirmation = false
      CanGenericConfirmationAPI2 = false
      CanRxQueue = false
      CanSupportMixedID = false
      CanRxQueueSize = 10
      CanMultipleBasicCANObjects = false
      CanMultipleBasicCANTxObjects = false
      CanHardwareHandleType = UINT8
      CanOptimizeOneController = true
      CanInterruptCategory = CATEGORY2
      CanGetStatus = false
      CanInterruptLock = DRIVER
      CanWakeupSupport = false
      CanRamCheck = None
      CanOverrunNotification = DET
      CanReinitStart = false
      CanGenericPreTransmit = false
      CanFdSupport = FULL
      CanRuntimeMeasurementSupport = false
      CanMaxRxDataLen = 64
      CanMaxTxDataLen = 64
      CanUsePeripheralAccessApi = false
      CanMirrorModeSupport = false
      CanUseOsInterruptControl = true
      CanSafeBswChecks = false
      CanSilentModeSupport = false
      CanHwTxFifoSupport = false
      CanCheckWakeupCanRetType = false
      CanFdHardwareBufferOptimization = true
      CanEnableSecurityEventReporting = false
      CanExternalClockSource = false
      CanCounterRef = SystemTimer
      CanMainFunctionRWPeriods: CanMainFunctionReadPeriod=0.01, CanMainFunctionWritePeriod=0.01
      CanHardwareResources:
        CanNumberOfChannels = 8
        CanNumberOfRules = 1024
        CanRamSize = 28672
        CanNumberOfRxBuffers = 128
        CanNumberOfRxFifos = 8
        CanNumberOfTxFifos = 3
        CanNumberOfTxBuffers = 32
        CanCanInterface = RSCAN_FD_V3
        CanBaseAddress = 0
        CanMaxRules = 255
      Unit0 (CanHardwareResources):
        CanNumberOfChannels = 8
        CanNumberOfRules = 1024
        CanRamSize = 28672
        CanNumberOfRxBuffers = 128
        CanNumberOfRxFifos = 8
        CanNumberOfTxFifos = 3
        CanNumberOfTxBuffers = 32
        CanCanInterface = RSCAN_FD_V3
        CanBaseAddress = 4291821568
        CanMaxRules = 255
