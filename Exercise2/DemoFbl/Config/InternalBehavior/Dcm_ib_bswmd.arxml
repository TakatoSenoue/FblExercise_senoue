AUTOSAR XML (schema 4-0-3)
package /MICROSARFBL/Dcm_ib_bswmd/BswModuleDescriptions
  bsw module description Dcm
    bsw internal behavior DcmBehavior
