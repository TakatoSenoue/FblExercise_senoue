AUTOSAR XML (schema 00049)
package /ActiveEcuC
  module config Csm: implementation-config-variant=VARIANT-PRE-COMPILE, module-description=Csm_Impl
    CsmGeneral:
      CsmCustomIncludeFiles = Crypto_30_LibCv_Custom.h
      CsmVersionInfoApi = false
      CsmUseDeprecated = false
      CsmAsymPrivateKeyMaxLength = 32
      CsmAsymPublicKeyMaxLength = 1024
      CsmDevErrorDetect = true
      CsmSymKeyMaxLength = 16
      CsmCallbackStartNotification = false
      CsmCancelationDuringProcessing = false
      CsmSafeBswChecks = true
      CsmSwcMainInterfaceVersion = CSM_ASR_VERSION_R21_11
      CsmMultiPartitionRuntimeChecks = false
      CsmJobTypeLayout:
        CsmJobTypeLayoutVarMembers = true
        CsmJobTypeLayoutRedirectionInfoRef = false
        CsmJobTypeLayoutAsr430Compatibility = true
        CsmJobTypeLayoutInput64 = false
        CsmJobTypeLayoutOutput64Ptr = false
        CsmJobTypeLayoutJobInfoPtr = true
        CsmJobTypeLayoutSecureCounterId = false
        CsmJobTypeLayoutCallbackUpdateNotification = false
        CsmJobTypeLayoutResultLength = false
        CsmJobTypeLayoutFieldOrdering = CSM_ASR_VERSION_R21_11
      CsmBswApiCompatibility: CsmDefaultJobKeyApiVersion=CSM_ASR_VERSION_4_04
    CsmJobs
      6 x CsmJob, all with CsmJobPriority=0, CsmProcessingMode=CRYPTO_PROCESSING_SYNC, CsmJobInterfaceUsePort=CRYPTO_USE_FNC, CsmJobUsePort=false:
        CsmJob_DecryptionAes128NoneCbc: CsmJobId=0, CsmJobKeyRef=CsmKey_Fbl_Decrypt_Aes128, CsmJobPrimitiveRef=Csm/CsmPrimitives_Dec_Aes128NoneCbc, CsmJobQueueRef=CsmQueue_Aes
        CsmJob_Signature_Class_C: CsmJobId=1, CsmJobKeyRef=CsmKey_Fbl_Signature_Class_C, CsmJobPrimitiveRef=Csm/CsmPrimitives_MacVer_HmacSha1, CsmJobQueueRef=CsmQueue_Standard
        CsmJob_SigAsymVer_RsaPssSha256: CsmJobId=2, CsmJobKeyRef=CsmKey_Fbl_Signature_Rsa3072, CsmJobPrimitiveRef=Csm/CsmPrimitives_SigAsymVer_RsaPssSha256, CsmJobQueueRef=CsmQueue_Standard
        CsmJob_SigAsymVer_RsaV15Sha1: CsmJobId=3, CsmJobKeyRef=CsmKey_Fbl_Signature_Rsa1024, CsmJobPrimitiveRef=Csm/CsmPrimitives_SigAsymVer_RsaV15Sha1, CsmJobQueueRef=CsmQueue_Standard
        CsmJob_SigAsymVer_Ed25519: CsmJobId=4, CsmJobKeyRef=CsmKey_Fbl_Signature_Ed25519, CsmJobPrimitiveRef=Csm/CsmPrimitives_SigAsymVer_Ed25519Sha512, CsmJobQueueRef=CsmQueue_Standard
        CsmJob_SigAsymVer_DummySha512: CsmJobId=5, CsmJobKeyRef=CsmKey_Fbl_HashDummy, CsmJobPrimitiveRef=Csm/CsmPrimitives_SigAsymVer_DummySha512, CsmJobQueueRef=CsmQueue_Standard
    CsmKeys
      7 x CsmKey, all with CsmKeyUsePort=false:
        CsmKey_Fbl_Decrypt_Aes128: CsmKeyId=0, CsmKeyRef=CryIfKey_Fbl_Decrypt_Aes128
        CsmKey_Fbl_Signature_Class_C: CsmKeyId=2, CsmKeyRef=CryIfKey_Fbl_Signature_ClassC
        CsmKey_Fbl_Signature_Ed25519: CsmKeyId=3, CsmKeyRef=CryIfKey_Fbl_Signature_Ed25519
        CsmKey_Fbl_Signature_Rsa1024: CsmKeyId=4, CsmKeyRef=CryIfKey_Fbl_Signature_Rsa1024
        CsmKey_Fbl_Signature_Rsa2048: CsmKeyId=5, CsmKeyRef=CryIfKey_Fbl_Signature_Rsa2048
        CsmKey_Fbl_Signature_Rsa3072: CsmKeyId=6, CsmKeyRef=CryIfKey_Fbl_Signature_Rsa3072
        CsmKey_Fbl_HashDummy: CsmKeyId=1, CsmKeyRef=CryIfKey_Fbl_HashDummy
    CsmQueues
      CsmQueue_Standard (CsmQueue):
        CsmQueueSize = 1
        CsmTriggerAsynchJobsInCallback = false
        CsmJobSharing = true
        CsmOperationModeLimitation = false
        CsmQueueProcessingMode = CRYPTO_PROCESSING_SYNC
        CsmChannelRef = CryIfChannel_CryptoCv_Fbl_Signature
        CsmQueueMainFunctionRef = CsmMainFunction
      CsmQueue_Aes (CsmQueue):
        CsmQueueSize = 1
        CsmTriggerAsynchJobsInCallback = false
        CsmJobSharing = true
        CsmOperationModeLimitation = false
        CsmQueueProcessingMode = CRYPTO_PROCESSING_SYNC
        CsmChannelRef = CryIfChannel_CryptoCv_Fbl_Aes
        CsmQueueMainFunctionRef = CsmMainFunction
    6 x CsmPrimitives:
      CsmPrimitives_Dec_Aes128NoneCbc
        CsmDecrypt
          CsmPrimitives_Dec_Aes128NoneCbc (CsmDecryptConfig):
            CsmDecryptAlgorithmMode = CRYPTO_ALGOMODE_CBC
            CsmDecryptAlgorithmSecondaryFamily = CRYPTO_ALGOFAM_CUSTOM
            CsmDecryptAlgorithmSecondaryFamilyCustom = CRYPTO_ALGOFAM_CUSTOM_PADDING_PKCS7
            CsmDecryptProcessing = CSM_SYNCHRONOUS
            CsmDecryptAlgorithmFamily = CRYPTO_ALGOFAM_AES
            CsmDecryptAlgorithmFamiliy = CRYPTO_ALGOFAM_AES
            CsmDecryptAlgorithmKeyLength = 16
      CsmPrimitives_MacVer_HmacSha1
        CsmMacVerify
          CsmPrimitives_MacVer_HmacSha1 (CsmMacVerifyConfig):
            CsmMacVerifyAlgorithmFamily = CRYPTO_ALGOFAM_SHA1
            CsmMacVerifyAlgorithmMode = CRYPTO_ALGOMODE_HMAC
            CsmMacVerifyCompareLength = 20
            CsmMacVerifyProcessing = CSM_SYNCHRONOUS
            CsmMacVerifyAlgorithmFamiliy = CRYPTO_ALGOFAM_SHA1
            CsmMacVerifyAlgorithmSecondaryFamily = CRYPTO_ALGOFAM_NOT_SET
            CsmMacVerifyAlgorithmKeyLength = 16
      CsmPrimitives_SigAsymVer_RsaPssSha256
        CsmSignatureVerify
          CsmPrimitives_SigAsymVer_RsaPssSha256 (CsmSignatureVerifyConfig):
            CsmSignatureVerifyAlgorithmFamily = CRYPTO_ALGOFAM_RSA
            CsmSignatureVerifyAlgorithmMode = CRYPTO_ALGOMODE_RSASSA_PSS
            CsmSignatureVerifyAlgorithmSecondaryFamily = CRYPTO_ALGOFAM_SHA2_256
            CsmSignatureVerifyKeyLength = 32
            CsmSignatureVerifyProcessing = CSM_SYNCHRONOUS
            CsmSignatureVerifyCompareLength = 32
            CsmSignatureVerifyAlgorithmFamiliy = CRYPTO_ALGOFAM_RSA
      CsmPrimitives_SigAsymVer_RsaV15Sha1
        CsmSignatureVerify
          CsmPrimitives_SigAsymVer_RsaV15Sha1 (CsmSignatureVerifyConfig):
            CsmSignatureVerifyAlgorithmFamily = CRYPTO_ALGOFAM_RSA
            CsmSignatureVerifyAlgorithmFamiliy = CRYPTO_ALGOFAM_RSA
            CsmSignatureVerifyAlgorithmMode = CRYPTO_ALGOMODE_RSASSA_PKCS1_v1_5
            CsmSignatureVerifyAlgorithmSecondaryFamily = CRYPTO_ALGOFAM_SHA1
            CsmSignatureVerifyKeyLength = 32
            CsmSignatureVerifyProcessing = CSM_SYNCHRONOUS
            CsmSignatureVerifyCompareLength = 32
      CsmPrimitives_SigAsymVer_Ed25519Sha512
        CsmSignatureVerify
          CsmPrimitives_SigAsymVer_Ed25519Sha512 (CsmSignatureVerifyConfig):
            CsmSignatureVerifyAlgorithmMode = CRYPTO_ALGOMODE_CUSTOM
            CsmSignatureVerifyProcessing = CSM_SYNCHRONOUS
            CsmSignatureVerifyAlgorithmFamily = CRYPTO_ALGOFAM_ED25519
            CsmSignatureVerifyAlgorithmSecondaryFamily = CRYPTO_ALGOFAM_SHA2_512
            CsmSignatureVerifyKeyLength = 32
            CsmSignatureVerifyCompareLength = 64
            CsmSignatureVerifyAlgorithmFamiliy = CRYPTO_ALGOFAM_ED25519
            CsmSignatureVerifyAlgorithmModeCustomRef = Crypto_30_LibCv_EdDsaEd25519Ph
      CsmPrimitives_SigAsymVer_DummySha512
        CsmHash
          CsmPrimitives_SigAsymVer_DummySha512 (CsmHashConfig):
            CsmHashAlgorithmFamily = CRYPTO_ALGOFAM_SHA2_512
            CsmHashProcessing = CSM_SYNCHRONOUS
            CsmHashResultLength = 64
            CsmHashAlgorithmFamiliy = CRYPTO_ALGOFAM_SHA2_512
            CsmHashAlgorithmMode = CRYPTO_ALGOMODE_NOT_SET
            CsmHashAlgorithmSecondaryFamily = CRYPTO_ALGOFAM_NOT_SET
    CsmMainFunction: CsmMainFunctionPartitionRef=EcucPartition
