AUTOSAR XML (schema 00049)
package /ActiveEcuC
  module config Fbl: implementation-config-variant=VARIANT-LINK-TIME, module-description=Fbl_Impl
    FblGeneral:
      FblDataProcessingBufferSize = 256
      FblDiagnosticBufferSize = 4095
      FblFlashDriverUsage = DOWNLOAD_DRIVER
      FblInternalMemoryCopy = true
      FblMaximumNumberOfSegments = 8
      FblOutputVerification = true
      FblP2Server = 10
      FblP2StarServer = 5000
      FblResponseAfterReset = true
      FblSleepTime = 300000
      FblUnalignedDataTransfer = true
      FblVerificationSegmentation = 256
      FblWriteSegmentation = 256
      FblApplicationStateTask = true
      FblApplicationTimerTask = true
      FblPresencePattern = true
      FblStartFunction = true
      FblAdaptiveDataTransferRcrrp = false
      FblGatewaySupport = false
      FblInputVerification = false
      FblOta = false
      FblHardwareSwap = false
      FblProcessedVerification = false
      FblOneStepUpdater = false
      FblS3ServerExtendedSession = 0
      FblS3ServerProgrammingSession = 0
      FblSuspendDriverOperation = false
      FblVerificationFunction = false
      FblReprogrammableLbt = false
      FblOsuFlashDriverRestoreStrategy = NO_FLASH_DRV_RESTORE
      FblProjectState = INTEGRATION
      FblStayInBoot = true
      FblSleepMode = false
      FblHeaderAddress = 65536
      FblGapFilling = false
      FblFillCode = 255
      FblCommonData = false
      FblUserSubfunction = false
      FblUserService = false
      FblUserRoutine = false
      FblWatchdogService = true
      FblWatchdogTriggerCycle = 1
      FblEncryptionMode = true
      FblCompressionMode = true
      FblPipelinedVerification = false
      FblPipelinedProgramming = false
      FblMaximumAmountOfLogicalBlocks = 1
      FblBlockStartAddress = 65536
      FblBlockLength = 262144
      FblXcpSupport = false
      FblEmbeddedVerificationData = false
      FblDelayFinalResponse = 0
    FblVector:
      FblAccessDelayTime = 10000
      FblCommunicationControlType = ENABLE_RX_AND_DISABLE_TX
      FblProcessDataStorage = true
      FblApplicationValidityFlag = true
      FblControlDTCOptionRecord = true
      FblCheckProgrammingPreconditionsService = true
    FblFlashBlockTable
      24 x FblFlashBlock:
        FblFlashBlock_0: FblFbStartAddress=0, FblFbEndAddress=8191, FblFbDescription=Flash Bank A Block0 (8KB)
        FblFlashBlock_1: FblFbStartAddress=8192, FblFbEndAddress=16383, FblFbDescription=Flash Bank A Block1 (8KB)
        FblFlashBlock_2: FblFbStartAddress=16384, FblFbEndAddress=24575, FblFbDescription=Flash Bank A Block2 (8KB)
        FblFlashBlock_3: FblFbStartAddress=24576, FblFbEndAddress=32767, FblFbDescription=Flash Bank A Block3 (8KB)
        FblFlashBlock_4: FblFbStartAddress=32768, FblFbEndAddress=40959, FblFbDescription=Flash Bank A Block4 (8KB)
        FblFlashBlock_5: FblFbStartAddress=40960, FblFbEndAddress=49151, FblFbDescription=Flash Bank A Block5 (8KB)
        FblFlashBlock_6: FblFbStartAddress=49152, FblFbEndAddress=57343, FblFbDescription=Flash Bank A Block6 (8KB)
        FblFlashBlock_7: FblFbStartAddress=57344, FblFbEndAddress=65535, FblFbDescription=Flash Bank A Block7 (8KB)
        FblFlashBlock_8: FblFbStartAddress=65536, FblFbEndAddress=98303, FblFbDescription=Flash Bank A Block8 (32KB), FblFbMemoryDeviceRef=Flash
        FblFlashBlock_9: FblFbStartAddress=98304, FblFbEndAddress=131071, FblFbDescription=Flash Bank A Block9 (32KB), FblFbMemoryDeviceRef=Flash
        FblFlashBlock_10: FblFbStartAddress=131072, FblFbEndAddress=163839, FblFbDescription=Flash Bank A Block10 (32KB), FblFbMemoryDeviceRef=Flash
        FblFlashBlock_11: FblFbStartAddress=163840, FblFbEndAddress=196607, FblFbDescription=Flash Bank A Block11 (32KB), FblFbMemoryDeviceRef=Flash
        FblFlashBlock_12: FblFbStartAddress=196608, FblFbEndAddress=229375, FblFbDescription=Flash Bank A Block12 (32KB), FblFbMemoryDeviceRef=Flash
        FblFlashBlock_13: FblFbStartAddress=229376, FblFbEndAddress=262143, FblFbDescription=Flash Bank A Block13 (32KB), FblFbMemoryDeviceRef=Flash
        FblFlashBlock_14: FblFbStartAddress=262144, FblFbEndAddress=294911, FblFbDescription=Flash Bank A Block14 (32KB), FblFbMemoryDeviceRef=Flash
        FblFlashBlock_15: FblFbStartAddress=294912, FblFbEndAddress=327679, FblFbDescription=Flash Bank A Block15 (32KB), FblFbMemoryDeviceRef=Flash
        FblFlashBlock_16: FblFbStartAddress=327680, FblFbEndAddress=393215, FblFbDescription=Flash Bank A Block16-17 (64KB), FblFbMemoryDeviceRef=Flash, FblFbLogicalBlockRef=DemoAppl
        FblFlashBlock_17: FblFbStartAddress=393216, FblFbEndAddress=458751, FblFbDescription=Flash Bank A Block18-19 (64KB), FblFbMemoryDeviceRef=Flash, FblFbLogicalBlockRef=DemoAppl
        FblFlashBlock_18: FblFbStartAddress=458752, FblFbEndAddress=524287, FblFbDescription=Flash Bank A Block20-21 (64KB), FblFbMemoryDeviceRef=Flash, FblFbLogicalBlockRef=DemoAppl
        FblFlashBlock_71: FblFbStartAddress=16777216, FblFbEndAddress=16809983, FblFbDescription=Extended User Area (32KB), FblFbMemoryDeviceRef=Flash
        FblFlashBlock_72: FblFbStartAddress=4280287232, FblFbEndAddress=4280303615, FblFbDescription=Data Flash Area Block0-255 (16KB)
        FblFlashBlock_73: FblFbStartAddress=4280303616, FblFbEndAddress=4280319999, FblFbDescription=Data Flash Area Block256-511 (16KB)
        FblFlashBlock_19: FblFbStartAddress=524288, FblFbEndAddress=589823, FblFbDescription=Flash Bank A Block22-23 (64KB), FblFbMemoryDeviceRef=Flash, FblFbLogicalBlockRef=DemoAppl
        FblFlashBlock_20: FblFbStartAddress=589824, FblFbEndAddress=655359, FblFbDescription=Flash Bank A Block24-25 (64KB), FblFbMemoryDeviceRef=Flash, FblFbLogicalBlockRef=DemoAppl
    FblMemoryDeviceTable
      Flash (FblMemoryDevice):
        FblMdErasedValue = 255
        FblMdSegmentSize = 256
        FblMdIndex = 0
        FblMdInitHook = false
        FblMdDeinitHook = false
        FblMdReadHook = false
        FblMdEraseHook = false
        FblMdWriteHook = false
        FblMdVerifyHook = false
    FblLogicalBlockTable
      DemoAppl (FblLogicalBlock):
        FblLbBlockNr = 0
        FblLbBlockIndex = 0
        FblLbDisposability = MANDATORY
        FblLbStartAddress = 327680
        FblLbEndAddress = 655359
        FblLbMaxReprogAttempts = 0
        FblLbInputVerification = SecM_VerifySignature
        FblLbProcessedVerification = SecM_VerifySignature
        FblLbPipelinedVerification = SecM_VerifySignature
        FblLbOutputVerification = SecM_Verification
        FblLbDescription = 
        FblLbBmHeaderAddress = 651232
