AUTOSAR XML (schema 00049)
package /ActiveEcuC
  module config vBRS: implementation-config-variant=VARIANT-PRE-COMPILE, module-description=vBRS_Impl
    vBRSGeneral:
      vBRSEnableEcuMStubGeneration = true
      vBRSEnableSchmStubGeneration = true
      vBRSExecutionInstance = FBL_Updater
      vBRSFblSupportExceptionTableInRam = false
      vBRSEnableCoreSpecificVLinkGenConfig = true
      vBRSEnableSupportLEDs = false
      vBRSEnableSafeContextSupport = false
      vBRSEnableMultiCoreSupport = false
      vBRSEnableSupportToggleWdPin = false
      vBRSEnableSupportToggleCustomPin = false
      vBRSDisableSetupSupport = false
      vBRSEnableSchmStubSupportDrvCanAN = true
      vBRSEnableSchmStubEmptyExclusiveAreaHandling = false
      vBRSFirstInstance = false
      vBRSFblSupportEcuMInit = true
      vBRSEnableSmallDevicesOptimization = false
      vBRSHypervisorGuest = false
      vBRSVariantUsageOfvLinkGen = vLinkGenVariant_DemoAppl
    vBRSHwConfig:
      vBRSEnablePLLClocksHandling = false
      vBRSEnablePortHandling = true
      vBRSEnableWatchdogHandling = true
      vBRSPreferPLLWatchdogInit = true
      vBRSPeriphClockDescription = Initial freq. values moved to vBaseEnv preconfig files. OSTM0 is used as Peripheral Timer for OS.
      vBRSOscClock = 16000000
      vBRSTimebaseClock = 160000000
      vBRSPeriphClock = 40000000
      vBRSProjectName = DemoAppl
      vBRSEvaluationBoard = F1X_176PIN_EVB
      vBRSMcuClockReferencePointForBrsPeriphClock = McuClockReferencePoint
      10 x vBRSEvalBoardInfo:
        X1X_DEFAULT_EVB: vBRSEvalBoard=X1X_DEFAULT_EVB, vBRSEvalBoardDescription=Default EVB for C1H, C1M, D1X, E1X, E1xFCC2, P1XC, R1L : Toggle Port 10 Pin 3
        F1X_064PIN_EVB: vBRSEvalBoard=F1X_064PIN_EVB, vBRSEvalBoardDescription=Toggle Port 8 Pin 1
        F1X_100PIN_EVB: vBRSEvalBoard=F1X_100PIN_EVB, vBRSEvalBoardDescription=Toggle Port 8 Pin 1
        F1X_144PIN_EVB: vBRSEvalBoard=F1X_144PIN_EVB, vBRSEvalBoardDescription=Toggle Port 8 Pin 1
        F1X_176PIN_EVB: vBRSEvalBoard=F1X_176PIN_EVB, vBRSEvalBoardDescription=Toggle Port 8 Pin 1
        F1X_STARTERKIT_V2_EVB: vBRSEvalBoard=F1X_STARTERKIT_V2_EVB, vBRSEvalBoardDescription=Toggle Port 0 Pin 11 --> LED1, set CAN0_EN and CAN1_EN to high
        P1XC_80PIN_EVB: vBRSEvalBoard=P1XC_80PIN_EVB, vBRSEvalBoardDescription=Toggle Port 2 Pin 2
        P1XC_292PIN_EVB: vBRSEvalBoard=P1XC_292PIN_EVB, vBRSEvalBoardDescription=Toggle Port 6 Pin 0
        P1X_100PIN_EVB: vBRSEvalBoard=P1X_100PIN_EVB, vBRSEvalBoardDescription=Toggle Port 2 Pin 2
        P1X_144PIN_EVB: vBRSEvalBoard=P1X_144PIN_EVB, vBRSEvalBoardDescription=Toggle Port 5 Pin 8
      vBRSDriverHandlingCAN:
        vBRSEnableDriverHandlingCAN = true
        vBRSDriverHandlingCAN_channel0 = true
        vBRSDriverHandlingCAN_channel{1..9} = false
        vBRSDriverHandlingCAN_PeripheralClock = true
        vBRSDriverHandlingCAN_channel{10..19} = false
    vBRSMemoryInit:
      vBRSInitPatternBlocks = 0
      vBRSInitPatternHardResetBlocks = 0
      vBRSInitPatternAreas = 0
      vBRSInitPatternHardResetAreas = 0
      vBRSInitEnable64BitInitPattern = false
      vBRSDisableMemoryInitGlobally = false
