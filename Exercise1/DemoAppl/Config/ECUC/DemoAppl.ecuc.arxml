AUTOSAR XML (schema 00049)
package /ActiveEcuC
  ecuc value collection ActiveEcuC
    ecuc-values:
      MemMap
      Csm
      Can
      vSecPrim
      Crypto
      FblBm
      FblMio
      Det
      EcuC
      FblBmHdr
      Smh
      Dcm
      vSet
      PduR
      WrapNv
      CanIf
      CanTp
      CryIf
      FblAsrStubs
      Os
      Mcu
      Fbl
      FblHal
      vLinkGen
      vBaseEnv
      vBRS
