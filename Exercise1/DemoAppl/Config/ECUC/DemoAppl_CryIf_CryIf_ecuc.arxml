AUTOSAR XML (schema 00049)
package /ActiveEcuC
  module config CryIf: implementation-config-variant=VARIANT-PRE-COMPILE, module-description=CryIf_Impl
    7 x CryIfKey:
      CryIfKey_Fbl_Decrypt_Aes128: CryIfKeyId=0, CryIfKeyRef=CryptoKey_Fbl_Decrypt_Aes128
      CryIfKey_Fbl_Signature_ClassC: CryIfKeyId=1, CryIfKeyRef=CryptoKey_Fbl_Signature_Class_C
      CryIfKey_Fbl_Signature_Ed25519: CryIfKeyId=2, CryIfKeyRef=CryptoKey_Fbl_Signature_Ed25519
      CryIfKey_Fbl_Signature_Rsa1024: CryIfKeyId=3, CryIfKeyRef=CryptoKey_Fbl_Signature_Rsa1024
      CryIfKey_Fbl_Signature_Rsa2048: CryIfKeyId=4, CryIfKeyRef=CryptoKey_Fbl_Signature_Rsa2048
      CryIfKey_Fbl_Signature_Rsa3072: CryIfKeyId=5, CryIfKeyRef=CryptoKey_Fbl_Signature_Rsa3072
      CryIfKey_Fbl_HashDummy: CryIfKeyId=6, CryIfKeyRef=CryptoKey_Fbl_HashDummy
    CryIfChannel_CryptoCv_Fbl_Aes (CryIfChannel): CryIfChannelId=1, CryIfDriverObjectRef=Crypto_30_LibCv_Aes
    CryIfChannel_CryptoCv_Fbl_Signature (CryIfChannel): CryIfChannelId=0, CryIfDriverObjectRef=Crypto_30_LibCv
    Crypto (CryIfCryptoModule):
      CryIfSupportsKeyElementCopyPartial = true
      CryIfCancelJobApiUsesJobType = true
      CryIfSupportsCertificateAPI = true
      CryIfSupportsKeyStatusAPI = false
      CryIfCryptoModuleRef = Crypto
    CryIfGeneral:
      CryIfVersionInfoApi = false
      CryIfDevErrorDetect = true
      CryIfMaxNumberOfKeyElements = 10
      CryIfMaxSizeOfKeyElement = 32
      CryIfRedirection = false
      CryIfSafeBswChecks = true
