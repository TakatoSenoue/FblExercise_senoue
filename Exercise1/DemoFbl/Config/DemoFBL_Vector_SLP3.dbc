VERSION ""

NS_ :

BS_:

BU_: Demo_2_2CAN11 Tester_CAN_FD Demo_0_CAN11_FD11 Demo_1_FD29 Demo_0_FD11 Demo_1_CAN29 Demo_0_CAN11 Tester_FD Tester

BO_ 1914 Functional_CAN_2: 8 Tester_CAN_FD
 SG_ Functional_CAN_FD : 0|64@1+ (1,0) [0|0] ""  Demo_2_2CAN11

BO_ 1460 Demo_2_CAN_Response_1: 8 Demo_2_2CAN11
 SG_ Demo_2_CAN_Response_1 : 0|64@1+ (1,0) [0|0] ""  Tester_CAN_FD

BO_ 1459 Demo_2_CAN_Response_0: 8 Demo_2_2CAN11
 SG_ Demo_2_CAN_Response_0 : 0|64@1+ (1,0) [0|0] ""  Tester

BO_ 1444 Demo_2_CAN_Request_1: 8 Tester_CAN_FD
 SG_ Demo_2_CAN_Request_1 : 0|64@1+ (1,0) [0|0] ""  Demo_2_2CAN11

BO_ 1443 Demo_2_CAN_Request_0: 8 Tester
 SG_ Demo_2_CAN_Request_0 : 0|64@1+ (1,0) [0|0] ""  Demo_2_2CAN11

BO_ 1913 Functional_CAN_FD: 64 Tester_CAN_FD
 SG_ Functional_CAN_FD : 0|64@1+ (1,0) [0|0] ""  Demo_0_CAN11_FD11

BO_ 1458 Demo_0_CAN_FD_Response: 64 Demo_0_CAN11_FD11
 SG_ Demo_0_CAN_FD_Response : 0|64@1+ (1,0) [0|0] ""  Tester_CAN_FD

BO_ 1442 Demo_0_CAN_FD_Request: 64 Tester_CAN_FD
 SG_ Demo_0_CAN_FD_Request : 0|64@1+ (1,0) [0|0] ""  Demo_0_CAN11_FD11

BO_ 2564481698 Demo_1_FD_Response: 64 Demo_1_FD29
 SG_ Demo_1_FD_Response : 0|64@1+ (1,0) [0|0] ""  Tester_FD

BO_ 2564481441 Demo_1_CAN_Response: 8 Demo_1_CAN29
 SG_ Demo_1_CAN_Response : 0|64@1+ (1,0) [0|0] ""  Tester

BO_ 1457 Demo_0_FD_Response: 64 Demo_0_FD11
 SG_ Demo_0_FD_Response : 0|64@1+ (1,0) [0|0] ""  Tester_FD

BO_ 1456 Demo_0_CAN_Response: 8 Demo_0_CAN11
 SG_ Demo_0_CAN_Response : 0|64@1+ (1,0) [0|0] ""  Tester

BO_ 2564465378 Demo_1_FD_Request: 64 Tester_FD
 SG_ Demo_1_FD_Request : 0|64@1+ (1,0) [0|0] ""  Demo_1_FD29

BO_ 1441 Demo_0_FD_Request: 64 Tester_FD
 SG_ Demo_0_FD_Request : 0|64@1+ (1,0) [0|0] ""  Demo_0_FD11

BO_ 2564465121 Demo_1_CAN_Request: 8 Tester
 SG_ Demo_1_CAN_Request : 0|64@1+ (1,0) [0|0] ""  Demo_1_CAN29

BO_ 1440 Demo_0_CAN_Request: 8 Tester
 SG_ Demo_0_CAN_Request : 0|64@1+ (1,0) [0|0] ""  Demo_0_CAN11

BO_ 1912 Functional_FD: 64 Tester_FD
 SG_ Functional_FD : 0|64@1+ (1,0) [0|0] ""  Demo_1_FD29,Demo_0_FD11

BO_ 1911 Functional_CAN: 8 Tester
 SG_ Functional_CAN : 0|64@1+ (1,0) [0|0] ""  Demo_2_2CAN11,Demo_1_CAN29,Demo_0_CAN11

CM_ BU_ Demo_2_2CAN11 "Classic CAN, 2 Connections";
CM_ BU_ Tester_CAN_FD "Classic CAN + CAN FD, 11 Bit identifies";
CM_ BU_ Demo_0_CAN11_FD11 "Classic CAN + CAN FD, 11 Bit identifiers";
CM_ BU_ Demo_1_FD29 "CAN FD, physical 29 Bit identifiers, functional 11 Bit identifier";
CM_ BU_ Demo_0_FD11 "CAN FD, 11 Bit identifiers";
CM_ BU_ Demo_1_CAN29 "Classic CAN, physical 29 Bit identifiers, functional 11 Bit identifier";
CM_ BU_ Demo_0_CAN11 "Classic CAN, 11 Bit identifiers";
CM_ BU_ Tester_FD "CAN FD";
CM_ BU_ Tester "Classic CAN";
CM_ BO_ 2564481698 "Physical CAN FD response message (29 Bit ID)";
CM_ BO_ 2564481441 "Physical CAN response message (29 Bit ID)";
CM_ BO_ 1457 "Physical CAN FD response message (11 Bit ID)";
CM_ BO_ 1456 "Physical CAN response message (11 Bit ID)";
CM_ BO_ 2564465378 "Physical CAN FD request message (29 Bit ID)";
CM_ BO_ 1441 "Physical CAN FD request message (11 Bit ID)";
CM_ BO_ 2564465121 "Physical CAN request message (29 Bit ID)";
CM_ BO_ 1440 "Physical CAN request message (11 Bit ID)";
CM_ BO_ 1912 "Functional CAN FD message (11 Bit ID)";
CM_ BO_ 1911 "Functional CAN message (11 Bit ID)";
BA_DEF_ BO_  "DiagFdOnly" ENUM  "no","yes";
BA_DEF_  "Manufacturer" STRING ;
BA_DEF_ BO_  "DiagState" ENUM  "no","yes";
BA_DEF_ BO_  "DiagResponse" ENUM  "no","yes";
BA_DEF_ BO_  "DiagRequest" ENUM  "no","yes";
BA_DEF_ BO_  "CANFD_BRS" ENUM  "0","1";
BA_DEF_  "DBName" STRING ;
BA_DEF_  "BusType" STRING ;
BA_DEF_ BO_  "VFrameFormat" ENUM  "StandardCAN","ExtendedCAN","reserved","reserved","reserved","reserved","reserved","reserved","reserved","reserved","reserved","reserved","reserved","reserved","StandardCAN_FD","ExtendedCAN_FD";
BA_DEF_DEF_  "DiagFdOnly" "yes";
BA_DEF_DEF_  "Manufacturer" "Vector";
BA_DEF_DEF_  "DiagState" "no";
BA_DEF_DEF_  "DiagResponse" "no";
BA_DEF_DEF_  "DiagRequest" "no";
BA_DEF_DEF_  "CANFD_BRS" "1";
BA_DEF_DEF_  "DBName" "";
BA_DEF_DEF_  "BusType" "";
BA_DEF_DEF_  "VFrameFormat" "StandardCAN";
BA_ "BusType" "CAN FD";
BA_ "DBName" "DemoFBL_Vector_SLP3";
BA_ "DiagFdOnly" BO_ 1914 0;
BA_ "DiagState" BO_ 1914 1;
BA_ "CANFD_BRS" BO_ 1914 0;
BA_ "DiagFdOnly" BO_ 1460 0;
BA_ "DiagResponse" BO_ 1460 1;
BA_ "CANFD_BRS" BO_ 1460 0;
BA_ "DiagFdOnly" BO_ 1459 0;
BA_ "DiagResponse" BO_ 1459 1;
BA_ "CANFD_BRS" BO_ 1459 0;
BA_ "DiagFdOnly" BO_ 1444 0;
BA_ "DiagRequest" BO_ 1444 1;
BA_ "CANFD_BRS" BO_ 1444 0;
BA_ "DiagFdOnly" BO_ 1443 0;
BA_ "DiagRequest" BO_ 1443 1;
BA_ "CANFD_BRS" BO_ 1443 0;
BA_ "DiagFdOnly" BO_ 1913 0;
BA_ "DiagState" BO_ 1913 1;
BA_ "VFrameFormat" BO_ 1913 14;
BA_ "DiagFdOnly" BO_ 1458 0;
BA_ "DiagResponse" BO_ 1458 1;
BA_ "VFrameFormat" BO_ 1458 14;
BA_ "DiagFdOnly" BO_ 1442 0;
BA_ "DiagRequest" BO_ 1442 1;
BA_ "VFrameFormat" BO_ 1442 14;
BA_ "DiagResponse" BO_ 2564481698 1;
BA_ "VFrameFormat" BO_ 2564481698 15;
BA_ "CANFD_BRS" BO_ 2564481441 0;
BA_ "DiagResponse" BO_ 2564481441 1;
BA_ "VFrameFormat" BO_ 2564481441 1;
BA_ "DiagResponse" BO_ 1457 1;
BA_ "VFrameFormat" BO_ 1457 14;
BA_ "DiagResponse" BO_ 1456 1;
BA_ "CANFD_BRS" BO_ 1456 0;
BA_ "DiagRequest" BO_ 2564465378 1;
BA_ "VFrameFormat" BO_ 2564465378 15;
BA_ "DiagRequest" BO_ 1441 1;
BA_ "VFrameFormat" BO_ 1441 14;
BA_ "DiagRequest" BO_ 2564465121 1;
BA_ "VFrameFormat" BO_ 2564465121 1;
BA_ "CANFD_BRS" BO_ 2564465121 0;
BA_ "DiagRequest" BO_ 1440 1;
BA_ "CANFD_BRS" BO_ 1440 0;
BA_ "DiagState" BO_ 1912 1;
BA_ "VFrameFormat" BO_ 1912 14;
BA_ "DiagState" BO_ 1911 1;
BA_ "CANFD_BRS" BO_ 1911 0;
