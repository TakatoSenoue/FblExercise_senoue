AUTOSAR XML (schema 00049)
package /VehicleProject
  system System
package /TP
  can tp config DemoFBL_Vector_SLP3_CAN: communication-cluster=DemoFBL_Vector_SLP3, can-tp-ecu{cycle-time-main-function=0.005, ecu-instance=Demo_0_CAN11_FD11}
    can tp channel TPCH: channel-id=0, channel-mode=FULL-DUPLEX-MODE
    can-tp-connection addressing-format=STANDARD, can-tp-channel=TPCH, data-pdu=Functional_CAN_FD_Tp_oDemoFBL_Vector_SLP3, receiver=TN_Demo_0_CAN11_FD11_FD, ta-type=FUNCTIONAL-CAN-FD, tp-sdu=Functional_CAN_FD_oDemoFBL_Vector_SLP3, transmitter=TN_Tester_CAN_FD_FD:
      ident Functional_CAN_FD_FD_oTN_Tester_CAN_FD_FD
    can-tp-connection addressing-format=STANDARD, can-tp-channel=TPCH, data-pdu=Functional_CAN_FD_Tp_oDemoFBL_Vector_SLP3_20, receiver=TN_Demo_0_CAN11_FD11, ta-type=FUNCTIONAL, tp-sdu=Functional_CAN_FD_oDemoFBL_Vector_SLP3_20, transmitter=TN_Tester_CAN_FD:
      ident Functional_CAN_FD_oTN_Tester_CAN_FD
    can-tp-connection addressing-format=STANDARD, can-tp-channel=TPCH, data-pdu=Demo_0_CAN_FD_Request_Tp_oDemoFBL_Vector_SLP3_20, flow-control-pdu=Demo_0_CAN_FD_Response_Tp_oDemoFBL_Vector_SLP3_20, receiver=TN_Demo_0_CAN11_FD11, ta-type=PHYSICAL, tp-sdu=Demo_0_CAN_FD_Request_oDemoFBL_Vector_SLP3_20, transmitter=TN_Tester_CAN_FD:
      ident Demo_0_CAN_FD_Request_oTN_Demo_0_CAN11_FD11
    can-tp-connection addressing-format=STANDARD, can-tp-channel=TPCH, data-pdu=Demo_0_CAN_FD_Request_Tp_oDemoFBL_Vector_SLP3, flow-control-pdu=Demo_0_CAN_FD_Response_Tp_oDemoFBL_Vector_SLP3, receiver=TN_Demo_0_CAN11_FD11_FD, ta-type=PHYSICAL-CAN-FD, tp-sdu=Demo_0_CAN_FD_Request_oDemoFBL_Vector_SLP3, transmitter=TN_Tester_CAN_FD_FD:
      ident Demo_0_CAN_FD_Request_oTN_Demo_0_CAN11_FD11_FD
    can-tp-connection addressing-format=STANDARD, can-tp-channel=TPCH, data-pdu=Demo_0_CAN_FD_Response_Tp_oDemoFBL_Vector_SLP3_20, flow-control-pdu=Demo_0_CAN_FD_Request_Tp_oDemoFBL_Vector_SLP3_20, receiver=TN_Tester_CAN_FD, ta-type=PHYSICAL, tp-sdu=Demo_0_CAN_FD_Response_oDemoFBL_Vector_SLP3_20, transmitter=TN_Demo_0_CAN11_FD11:
      ident Demo_0_CAN_FD_Response_oTN_Demo_0_CAN11_FD11
    can-tp-connection addressing-format=STANDARD, can-tp-channel=TPCH, data-pdu=Demo_0_CAN_FD_Response_Tp_oDemoFBL_Vector_SLP3, flow-control-pdu=Demo_0_CAN_FD_Request_Tp_oDemoFBL_Vector_SLP3, receiver=TN_Tester_CAN_FD_FD, ta-type=PHYSICAL-CAN-FD, tp-sdu=Demo_0_CAN_FD_Response_oDemoFBL_Vector_SLP3, transmitter=TN_Demo_0_CAN11_FD11_FD:
      ident Demo_0_CAN_FD_Response_oTN_Demo_0_CAN11_FD11_FD
    4 x can tp node:
      TN_Demo_0_CAN11_FD11: connector=CN_DemoFBL_Vector_SLP3
      TN_Demo_0_CAN11_FD11_FD: connector=CN_DemoFBL_Vector_SLP3
      TN_Tester_CAN_FD
      TN_Tester_CAN_FD_FD
package /Cluster
  can cluster DemoFBL_Vector_SLP3: protocol-name=CAN
    can physical channel CHNL: comm-connectors=CN_DemoFBL_Vector_SLP3
      frame Demo_0_CAN_FD_Request_oDemoFBL_Vector_SLP3: id 0x5A2, to Demo_0_CAN11_FD11, frame-length=64, can-addressing-mode=STANDARD, can-frame-rx-behavior=CAN-FD, can-frame-tx-behavior=CAN-FD
        n pdu Demo_0_CAN_FD_Request_Tp_oDemoFBL_Vector_SLP3: length=64
      frame Demo_0_CAN_FD_Request_oDemoFBL_Vector_SLP3_20: id 0x5A2, to Demo_0_CAN11_FD11, frame-length=8, can-addressing-mode=STANDARD, can-frame-rx-behavior=CAN-20, can-frame-tx-behavior=CAN-20
        n pdu Demo_0_CAN_FD_Request_Tp_oDemoFBL_Vector_SLP3_20: length=8
      frame Demo_0_CAN_FD_Response_oDemoFBL_Vector_SLP3: id 0x5B2, from Demo_0_CAN11_FD11, frame-length=64, can-addressing-mode=STANDARD, can-frame-rx-behavior=CAN-FD, can-frame-tx-behavior=CAN-FD
        n pdu Demo_0_CAN_FD_Response_Tp_oDemoFBL_Vector_SLP3: length=64
      frame Demo_0_CAN_FD_Response_oDemoFBL_Vector_SLP3_20: id 0x5B2, from Demo_0_CAN11_FD11, frame-length=8, can-addressing-mode=STANDARD, can-frame-rx-behavior=CAN-20, can-frame-tx-behavior=CAN-20
        n pdu Demo_0_CAN_FD_Response_Tp_oDemoFBL_Vector_SLP3_20: length=8
      frame Functional_CAN_FD_oDemoFBL_Vector_SLP3: id 0x779, to Demo_0_CAN11_FD11, frame-length=64, can-addressing-mode=STANDARD, can-frame-rx-behavior=CAN-FD, can-frame-tx-behavior=CAN-FD
        n pdu Functional_CAN_FD_Tp_oDemoFBL_Vector_SLP3: length=64
      frame Functional_CAN_FD_oDemoFBL_Vector_SLP3_20: id 0x779, to Demo_0_CAN11_FD11, frame-length=8, can-addressing-mode=STANDARD, can-frame-rx-behavior=CAN-20, can-frame-tx-behavior=CAN-20
        n pdu Functional_CAN_FD_Tp_oDemoFBL_Vector_SLP3_20: length=8
      pdu triggering PT_Demo_0_CAN_FD_Request: pdu=Demo_0_CAN_FD_Request_oDemoFBL_Vector_SLP3, to Demo_0_CAN11_FD11
      pdu triggering PT_Demo_0_CAN_FD_Request_20: pdu=Demo_0_CAN_FD_Request_oDemoFBL_Vector_SLP3_20, to Demo_0_CAN11_FD11
      pdu triggering PT_Demo_0_CAN_FD_Response: pdu=Demo_0_CAN_FD_Response_oDemoFBL_Vector_SLP3, from Demo_0_CAN11_FD11
      pdu triggering PT_Demo_0_CAN_FD_Response_20: pdu=Demo_0_CAN_FD_Response_oDemoFBL_Vector_SLP3_20, from Demo_0_CAN11_FD11
      pdu triggering PT_Functional_CAN_FD: pdu=Functional_CAN_FD_oDemoFBL_Vector_SLP3, to Demo_0_CAN11_FD11
      pdu triggering PT_Functional_CAN_FD_20: pdu=Functional_CAN_FD_oDemoFBL_Vector_SLP3_20, to Demo_0_CAN11_FD11
package /ECU
  ecu instance Demo_0_CAN11_FD11  # Classic CAN + CAN FD, 11 Bit identifiers
    can communication controller CT_DemoFBL_Vector_SLP3
    can communication connector CN_DemoFBL_Vector_SLP3: comm-controller=CT_DemoFBL_Vector_SLP3
package /PDU
  dcm i pdu Demo_0_CAN_FD_Request_oDemoFBL_Vector_SLP3: length=64, diag-pdu-type=DIAG-REQUEST
  dcm i pdu Demo_0_CAN_FD_Request_oDemoFBL_Vector_SLP3_20: length=8, diag-pdu-type=DIAG-REQUEST
  dcm i pdu Demo_0_CAN_FD_Response_oDemoFBL_Vector_SLP3: length=64, diag-pdu-type=DIAG-RESPONSE
  dcm i pdu Demo_0_CAN_FD_Response_oDemoFBL_Vector_SLP3_20: length=8, diag-pdu-type=DIAG-RESPONSE
  dcm i pdu Functional_CAN_FD_oDemoFBL_Vector_SLP3: length=62, diag-pdu-type=DIAG-REQUEST
  dcm i pdu Functional_CAN_FD_oDemoFBL_Vector_SLP3_20: length=7, diag-pdu-type=DIAG-REQUEST
