AUTOSAR XML (schema 00049)
package /ActiveEcuC
  module config FblAsrStubs: implementation-config-variant=VARIANT-LINK-TIME, module-description=FblAsrStubs_Impl
    FblAsrStubsModuleConfigDefines: FblAsrStubsCreateGptConfigDefines=false, FblAsrStubsCreateDemConfigDefines=false, FblAsrStubsCreateComConfigDefines=false
