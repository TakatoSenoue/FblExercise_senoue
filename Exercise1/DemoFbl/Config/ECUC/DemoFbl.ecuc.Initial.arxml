AUTOSAR XML (schema 00049)
package /InitialEcuC
  ecuc value collection InitialEcuC: ecuc-values=[Can, CanIf, CanSM, CanTp, ComM, Dcm, EcuC, EcuM, PduR]
  module config Can
    CanConfigSet
      CT_DemoFBL_Vector_SLP3_216858f6 (CanController):
        CanControllerActivation = true
        CanControllerDefaultBaudrate = CanControllerBaudrateConfig
        CanControllerSystemRef = CT_DemoFBL_Vector_SLP3
        CanWakeupSourceRef = EcuMCommonConfiguration/CN_DemoFBL_Vector_SLP3_abba4211
        CanControllerBaudrateConfig
      CN_DemoFBL_Vector_SLP3_abba4211_Tx (CanHardwareObject): CanHandleType=BASIC, CanIdValue=0, CanObjectType=TRANSMIT, CanControllerRef=CanConfigSet/CT_DemoFBL_Vector_SLP3_216858f6
      CN_DemoFBL_Vector_SLP3_dfd96cca_Rx (CanHardwareObject): CanHandleType=BASIC, CanIdType=STANDARD, CanIdValue=0, CanObjectType=RECEIVE, CanControllerRef=CanConfigSet/CT_DemoFBL_Vector_SLP3_216858f6
    CanGeneral: CanIndex=0
  module config CanIf
    CanIfCtrlDrvCfg_7d254554 (CanIfCtrlDrvCfg): CanIfCtrlDrvInitHohConfigRef=CanIfInitHohCfg, CanIfCtrlDrvNameRef=CanGeneral
      CT_DemoFBL_Vector_SLP3_216858f6 (CanIfCtrlCfg): CanIfCtrlCanCtrlRef=CanConfigSet/CT_DemoFBL_Vector_SLP3_216858f6
    CanIfInitCfg
      CHNL_3b54cc70 (CanIfBufferCfg): CanIfBufferSize=0, CanIfBufferHthRef=CanIfInitHohCfg/CN_DemoFBL_Vector_SLP3_abba4211_Tx
      CanIfInitHohCfg: CanIfInitRefCfgSet=CanConfigSet
        CN_DemoFBL_Vector_SLP3_dfd96cca_Rx (CanIfHrhCfg):
          CanIfHrhCanCtrlIdRef = CanIfCtrlDrvCfg_7d254554/CT_DemoFBL_Vector_SLP3_216858f6
          CanIfHrhIdSymRef = CanConfigSet/CN_DemoFBL_Vector_SLP3_dfd96cca_Rx
        CN_DemoFBL_Vector_SLP3_abba4211_Tx (CanIfHthCfg):
          CanIfHthCanCtrlIdRef = CanIfCtrlDrvCfg_7d254554/CT_DemoFBL_Vector_SLP3_216858f6
          CanIfHthIdSymRef = CanConfigSet/CN_DemoFBL_Vector_SLP3_abba4211_Tx
      4 x CanIfRxPduCfg, all with CanIfRxPduUserRxIndicationName=CanTp_RxIndication, CanIfRxPduUserRxIndicationType=PDUID_PDUINFOPTR, CanIfRxPduUserRxIndicationUL=CAN_TP, CanIfRxPduHrhIdRef=CanIfInitHohCfg/CN_DemoFBL_Vector_SLP3_dfd96cca_Rx:
        Demo_0_CAN_FD_Request_Tp_oDemoFBL_Vector_SLP3_20_507d1247_Rx: CanIfRxPduCanId=1442, CanIfRxPduCanIdType=STANDARD_NO_FD_CAN, CanIfRxPduDlc=8, CanIfRxPduRef=Demo_0_CAN_FD_Request_Tp_oDemoFBL_Vector_SLP3_20_f2ebe614_Rx
        Demo_0_CAN_FD_Request_Tp_oDemoFBL_Vector_SLP3_c807a36f_Rx: CanIfRxPduCanId=1442, CanIfRxPduCanIdType=STANDARD_FD_CAN, CanIfRxPduDlc=64, CanIfRxPduRef=Demo_0_CAN_FD_Request_Tp_oDemoFBL_Vector_SLP3_9e917504_Rx
        Functional_CAN_FD_Tp_oDemoFBL_Vector_SLP3_20_12cf71bb_Rx: CanIfRxPduCanId=1913, CanIfRxPduCanIdType=STANDARD_NO_FD_CAN, CanIfRxPduDlc=8, CanIfRxPduRef=Functional_CAN_FD_Tp_oDemoFBL_Vector_SLP3_20_883488d5_Rx
        Functional_CAN_FD_Tp_oDemoFBL_Vector_SLP3_646360de_Rx: CanIfRxPduCanId=1913, CanIfRxPduCanIdType=STANDARD_FD_CAN, CanIfRxPduDlc=64, CanIfRxPduRef=Functional_CAN_FD_Tp_oDemoFBL_Vector_SLP3_36e4c388_Rx
      Demo_0_CAN_FD_Response_Tp_oDemoFBL_Vector_SLP3_20_cf88ffc8_Tx (CanIfTxPduCfg):
        CanIfTxPduCanId = 1458
        CanIfTxPduCanIdType = STANDARD_CAN
        CanIfTxPduDlc = 8
        CanIfTxPduUserTxConfirmationName = CanTp_TxConfirmation
        CanIfTxPduUserTxConfirmationUL = CAN_TP
        CanIfTxPduBufferRef = CanIfInitCfg/CHNL_3b54cc70
        CanIfTxPduRef = Demo_0_CAN_FD_Response_Tp_oDemoFBL_Vector_SLP3_20_ee1db9f7_Tx
      Demo_0_CAN_FD_Response_Tp_oDemoFBL_Vector_SLP3_efb2f3be_Tx (CanIfTxPduCfg):
        CanIfTxPduCanId = 1458
        CanIfTxPduCanIdType = STANDARD_FD_CAN
        CanIfTxPduDlc = 64
        CanIfTxPduUserTxConfirmationName = CanTp_TxConfirmation
        CanIfTxPduUserTxConfirmationUL = CAN_TP
        CanIfTxPduBufferRef = CanIfInitCfg/CHNL_3b54cc70
        CanIfTxPduRef = Demo_0_CAN_FD_Response_Tp_oDemoFBL_Vector_SLP3_126039d0_Tx
    CanIfPrivateCfg: CanIfPrivateSoftwareFilterType=LINEAR
    CanIfPublicCfg: CanIfPublicPnSupport=false
  module config CanSM
    CanSMConfiguration
      CHNL_3b54cc70 (CanSMManagerNetwork): CanSMComMNetworkHandleRef=ComMConfigSet/CN_DemoFBL_Vector_SLP3_abba4211
        CT_DemoFBL_Vector_SLP3_a75d9abc (CanSMController): CanSMControllerId=CanIfCtrlDrvCfg_7d254554/CT_DemoFBL_Vector_SLP3_216858f6
  module config CanTp
    CanTpConfig: CanTpMainFunctionPeriod=0.005
      4 x CanTpChannel, all with CanTpChannelMode=CANTP_MODE_FULL_DUPLEX:
        TPCH_1059bc7c
          CanTpRxNSdu_0468c0cb (CanTpRxNSdu):
            CanTpRxAddressingFormat = CANTP_STANDARD
            CanTpRxDl = 8
            CanTpRxTaType = CANTP_PHYSICAL
            CanTpRxNSduRef = EcucPduCollection/Demo_0_CAN_FD_Request_oDemoFBL_Vector_SLP3_20_dc7615a6_Rx
            CanTpRxNPdu_df6d4951 (CanTpRxNPdu): CanTpRxNPduRef=Demo_0_CAN_FD_Request_Tp_oDemoFBL_Vector_SLP3_20_f2ebe614_Rx
            CanTpTxFcNPdu_df6d4951 (CanTpTxFcNPdu): CanTpTxFcNPduRef=Demo_0_CAN_FD_Response_Tp_oDemoFBL_Vector_SLP3_20_ee1db9f7_Tx
          CanTpTxNSdu_0468c0cb (CanTpTxNSdu):
            CanTpTxAddressingFormat = CANTP_STANDARD
            CanTpTxDl = 8
            CanTpTxTaType = CANTP_PHYSICAL
            CanTpTxNSduRef = EcucPduCollection/Demo_0_CAN_FD_Response_oDemoFBL_Vector_SLP3_20_50875972_Tx
            CanTpRxFcNPdu_fd979da3 (CanTpRxFcNPdu): CanTpRxFcNPduRef=Demo_0_CAN_FD_Request_Tp_oDemoFBL_Vector_SLP3_20_f2ebe614_Rx
            CanTpTxNPdu_fd979da3 (CanTpTxNPdu): CanTpTxNPduRef=Demo_0_CAN_FD_Response_Tp_oDemoFBL_Vector_SLP3_20_ee1db9f7_Tx
        TPCH_35dcba18
          CanTpRxNSdu_08631fbd (CanTpRxNSdu):
            CanTpRxAddressingFormat = CANTP_STANDARD
            CanTpRxDl = 8
            CanTpRxTaType = CANTP_FUNCTIONAL
            CanTpRxNSduRef = EcucPduCollection/Functional_CAN_FD_oDemoFBL_Vector_SLP3_20_7403a32a_Rx
            CanTpRxNPdu_3cfeb570 (CanTpRxNPdu): CanTpRxNPduRef=Functional_CAN_FD_Tp_oDemoFBL_Vector_SLP3_20_883488d5_Rx
        TPCH_b06d3498
          CanTpRxNSdu_e1aeb83a (CanTpRxNSdu):
            CanTpRxAddressingFormat = CANTP_STANDARD
            CanTpRxDl = 64
            CanTpRxTaType = CANTP_CANFD_FUNCTIONAL
            CanTpRxNSduRef = EcucPduCollection/Functional_CAN_FD_oDemoFBL_Vector_SLP3_ed563a98_Rx
            CanTpRxNPdu_e4a40b7d (CanTpRxNPdu): CanTpRxNPduRef=Functional_CAN_FD_Tp_oDemoFBL_Vector_SLP3_36e4c388_Rx
        TPCH_e51207dc
          CanTpRxNSdu_f05a2e85 (CanTpRxNSdu):
            CanTpRxAddressingFormat = CANTP_STANDARD
            CanTpRxDl = 64
            CanTpRxTaType = CANTP_CANFD_PHYSICAL
            CanTpRxNSduRef = EcucPduCollection/Demo_0_CAN_FD_Request_oDemoFBL_Vector_SLP3_6635a675_Rx
            CanTpRxNPdu_e980d874 (CanTpRxNPdu): CanTpRxNPduRef=Demo_0_CAN_FD_Request_Tp_oDemoFBL_Vector_SLP3_9e917504_Rx
            CanTpTxFcNPdu_e980d874 (CanTpTxFcNPdu): CanTpTxFcNPduRef=Demo_0_CAN_FD_Response_Tp_oDemoFBL_Vector_SLP3_126039d0_Tx
          CanTpTxNSdu_f05a2e85 (CanTpTxNSdu):
            CanTpTxAddressingFormat = CANTP_STANDARD
            CanTpTxDl = 64
            CanTpTxTaType = CANTP_CANFD_PHYSICAL
            CanTpTxNSduRef = EcucPduCollection/Demo_0_CAN_FD_Response_oDemoFBL_Vector_SLP3_8fbef359_Tx
            CanTpRxFcNPdu_cb7a0c86 (CanTpRxFcNPdu): CanTpRxFcNPduRef=Demo_0_CAN_FD_Request_Tp_oDemoFBL_Vector_SLP3_9e917504_Rx
            CanTpTxNPdu_cb7a0c86 (CanTpTxNPdu): CanTpTxNPduRef=Demo_0_CAN_FD_Response_Tp_oDemoFBL_Vector_SLP3_126039d0_Tx
  module config ComM
    ComMConfigSet: ComMPncEnabled=false
      CN_DemoFBL_Vector_SLP3_abba4211 (ComMChannel): ComMBusType=COMM_BUS_TYPE_CAN, ComMChannelId=0
        ComMNetworkManagement
        CN_DemoFBL_Vector_SLP3_fc69dc3d (ComMUserPerChannel): ComMUserChannel=CN_DemoFBL_Vector_SLP3_ae3f277d
      CN_DemoFBL_Vector_SLP3_ae3f277d (ComMUser)
    ComMGeneral: ComMPncSupport=false
  module config Dcm
    DcmConfigSet
      DcmDsl
        DcmDslProtocol
          DcmDslProtocolRow_29812fbf (DcmDslProtocolRow)
            DcmDslConnection_64d54b0f (DcmDslConnection)
              DcmDslMainConnection_e6feb00f (DcmDslMainConnection)
                Demo_0_CAN_FD_Request_oDemoFBL_Vector_SLP3_20_797faa4e_Rx_26d06049 (DcmDslProtocolRx):
                  DcmDslProtocolRxAddrType = DCM_PHYSICAL_TYPE
                  DcmDslProtocolRxPduId = 1
                  DcmDslProtocolRxComMChannelRef = ComMConfigSet/CN_DemoFBL_Vector_SLP3_abba4211
                  DcmDslProtocolRxPduRef = Demo_0_CAN_FD_Request_oDemoFBL_Vector_SLP3_20_797faa4e_Rx
                Functional_CAN_FD_oDemoFBL_Vector_SLP3_20_57859879_Rx_0f27df12 (DcmDslProtocolRx):
                  DcmDslProtocolRxAddrType = DCM_FUNCTIONAL_TYPE
                  DcmDslProtocolRxPduId = 2
                  DcmDslProtocolRxComMChannelRef = ComMConfigSet/CN_DemoFBL_Vector_SLP3_abba4211
                  DcmDslProtocolRxPduRef = Functional_CAN_FD_oDemoFBL_Vector_SLP3_20_57859879_Rx
                Demo_0_CAN_FD_Response_oDemoFBL_Vector_SLP3_20_fac2fc54_Tx_7966a2bf (DcmDslProtocolTx): DcmDslTxConfirmationPduId=0, DcmDslProtocolTxPduRef=EcucPduCollection/Demo_0_CAN_FD_Response_oDemoFBL_Vector_SLP3_20_fac2fc54_Tx
            DcmDslConnection_bcbd2a82 (DcmDslConnection)
              DcmDslMainConnection_0a68bfea (DcmDslMainConnection)
                Demo_0_CAN_FD_Request_oDemoFBL_Vector_SLP3_67f6c3c9_Rx_2eeaac32 (DcmDslProtocolRx):
                  DcmDslProtocolRxAddrType = DCM_PHYSICAL_TYPE
                  DcmDslProtocolRxPduId = 4
                  DcmDslProtocolRxComMChannelRef = ComMConfigSet/CN_DemoFBL_Vector_SLP3_abba4211
                  DcmDslProtocolRxPduRef = Demo_0_CAN_FD_Request_oDemoFBL_Vector_SLP3_67f6c3c9_Rx
                Functional_CAN_FD_oDemoFBL_Vector_SLP3_3cffe9e9_Rx_56b3eb44 (DcmDslProtocolRx):
                  DcmDslProtocolRxAddrType = DCM_FUNCTIONAL_TYPE
                  DcmDslProtocolRxPduId = 5
                  DcmDslProtocolRxComMChannelRef = ComMConfigSet/CN_DemoFBL_Vector_SLP3_abba4211
                  DcmDslProtocolRxPduRef = Functional_CAN_FD_oDemoFBL_Vector_SLP3_3cffe9e9_Rx
                Demo_0_CAN_FD_Response_oDemoFBL_Vector_SLP3_01a35bfe_Tx_6ae15480 (DcmDslProtocolTx): DcmDslTxConfirmationPduId=3, DcmDslProtocolTxPduRef=EcucPduCollection/Demo_0_CAN_FD_Response_oDemoFBL_Vector_SLP3_01a35bfe_Tx
  module config EcuC
    EcucPduCollection: PduIdTypeEnum=UINT8, PduLengthTypeEnum=UINT8
      18 x Pdu:
        Demo_0_CAN_FD_Request_Tp_oDemoFBL_Vector_SLP3_20_f2ebe614_Rx: DynamicLength=false, PduLength=8, SysTPduToFrameMappingRef=Demo_0_CAN_FD_Request_Tp
        Demo_0_CAN_FD_Request_Tp_oDemoFBL_Vector_SLP3_9e917504_Rx: DynamicLength=false, PduLength=64, SysTPduToFrameMappingRef=Demo_0_CAN_FD_Request_Tp
        Demo_0_CAN_FD_Request_oDemoFBL_Vector_SLP3_20_797faa4e_Rx: DynamicLength=true, PduLength=8
        Demo_0_CAN_FD_Request_oDemoFBL_Vector_SLP3_20_dc7615a6_Rx: DynamicLength=true, PduLength=8
        Demo_0_CAN_FD_Request_oDemoFBL_Vector_SLP3_6635a675_Rx: DynamicLength=true, PduLength=64
        Demo_0_CAN_FD_Request_oDemoFBL_Vector_SLP3_67f6c3c9_Rx: DynamicLength=true, PduLength=64
        Demo_0_CAN_FD_Response_Tp_oDemoFBL_Vector_SLP3_126039d0_Tx: DynamicLength=false, PduLength=64, SysTPduToFrameMappingRef=Demo_0_CAN_FD_Response_Tp
        Demo_0_CAN_FD_Response_Tp_oDemoFBL_Vector_SLP3_20_ee1db9f7_Tx: DynamicLength=false, PduLength=8, SysTPduToFrameMappingRef=Demo_0_CAN_FD_Response_Tp
        Demo_0_CAN_FD_Response_oDemoFBL_Vector_SLP3_01a35bfe_Tx: DynamicLength=true, PduLength=64
        Demo_0_CAN_FD_Response_oDemoFBL_Vector_SLP3_20_50875972_Tx: DynamicLength=true, PduLength=8
        Demo_0_CAN_FD_Response_oDemoFBL_Vector_SLP3_20_fac2fc54_Tx: DynamicLength=true, PduLength=8
        Demo_0_CAN_FD_Response_oDemoFBL_Vector_SLP3_8fbef359_Tx: DynamicLength=true, PduLength=64
        Functional_CAN_FD_Tp_oDemoFBL_Vector_SLP3_20_883488d5_Rx: DynamicLength=false, PduLength=8, SysTPduToFrameMappingRef=Functional_CAN_FD_Tp
        Functional_CAN_FD_Tp_oDemoFBL_Vector_SLP3_36e4c388_Rx: DynamicLength=false, PduLength=64, SysTPduToFrameMappingRef=Functional_CAN_FD_Tp
        Functional_CAN_FD_oDemoFBL_Vector_SLP3_20_57859879_Rx: DynamicLength=true, PduLength=7
        Functional_CAN_FD_oDemoFBL_Vector_SLP3_20_7403a32a_Rx: DynamicLength=true, PduLength=7
        Functional_CAN_FD_oDemoFBL_Vector_SLP3_3cffe9e9_Rx: DynamicLength=true, PduLength=62
        Functional_CAN_FD_oDemoFBL_Vector_SLP3_ed563a98_Rx: DynamicLength=true, PduLength=62
  module config EcuM
    EcuMConfiguration
      EcuMCommonConfiguration
        EcuMDriverInitListOne
        EcuMDriverRestartList
        CN_DemoFBL_Vector_SLP3_abba4211 (EcuMWakeupSource): EcuMWakeupSourceId=5, EcuMComMChannelRef=ComMConfigSet/CN_DemoFBL_Vector_SLP3_abba4211
      EcuMFlexConfiguration: EcuMFlexModuleConfigurationRef=CanConfigSet
  module config PduR
    PduRGeneral
    PduRRoutingTables
      PduRRoutingTable
        6 x PduRRoutingPath:
          Demo_0_CAN_FD_Request_oDemoFBL_Vector_SLP3_20_dc7615a6_Rx
            Demo_0_CAN_FD_Request_oDemoFBL_Vector_SLP3_20_dc7615a6_Rx_5b048e34_Rx (PduRDestPdu): PduRDestPduRef=Demo_0_CAN_FD_Request_oDemoFBL_Vector_SLP3_20_797faa4e_Rx
            PduRSrcPdu_5b048e34 (PduRSrcPdu): PduRSrcPduRef=EcucPduCollection/Demo_0_CAN_FD_Request_oDemoFBL_Vector_SLP3_20_dc7615a6_Rx
          Demo_0_CAN_FD_Request_oDemoFBL_Vector_SLP3_6635a675_Rx
            Demo_0_CAN_FD_Request_oDemoFBL_Vector_SLP3_6635a675_Rx_425f3fdc_Rx (PduRDestPdu): PduRDestPduRef=Demo_0_CAN_FD_Request_oDemoFBL_Vector_SLP3_67f6c3c9_Rx
            PduRSrcPdu_425f3fdc (PduRSrcPdu): PduRSrcPduRef=EcucPduCollection/Demo_0_CAN_FD_Request_oDemoFBL_Vector_SLP3_6635a675_Rx
          Demo_0_CAN_FD_Response_oDemoFBL_Vector_SLP3_01a35bfe_Tx
            Demo_0_CAN_FD_Response_oDemoFBL_Vector_SLP3_8fbef359_Tx (PduRDestPdu): PduRDestPduRef=EcucPduCollection/Demo_0_CAN_FD_Response_oDemoFBL_Vector_SLP3_8fbef359_Tx
            PduRSrcPdu_c8f30f5f (PduRSrcPdu): PduRSrcPduRef=EcucPduCollection/Demo_0_CAN_FD_Response_oDemoFBL_Vector_SLP3_01a35bfe_Tx
          Demo_0_CAN_FD_Response_oDemoFBL_Vector_SLP3_20_fac2fc54_Tx
            Demo_0_CAN_FD_Response_oDemoFBL_Vector_SLP3_20_50875972_Tx (PduRDestPdu): PduRDestPduRef=EcucPduCollection/Demo_0_CAN_FD_Response_oDemoFBL_Vector_SLP3_20_50875972_Tx
            PduRSrcPdu_554525c7 (PduRSrcPdu): PduRSrcPduRef=EcucPduCollection/Demo_0_CAN_FD_Response_oDemoFBL_Vector_SLP3_20_fac2fc54_Tx
          Functional_CAN_FD_oDemoFBL_Vector_SLP3_20_7403a32a_Rx
            Functional_CAN_FD_oDemoFBL_Vector_SLP3_20_7403a32a_Rx_3d6136a3_Rx (PduRDestPdu): PduRDestPduRef=Functional_CAN_FD_oDemoFBL_Vector_SLP3_20_57859879_Rx
            PduRSrcPdu_3d6136a3 (PduRSrcPdu): PduRSrcPduRef=EcucPduCollection/Functional_CAN_FD_oDemoFBL_Vector_SLP3_20_7403a32a_Rx
          Functional_CAN_FD_oDemoFBL_Vector_SLP3_ed563a98_Rx
            Functional_CAN_FD_oDemoFBL_Vector_SLP3_ed563a98_Rx_1cf8eade_Rx (PduRDestPdu): PduRDestPduRef=Functional_CAN_FD_oDemoFBL_Vector_SLP3_3cffe9e9_Rx
            PduRSrcPdu_1cf8eade (PduRSrcPdu): PduRSrcPduRef=EcucPduCollection/Functional_CAN_FD_oDemoFBL_Vector_SLP3_ed563a98_Rx
