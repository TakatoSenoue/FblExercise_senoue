AUTOSAR XML (schema 00049)
package /ActiveEcuC
  module config FblMio: implementation-config-variant=VARIANT-LINK-TIME, module-description=FblMio_Impl
    FblMioGeneral:
      FblMioInitHandling = ALL_DRIVERS_MANDATORY
      FblMioBlankCheckBeforeRead = false
      FblMioUserMainFunction = false
      FblMioUserInitFunction = false
      FblMioCompareAfterWrite = false
      FblMioUseCase = USECASE_HIS_ONLY
      FblMioBlankCheckApi = false
      FblMioFlashBlockCaching = true
      FblMioMemInfoCaching = true
