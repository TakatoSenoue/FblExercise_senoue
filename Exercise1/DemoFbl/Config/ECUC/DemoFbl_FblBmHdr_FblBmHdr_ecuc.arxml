AUTOSAR XML (schema 00049)
package /ActiveEcuC
  module config FblBmHdr: implementation-config-variant=VARIANT-PRE-COMPILE, module-description=FblBmHdr_Impl
    FblBmHdrHeader: FblBmHdrBlockStartAddress=65536, FblBmHdrBlockLength=262144, FblBmHdrEntryAddress=Brs_ApplicationEntry, FblBmHdrTargetRef=Fbl
      FblBmHdrVariant
        FblBmHdrAuthenticationHeader: FblBmHdrAuthenticationHeaderAddress=0x0004F400
    4 x FblBmHdrTarget:
      Appl: FblBmHdrTargetId=2
      Data: FblBmHdrTargetId=3
      Fbl: FblBmHdrTargetId=0
      FblUpdater: FblBmHdrTargetId=1
    FblBmHdrGeneral: FblBmHdrMaxVerificationEntries=1, FblBmHdrSbVerificationList=false, FblBmHdrAllowTargetsWithoutMacOperation=false
