AUTOSAR XML (schema 00049)
package /ActiveEcuC
  module config Crypto: implementation-config-variant=VARIANT-PRE-COMPILE, module-description=Crypto_Impl
    CryptoKeyElements
      135 x CryptoKeyElement, all with CryptoKeyElementPersist=false, CryptoKeyElementFormat=CRYPTO_KE_FORMAT_BIN_OCTET, CryptoKeyElementWriteOnce=false:
        Crypto_30_LibCv_Signature_Key: CryptoKeyElementSize=32, CryptoKeyElementId=1, CryptoKeyElementReadAccess=RA_ALLOWED, CryptoKeyElementAllowPartialAccess=false, CryptoKeyElementWriteAccess=WA_ALLOWED
        Crypto_30_LibCv_Random_Seed: CryptoKeyElementSize=20, CryptoKeyElementId=3, CryptoKeyElementReadAccess=RA_ALLOWED, CryptoKeyElementAllowPartialAccess=false, CryptoKeyElementWriteAccess=WA_ALLOWED
        Crypto_30_LibCv_KeyGenerate_Seed: CryptoKeyElementSize=16, CryptoKeyElementId=16, CryptoKeyElementReadAccess=RA_ALLOWED, CryptoKeyElementAllowPartialAccess=false, CryptoKeyElementWriteAccess=WA_ALLOWED
        Crypto_30_LibCv_KeyGenerate_Key: CryptoKeyElementSize=16, CryptoKeyElementId=1, CryptoKeyElementReadAccess=RA_ALLOWED, CryptoKeyElementAllowPartialAccess=false, CryptoKeyElementWriteAccess=WA_ALLOWED
        Crypto_30_LibCv_KeyExchange_SharedValue: CryptoKeyElementSize=32, CryptoKeyElementId=1, CryptoKeyElementReadAccess=RA_ALLOWED, CryptoKeyElementAllowPartialAccess=false, CryptoKeyElementWriteAccess=WA_ALLOWED
        Crypto_30_LibCv_KeyExchange_PrivKey: CryptoKeyElementSize=32, CryptoKeyElementId=9, CryptoKeyElementReadAccess=RA_ALLOWED, CryptoKeyElementAllowPartialAccess=false, CryptoKeyElementWriteAccess=WA_ALLOWED
        Crypto_30_LibCv_Mac_Proof: CryptoKeyElementSize=48, CryptoKeyElementId=2, CryptoKeyElementReadAccess=RA_ALLOWED, CryptoKeyElementAllowPartialAccess=false, CryptoKeyElementWriteAccess=WA_ALLOWED
        Crypto_30_LibCv_KeyDerivation_Salt: CryptoKeyElementSize=16, CryptoKeyElementId=13, CryptoKeyElementReadAccess=RA_ALLOWED, CryptoKeyElementAllowPartialAccess=false, CryptoKeyElementWriteAccess=WA_ALLOWED
        Crypto_30_LibCv_KeyExchange_OwnPubKey: CryptoKeyElementSize=32, CryptoKeyElementReadAccess=RA_ALLOWED, CryptoKeyElementId=10, CryptoKeyElementAllowPartialAccess=false, CryptoKeyElementWriteAccess=WA_ALLOWED
        Crypto_30_LibCv_KeyExchange_Base: CryptoKeyElementSize=16, CryptoKeyElementId=8, CryptoKeyElementReadAccess=RA_ALLOWED, CryptoKeyElementAllowPartialAccess=false, CryptoKeyElementWriteAccess=WA_ALLOWED
        Crypto_30_LibCv_KeyDerivation_Password: CryptoKeyElementSize=64, CryptoKeyElementAllowPartialAccess=true, CryptoKeyElementId=1, CryptoKeyElementReadAccess=RA_ALLOWED, CryptoKeyElementWriteAccess=WA_ALLOWED
        Crypto_30_LibCv_Cipher_Key: CryptoKeyElementSize=16, CryptoKeyElementId=1, CryptoKeyElementReadAccess=RA_ALLOWED, CryptoKeyElementAllowPartialAccess=false, CryptoKeyElementWriteAccess=WA_ALLOWED
        Crypto_30_LibCv_Cipher_IV: CryptoKeyElementSize=16, CryptoKeyElementId=5, CryptoKeyElementReadAccess=RA_ALLOWED, CryptoKeyElementAllowPartialAccess=false, CryptoKeyElementWriteAccess=WA_ALLOWED
        Crypto_30_LibCv_Cipher_Proof: CryptoKeyElementSize=48, CryptoKeyElementId=6, CryptoKeyElementReadAccess=RA_ALLOWED, CryptoKeyElementAllowPartialAccess=false, CryptoKeyElementWriteAccess=WA_ALLOWED
        Crypto_30_LibCv_Mac_Key: CryptoKeyElementSize=16, CryptoKeyElementId=1, CryptoKeyElementReadAccess=RA_ALLOWED, CryptoKeyElementAllowPartialAccess=false, CryptoKeyElementWriteAccess=WA_ALLOWED
        Crypto_30_LibCv_Hash_Result: CryptoKeyElementSize=20, CryptoKeyElementId=1, CryptoKeyElementReadAccess=RA_ALLOWED, CryptoKeyElementAllowPartialAccess=false, CryptoKeyElementWriteAccess=WA_ALLOWED
        Crypto_30_LibCv_KeyDerive_Algorithm: CryptoKeyElementId=15, CryptoKeyElementInitValue=0x00, CryptoKeyElementSize=1, CryptoKeyElementReadAccess=RA_ALLOWED, CryptoKeyElementAllowPartialAccess=false, CryptoKeyElementWriteAccess=WA_ALLOWED
        Crypto_30_LibCv_KeyGenerate_Algorithm: CryptoKeyElementId=17, CryptoKeyElementInitValue=0x00, CryptoKeyElementSize=1, CryptoKeyElementReadAccess=RA_ALLOWED, CryptoKeyElementAllowPartialAccess=false, CryptoKeyElementWriteAccess=WA_ALLOWED
        Crypto_30_LibCv_KeyExchange_Algorithm_X25519: CryptoKeyElementId=12, CryptoKeyElementInitValue=0x00, CryptoKeyElementSize=1, CryptoKeyElementReadAccess=RA_ALLOWED, CryptoKeyElementAllowPartialAccess=false, CryptoKeyElementWriteAccess=WA_ALLOWED
        Crypto_30_LibCv_Random_Algorithm_Fips186_Sha1: CryptoKeyElementId=4, CryptoKeyElementInitValue=0x00, CryptoKeyElementSize=1, CryptoKeyElementReadAccess=RA_ALLOWED, CryptoKeyElementAllowPartialAccess=false, CryptoKeyElementWriteAccess=WA_ALLOWED
        Crypto_30_LibCv_Rsa_Modulus: CryptoKeyElementSize=256, CryptoKeyElementId=160, CryptoKeyElementReadAccess=RA_ALLOWED, CryptoKeyElementAllowPartialAccess=false, CryptoKeyElementWriteAccess=WA_ALLOWED
        Crypto_30_LibCv_Rsa_Pub_Exponent: CryptoKeyElementSize=3, CryptoKeyElementId=161, CryptoKeyElementReadAccess=RA_ALLOWED, CryptoKeyElementAllowPartialAccess=false, CryptoKeyElementWriteAccess=WA_ALLOWED
        Crypto_30_LibCv_Rsa_Priv_Exponent: CryptoKeyElementSize=256, CryptoKeyElementId=162, CryptoKeyElementReadAccess=RA_ALLOWED, CryptoKeyElementAllowPartialAccess=false, CryptoKeyElementWriteAccess=WA_ALLOWED
        Crypto_30_LibCv_Rsa_Salt: CryptoKeyElementSize=32, CryptoKeyElementId=163, CryptoKeyElementReadAccess=RA_ALLOWED, CryptoKeyElementAllowPartialAccess=false, CryptoKeyElementWriteAccess=WA_ALLOWED
        Crypto_30_LibCv_Rsa_SaltLength: CryptoKeyElementId=164, CryptoKeyElementSize=2, CryptoKeyElementReadAccess=RA_ALLOWED, CryptoKeyElementAllowPartialAccess=false, CryptoKeyElementWriteAccess=WA_ALLOWED
        Crypto_30_LibCv_KeyExchange_Algorithm_ANSIP256R1: CryptoKeyElementId=12, CryptoKeyElementInitValue=0x01, CryptoKeyElementSize=1, CryptoKeyElementReadAccess=RA_ALLOWED, CryptoKeyElementAllowPartialAccess=false, CryptoKeyElementWriteAccess=WA_ALLOWED
        Crypto_30_LibCv_KeyExchange_PartnerPubKey: CryptoKeyElementSize=132, CryptoKeyElementAllowPartialAccess=true, CryptoKeyElementId=3003, CryptoKeyElementReadAccess=RA_ALLOWED, CryptoKeyElementWriteAccess=WA_ALLOWED
        Crypto_30_LibCv_KeyDerivation_Algorithm_NIST80056A: CryptoKeyElementId=15, CryptoKeyElementInitValue=0x03, CryptoKeyElementSize=1, CryptoKeyElementReadAccess=RA_ALLOWED, CryptoKeyElementAllowPartialAccess=false, CryptoKeyElementWriteAccess=WA_ALLOWED
        Crypto_30_LibCv_KeyDerivation_Algorithm_ISO15118: CryptoKeyElementId=15, CryptoKeyElementInitValue=0x04, CryptoKeyElementSize=1, CryptoKeyElementReadAccess=RA_ALLOWED, CryptoKeyElementAllowPartialAccess=false, CryptoKeyElementWriteAccess=WA_ALLOWED
        Crypto_30_LibCv_KeyDerivation_Algorithm_SYM_NIST800108: CryptoKeyElementId=15, CryptoKeyElementInitValue=0x01, CryptoKeyElementSize=1, CryptoKeyElementReadAccess=RA_ALLOWED, CryptoKeyElementAllowPartialAccess=false, CryptoKeyElementWriteAccess=WA_ALLOWED
        Crypto_30_LibCv_KeyDerivation_Algorithm_ASM_NISTFIPS1864: CryptoKeyElementId=15, CryptoKeyElementInitValue=0x02, CryptoKeyElementSize=1, CryptoKeyElementReadAccess=RA_ALLOWED, CryptoKeyElementAllowPartialAccess=false, CryptoKeyElementWriteAccess=WA_ALLOWED
        Crypto_30_LibCv_KeyDerivation_AdditionalInfo: CryptoKeyElementSize=5, CryptoKeyElementId=131, CryptoKeyElementReadAccess=RA_ALLOWED, CryptoKeyElementAllowPartialAccess=false, CryptoKeyElementWriteAccess=WA_ALLOWED
        Crypto_30_LibCv_SCC_Contract_PubKey: CryptoKeyElementSize=132, CryptoKeyElementAllowPartialAccess=true, CryptoKeyElementId=3013, CryptoKeyElementReadAccess=RA_ALLOWED, CryptoKeyElementWriteAccess=WA_ALLOWED
        Crypto_30_LibCv_SCC_IV_And_Encrypted_PrivKey: CryptoKeyElementSize=128, CryptoKeyElementAllowPartialAccess=true, CryptoKeyElementId=3014, CryptoKeyElementReadAccess=RA_ALLOWED, CryptoKeyElementWriteAccess=WA_ALLOWED
        Crypto_30_LibCv_Random_Algorithm: CryptoKeyElementId=4, CryptoKeyElementSize=1, CryptoKeyElementReadAccess=RA_ALLOWED, CryptoKeyElementAllowPartialAccess=false, CryptoKeyElementWriteAccess=WA_ALLOWED
        Crypto_30_LibCv_Random_Algorithm_Nist_800_90A_DRBG_AES128: CryptoKeyElementId=4, CryptoKeyElementSize=1, CryptoKeyElementInitValue=0x01, CryptoKeyElementReadAccess=RA_ALLOWED, CryptoKeyElementAllowPartialAccess=false, CryptoKeyElementWriteAccess=WA_ALLOWED
        Crypto_30_LibCv_Random_AdditionalInput: CryptoKeyElementSize=32, CryptoKeyElementId=3016, CryptoKeyElementReadAccess=RA_ALLOWED, CryptoKeyElementAllowPartialAccess=false, CryptoKeyElementWriteAccess=WA_ALLOWED
        Crypto_30_LibCv_Random_Nonce: CryptoKeyElementId=3017, CryptoKeyElementSize=16, CryptoKeyElementReadAccess=RA_ALLOWED, CryptoKeyElementAllowPartialAccess=false, CryptoKeyElementWriteAccess=WA_ALLOWED
        Crypto_30_LibCv_Random_PrivateString: CryptoKeyElementId=3015, CryptoKeyElementSize=16, CryptoKeyElementReadAccess=RA_ALLOWED, CryptoKeyElementAllowPartialAccess=false, CryptoKeyElementWriteAccess=WA_ALLOWED
        Crypto_30_LibCv_Random_Reseed_Counter: CryptoKeyElementId=3018, CryptoKeyElementWriteAccess=WA_DENIED, CryptoKeyElementAllowPartialAccess=false, CryptoKeyElementSize=4, CryptoKeyElementInitValue=0 0 0 1, CryptoKeyElementReadAccess=RA_ALLOWED
        Crypto_30_LibCv_Rsa_PrimeP: CryptoKeyElementId=3051, CryptoKeyElementSize=16, CryptoKeyElementReadAccess=RA_ALLOWED, CryptoKeyElementAllowPartialAccess=false, CryptoKeyElementWriteAccess=WA_ALLOWED
        Crypto_30_LibCv_Rsa_PrimeQ: CryptoKeyElementId=3052, CryptoKeyElementSize=16, CryptoKeyElementReadAccess=RA_ALLOWED, CryptoKeyElementAllowPartialAccess=false, CryptoKeyElementWriteAccess=WA_ALLOWED
        Crypto_30_LibCv_Rsa_ExponentDp: CryptoKeyElementId=3053, CryptoKeyElementSize=16, CryptoKeyElementReadAccess=RA_ALLOWED, CryptoKeyElementAllowPartialAccess=false, CryptoKeyElementWriteAccess=WA_ALLOWED
        Crypto_30_LibCv_Rsa_ExponentDq: CryptoKeyElementId=3054, CryptoKeyElementSize=16, CryptoKeyElementReadAccess=RA_ALLOWED, CryptoKeyElementAllowPartialAccess=false, CryptoKeyElementWriteAccess=WA_ALLOWED
        Crypto_30_LibCv_Rsa_InverseQi: CryptoKeyElementId=3055, CryptoKeyElementSize=16, CryptoKeyElementReadAccess=RA_ALLOWED, CryptoKeyElementAllowPartialAccess=false, CryptoKeyElementWriteAccess=WA_ALLOWED
        Crypto_30_LibCv_KeyExchange_Algorithm_SECP256R1: CryptoKeyElementId=12, CryptoKeyElementInitValue=0x02, CryptoKeyElementSize=1, CryptoKeyElementReadAccess=RA_ALLOWED, CryptoKeyElementAllowPartialAccess=false, CryptoKeyElementWriteAccess=WA_ALLOWED
        Crypto_30_LibCv_Random_Seed_Nist_800_90A_DRBG_AES128: CryptoKeyElementId=3, CryptoKeyElementAllowPartialAccess=false, CryptoKeyElementReadAccess=RA_DENIED, CryptoKeyElementSize=32, CryptoKeyElementWriteAccess=WA_ALLOWED
        Crypto_30_LibCv_Mac_Key_She: CryptoKeyElementReadAccess=RA_ENCRYPTED, CryptoKeyElementId=1, CryptoKeyElementWriteAccess=WA_ENCRYPTED, CryptoKeyElementSize=16, CryptoKeyElementAllowPartialAccess=false
        Crypto_30_LibCv_Cipher_Key_She: CryptoKeyElementReadAccess=RA_ENCRYPTED, CryptoKeyElementId=1, CryptoKeyElementWriteAccess=WA_ENCRYPTED, CryptoKeyElementSize=16, CryptoKeyElementAllowPartialAccess=false
        Crypto_30_LibCv_She_UId: CryptoKeyElementSize=15, CryptoKeyElementId=3021, CryptoKeyElementReadAccess=RA_ALLOWED, CryptoKeyElementAllowPartialAccess=false, CryptoKeyElementWriteAccess=WA_ALLOWED
        Crypto_30_LibCv_She_Counter: CryptoKeyElementInitValue=0 0 0 0, CryptoKeyElementId=3019, CryptoKeyElementSize=4, CryptoKeyElementWriteAccess=WA_DENIED, CryptoKeyElementReadAccess=RA_ALLOWED, CryptoKeyElementAllowPartialAccess=false
        Crypto_30_LibCv_She_BootProtection: CryptoKeyElementInitValue=0, CryptoKeyElementId=3056, CryptoKeyElementSize=1, CryptoKeyElementReadAccess=RA_ALLOWED, CryptoKeyElementAllowPartialAccess=false, CryptoKeyElementWriteAccess=WA_ALLOWED
        Crypto_30_LibCv_She_DebuggerProtection: CryptoKeyElementInitValue=0, CryptoKeyElementId=3057, CryptoKeyElementSize=1, CryptoKeyElementReadAccess=RA_ALLOWED, CryptoKeyElementAllowPartialAccess=false, CryptoKeyElementWriteAccess=WA_ALLOWED
        Crypto_30_LibCv_SCC_Contract_AAD: CryptoKeyElementSize=34, CryptoKeyElementAllowPartialAccess=true, CryptoKeyElementId=3060, CryptoKeyElementReadAccess=RA_ALLOWED, CryptoKeyElementWriteAccess=WA_ALLOWED
        Crypto_30_LibCv_KeyDerivation_Label: CryptoKeyElementSize=4, CryptoKeyElementId=130, CryptoKeyElementReadAccess=RA_ALLOWED, CryptoKeyElementAllowPartialAccess=false, CryptoKeyElementWriteAccess=WA_ALLOWED
        Crypto_30_LibCv_Fbl_Decrypt_Aes128_Key: CryptoKeyElementId=1, CryptoKeyElementSize=16, CryptoKeyElementReadAccess=RA_ALLOWED, CryptoKeyElementAllowPartialAccess=false, CryptoKeyElementWriteAccess=WA_ALLOWED
        Crypto_30_LibCv_Fbl_Signature_ClassC: CryptoKeyElementId=1, CryptoKeyElementSize=16, CryptoKeyElementReadAccess=RA_ALLOWED, CryptoKeyElementAllowPartialAccess=false, CryptoKeyElementWriteAccess=WA_ALLOWED
        Crypto_30_LibCv_Fbl_Signature_Ed25519: CryptoKeyElementId=1, CryptoKeyElementSize=32, CryptoKeyElementReadAccess=RA_ALLOWED, CryptoKeyElementAllowPartialAccess=false, CryptoKeyElementWriteAccess=WA_ALLOWED
        Crypto_30_LibCv_Fbl_Signature_Rsa1024_Exp: CryptoKeyElementId=161, CryptoKeyElementSize=4, CryptoKeyElementReadAccess=RA_ALLOWED, CryptoKeyElementAllowPartialAccess=false, CryptoKeyElementWriteAccess=WA_ALLOWED
        Crypto_30_LibCv_Fbl_Signature_Rsa1024_Mod: CryptoKeyElementId=160, CryptoKeyElementSize=128, CryptoKeyElementReadAccess=RA_ALLOWED, CryptoKeyElementAllowPartialAccess=false, CryptoKeyElementWriteAccess=WA_ALLOWED
        Crypto_30_LibCv_Fbl_Signature_Rsa2048_Exp: CryptoKeyElementId=161, CryptoKeyElementSize=4, CryptoKeyElementReadAccess=RA_ALLOWED, CryptoKeyElementAllowPartialAccess=false, CryptoKeyElementWriteAccess=WA_ALLOWED
        Crypto_30_LibCv_Fbl_Signature_Rsa2048_Mod: CryptoKeyElementId=160, CryptoKeyElementSize=256, CryptoKeyElementReadAccess=RA_ALLOWED, CryptoKeyElementAllowPartialAccess=false, CryptoKeyElementWriteAccess=WA_ALLOWED
        Crypto_30_LibCv_Fbl_Signature_Rsa3072_Exp: CryptoKeyElementId=161, CryptoKeyElementSize=4, CryptoKeyElementReadAccess=RA_ALLOWED, CryptoKeyElementAllowPartialAccess=false, CryptoKeyElementWriteAccess=WA_ALLOWED
        Crypto_30_LibCv_Fbl_Signature_Rsa3072_Mod: CryptoKeyElementId=160, CryptoKeyElementSize=384, CryptoKeyElementReadAccess=RA_ALLOWED, CryptoKeyElementAllowPartialAccess=false, CryptoKeyElementWriteAccess=WA_ALLOWED
        Crypto_30_LibCv_Fbl_Decrypt_Aes128_IV: CryptoKeyElementId=5, CryptoKeyElementSize=16, CryptoKeyElementReadAccess=RA_ALLOWED, CryptoKeyElementAllowPartialAccess=false, CryptoKeyElementWriteAccess=WA_ALLOWED
        Crypto_30_LibCv_Label: CryptoKeyElementId=3058, CryptoKeyElementSize=16, CryptoKeyElementReadAccess=RA_ALLOWED, CryptoKeyElementAllowPartialAccess=false, CryptoKeyElementWriteAccess=WA_ALLOWED
        Crypto_30_LibCv_KeyExchange_Algorithm_SECP384R1: CryptoKeyElementId=12, CryptoKeyElementInitValue=0x04, CryptoKeyElementSize=1, CryptoKeyElementReadAccess=RA_ALLOWED, CryptoKeyElementAllowPartialAccess=false, CryptoKeyElementWriteAccess=WA_ALLOWED
        Crypto_30_LibCv_KeyDerivation_Algorithm_KDF_X963_SHA256: CryptoKeyElementId=15, CryptoKeyElementInitValue=0x06, CryptoKeyElementSize=1, CryptoKeyElementReadAccess=RA_ALLOWED, CryptoKeyElementAllowPartialAccess=false, CryptoKeyElementWriteAccess=WA_ALLOWED
        Crypto_30_LibCv_Mac_Key_She_Ram: CryptoKeyElementId=1, CryptoKeyElementWriteAccess=WA_ALLOWED, CryptoKeyElementSize=16, CryptoKeyElementReadAccess=RA_ENCRYPTED, CryptoKeyElementAllowPartialAccess=false
        Crypto_30_LibCv_Cipher_Key_She_Ram: CryptoKeyElementId=1, CryptoKeyElementWriteAccess=WA_ALLOWED, CryptoKeyElementSize=16, CryptoKeyElementReadAccess=RA_ENCRYPTED, CryptoKeyElementAllowPartialAccess=false
        Crypto_30_LibCv_Cipher_2NDKey: CryptoKeyElementId=7, CryptoKeyElementSize=16, CryptoKeyElementReadAccess=RA_ALLOWED, CryptoKeyElementAllowPartialAccess=false, CryptoKeyElementWriteAccess=WA_ALLOWED
        Crypto_30_LibCv_KeyGenerate_Algorithm_Symmetric_Generic: CryptoKeyElementId=17, CryptoKeyElementInitValue=0, CryptoKeyElementSize=1, CryptoKeyElementReadAccess=RA_ALLOWED, CryptoKeyElementAllowPartialAccess=false, CryptoKeyElementWriteAccess=WA_ALLOWED
        Crypto_30_LibCv_KeyGenerate_Algorithm_Ansi_Nist_Sec_P256R1: CryptoKeyElementId=17, CryptoKeyElementInitValue=1, CryptoKeyElementSize=1, CryptoKeyElementReadAccess=RA_ALLOWED, CryptoKeyElementAllowPartialAccess=false, CryptoKeyElementWriteAccess=WA_ALLOWED
        Crypto_30_LibCv_KeyGenerate_Algorithm_Nist_Sec_P384R1: CryptoKeyElementId=17, CryptoKeyElementInitValue=2, CryptoKeyElementSize=1, CryptoKeyElementReadAccess=RA_ALLOWED, CryptoKeyElementAllowPartialAccess=false, CryptoKeyElementWriteAccess=WA_ALLOWED
        Crypto_30_LibCv_KeyDerivation_Iterations_PBKDF2: CryptoKeyElementId=14, CryptoKeyElementSize=4, CryptoKeyElementReadAccess=RA_ALLOWED, CryptoKeyElementAllowPartialAccess=false, CryptoKeyElementWriteAccess=WA_ALLOWED
        Crypto_30_LibCv_KeyDerivation_Algorithm_PBKDF2_HMAC_SHA1: CryptoKeyElementId=15, CryptoKeyElementInitValue=0x09, CryptoKeyElementSize=1, CryptoKeyElementReadAccess=RA_ALLOWED, CryptoKeyElementAllowPartialAccess=false, CryptoKeyElementWriteAccess=WA_ALLOWED
        Crypto_30_LibCv_KeyDerivation_Algorithm_PBKDF2_HMAC_SHA256: CryptoKeyElementId=15, CryptoKeyElementInitValue=0x0A, CryptoKeyElementSize=1, CryptoKeyElementReadAccess=RA_ALLOWED, CryptoKeyElementAllowPartialAccess=false, CryptoKeyElementWriteAccess=WA_ALLOWED
        Crypto_30_LibCv_KeyDerivation_Algorithm_KDF_X963_SHA512: CryptoKeyElementId=15, CryptoKeyElementInitValue=0x07, CryptoKeyElementSize=1, CryptoKeyElementReadAccess=RA_ALLOWED, CryptoKeyElementAllowPartialAccess=false, CryptoKeyElementWriteAccess=WA_ALLOWED
        Crypto_30_LibCv_Aead_ChaCha_Key: CryptoKeyElementId=1, CryptoKeyElementSize=32, CryptoKeyElementReadAccess=RA_ALLOWED, CryptoKeyElementAllowPartialAccess=false, CryptoKeyElementWriteAccess=WA_ALLOWED
        Crypto_30_LibCv_Aead_ChaCha_Nonce: CryptoKeyElementId=5, CryptoKeyElementSize=12, CryptoKeyElementReadAccess=RA_ALLOWED, CryptoKeyElementAllowPartialAccess=false, CryptoKeyElementWriteAccess=WA_ALLOWED
        Crypto_30_LibCv_Random_Algorithm_Nist_800_90A_DRBG_AES128_DF: CryptoKeyElementId=4, CryptoKeyElementSize=1, CryptoKeyElementInitValue=2, CryptoKeyElementReadAccess=RA_ALLOWED, CryptoKeyElementAllowPartialAccess=false, CryptoKeyElementWriteAccess=WA_ALLOWED
        Crypto_30_LibCv_Random_Algorithm_Nist_800_90A_DRBG_HASH_SHA2_512: CryptoKeyElementId=4, CryptoKeyElementSize=1, CryptoKeyElementInitValue=3, CryptoKeyElementReadAccess=RA_ALLOWED, CryptoKeyElementAllowPartialAccess=false, CryptoKeyElementWriteAccess=WA_ALLOWED
        Crypto_30_LibCv_Random_Seed_Nist_800_90A_DRBG_HASH_SHA2_512: CryptoKeyElementId=3, CryptoKeyElementAllowPartialAccess=false, CryptoKeyElementReadAccess=RA_DENIED, CryptoKeyElementSize=222, CryptoKeyElementWriteAccess=WA_ALLOWED
        Crypto_30_LibCv_Random_Algorithm_Nist_800_90A_DRBG_AES256: CryptoKeyElementId=4, CryptoKeyElementSize=1, CryptoKeyElementInitValue=4, CryptoKeyElementReadAccess=RA_ALLOWED, CryptoKeyElementAllowPartialAccess=false, CryptoKeyElementWriteAccess=WA_ALLOWED
        Crypto_30_LibCv_Random_Algorithm_Nist_800_90A_DRBG_AES256Df: CryptoKeyElementId=4, CryptoKeyElementSize=1, CryptoKeyElementInitValue=5, CryptoKeyElementReadAccess=RA_ALLOWED, CryptoKeyElementAllowPartialAccess=false, CryptoKeyElementWriteAccess=WA_ALLOWED
        Crypto_30_LibCv_Random_Seed_Nist_800_90A_DRBG_AES256: CryptoKeyElementId=3, CryptoKeyElementAllowPartialAccess=false, CryptoKeyElementReadAccess=RA_DENIED, CryptoKeyElementSize=48, CryptoKeyElementWriteAccess=WA_ALLOWED
        Crypto_30_LibCv_KeyDerivation_Algorithm_HKDF_HMAC_SHA256: CryptoKeyElementId=15, CryptoKeyElementInitValue=0x0B, CryptoKeyElementSize=1, CryptoKeyElementReadAccess=RA_ALLOWED, CryptoKeyElementAllowPartialAccess=false, CryptoKeyElementWriteAccess=WA_ALLOWED
        Crypto_30_LibCv_KeyDerivation_Iterations_HKDF: CryptoKeyElementId=14, CryptoKeyElementSize=1, CryptoKeyElementReadAccess=RA_ALLOWED, CryptoKeyElementAllowPartialAccess=false, CryptoKeyElementWriteAccess=WA_ALLOWED
        Crypto_30_LibCv_KeyDerivation_Algorithm_Spake2Plus_P256R1: CryptoKeyElementId=15, CryptoKeyElementInitValue=0x0C, CryptoKeyElementSize=1, CryptoKeyElementReadAccess=RA_ALLOWED, CryptoKeyElementAllowPartialAccess=false, CryptoKeyElementWriteAccess=WA_ALLOWED
        Crypto_30_LibCv_KeyExchange_Algorithm_Spake2Plus_Suite8: CryptoKeyElementId=12, CryptoKeyElementSize=1, CryptoKeyElementInitValue=5, CryptoKeyElementReadAccess=RA_ALLOWED, CryptoKeyElementAllowPartialAccess=false, CryptoKeyElementWriteAccess=WA_ALLOWED
        Crypto_30_LibCv_KeyExchange_Algorithm_Spake2Plus_Suite8_1: CryptoKeyElementId=12, CryptoKeyElementSize=1, CryptoKeyElementInitValue=6, CryptoKeyElementReadAccess=RA_ALLOWED, CryptoKeyElementAllowPartialAccess=false, CryptoKeyElementWriteAccess=WA_ALLOWED
        Crypto_30_LibCv_W0: CryptoKeyElementId=3084, CryptoKeyElementSize=16, CryptoKeyElementReadAccess=RA_ALLOWED, CryptoKeyElementAllowPartialAccess=false, CryptoKeyElementWriteAccess=WA_ALLOWED
        Crypto_30_LibCv_W1: CryptoKeyElementId=3085, CryptoKeyElementSize=16, CryptoKeyElementReadAccess=RA_ALLOWED, CryptoKeyElementAllowPartialAccess=false, CryptoKeyElementWriteAccess=WA_ALLOWED
        Crypto_30_LibCv_L: CryptoKeyElementId=3086, CryptoKeyElementSize=16, CryptoKeyElementReadAccess=RA_ALLOWED, CryptoKeyElementAllowPartialAccess=false, CryptoKeyElementWriteAccess=WA_ALLOWED
        Crypto_30_LibCv_Verification_Result: CryptoKeyElementId=3088, CryptoKeyElementSize=1, CryptoKeyElementReadAccess=RA_ALLOWED, CryptoKeyElementAllowPartialAccess=false, CryptoKeyElementWriteAccess=WA_ALLOWED
        Crypto_30_LibCv_AdditionalInfo: CryptoKeyElementId=131, CryptoKeyElementSize=16, CryptoKeyElementReadAccess=RA_ALLOWED, CryptoKeyElementAllowPartialAccess=false, CryptoKeyElementWriteAccess=WA_ALLOWED
        Crypto_30_LibCv_Verification: CryptoKeyElementId=3087, CryptoKeyElementSize=16, CryptoKeyElementReadAccess=RA_ALLOWED, CryptoKeyElementAllowPartialAccess=false, CryptoKeyElementWriteAccess=WA_ALLOWED
        Crypto_30_LibCv_KeyGenerate_Algorithm_Ed25519: CryptoKeyElementId=17, CryptoKeyElementSize=1, CryptoKeyElementInitValue=3, CryptoKeyElementReadAccess=RA_ALLOWED, CryptoKeyElementAllowPartialAccess=false, CryptoKeyElementWriteAccess=WA_ALLOWED
        Crypto_30_LibCv_KeyExchange_PartnerPubKey_2: CryptoKeyElementId=3004, CryptoKeyElementSize=16, CryptoKeyElementReadAccess=RA_ALLOWED, CryptoKeyElementAllowPartialAccess=false, CryptoKeyElementWriteAccess=WA_ALLOWED
        Crypto_30_LibCv_KeyExchange_Algorithm_NISTP224R1_BD: CryptoKeyElementId=12, CryptoKeyElementInitValue=3, CryptoKeyElementSize=1, CryptoKeyElementReadAccess=RA_ALLOWED, CryptoKeyElementAllowPartialAccess=false, CryptoKeyElementWriteAccess=WA_ALLOWED
        Crypto_30_LibCv_KeyExchange_EcuId: CryptoKeyElementId=3007, CryptoKeyElementSize=1, CryptoKeyElementReadAccess=RA_ALLOWED, CryptoKeyElementAllowPartialAccess=false, CryptoKeyElementWriteAccess=WA_ALLOWED
        Crypto_30_LibCv_KeyExchange_NumEcu: CryptoKeyElementId=3006, CryptoKeyElementSize=1, CryptoKeyElementReadAccess=RA_ALLOWED, CryptoKeyElementAllowPartialAccess=false, CryptoKeyElementWriteAccess=WA_ALLOWED
        Crypto_30_LibCv_KeyExchange_Intermediate: CryptoKeyElementId=3005, CryptoKeyElementSize=16, CryptoKeyElementReadAccess=RA_ALLOWED, CryptoKeyElementAllowPartialAccess=false, CryptoKeyElementWriteAccess=WA_ALLOWED
        Crypto_30_LibCv_KeyDerivation_Algorithm_HKDF_Option1_SHA256: CryptoKeyElementId=15, CryptoKeyElementInitValue=0x0D, CryptoKeyElementSize=1, CryptoKeyElementReadAccess=RA_ALLOWED, CryptoKeyElementAllowPartialAccess=false, CryptoKeyElementWriteAccess=WA_ALLOWED
        Crypto_30_LibCv_KeyExchange_Algorithm_SECP521R1: CryptoKeyElementId=12, CryptoKeyElementInitValue=0x07, CryptoKeyElementSize=1, CryptoKeyElementReadAccess=RA_ALLOWED, CryptoKeyElementAllowPartialAccess=false, CryptoKeyElementWriteAccess=WA_ALLOWED
        Crypto_30_LibCv_KeyDerivation_Algorithm_HKDF_HMAC_SHA384: CryptoKeyElementId=15, CryptoKeyElementInitValue=0x0E, CryptoKeyElementSize=1, CryptoKeyElementReadAccess=RA_ALLOWED, CryptoKeyElementAllowPartialAccess=false, CryptoKeyElementWriteAccess=WA_ALLOWED
        Crypto_30_LibCv_KeyDerivation_Algorithm_HKDF_Option1_SHA512: CryptoKeyElementId=15, CryptoKeyElementInitValue=0x0F, CryptoKeyElementSize=1, CryptoKeyElementReadAccess=RA_ALLOWED, CryptoKeyElementAllowPartialAccess=false, CryptoKeyElementWriteAccess=WA_ALLOWED
        Crypto_30_LibCv_KeyDerivation_Algorithm_ISO15118_20: CryptoKeyElementId=15, CryptoKeyElementInitValue=0x10, CryptoKeyElementSize=1, CryptoKeyElementReadAccess=RA_ALLOWED, CryptoKeyElementAllowPartialAccess=false, CryptoKeyElementWriteAccess=WA_ALLOWED
        Crypto_30_LibCv_KeyExchange_Algorithm_X448: CryptoKeyElementId=12, CryptoKeyElementInitValue=0x08, CryptoKeyElementSize=1, CryptoKeyElementReadAccess=RA_ALLOWED, CryptoKeyElementAllowPartialAccess=false, CryptoKeyElementWriteAccess=WA_ALLOWED
        Crypto_30_LibCv_Signature_EcDsa_SECp160r1_public: CryptoKeyElementId=1, CryptoKeyElementSize=40, CryptoKeyElementReadAccess=RA_ALLOWED, CryptoKeyElementAllowPartialAccess=false, CryptoKeyElementWriteAccess=WA_ALLOWED
        Crypto_30_LibCv_Signature_EcDsa_SECp256r1_public: CryptoKeyElementId=1, CryptoKeyElementSize=64, CryptoKeyElementReadAccess=RA_ALLOWED, CryptoKeyElementAllowPartialAccess=false, CryptoKeyElementWriteAccess=WA_ALLOWED
        Crypto_30_LibCv_Signature_EcDsa_SECp384r1_public: CryptoKeyElementId=1, CryptoKeyElementSize=96, CryptoKeyElementReadAccess=RA_ALLOWED, CryptoKeyElementAllowPartialAccess=false, CryptoKeyElementWriteAccess=WA_ALLOWED
        Crypto_30_LibCv_Signature_EcDsa_SECp521r1_public: CryptoKeyElementId=1, CryptoKeyElementSize=132, CryptoKeyElementReadAccess=RA_ALLOWED, CryptoKeyElementAllowPartialAccess=false, CryptoKeyElementWriteAccess=WA_ALLOWED
        Crypto_30_LibCv_Signature_EdDsa_Ed25519_public: CryptoKeyElementId=1, CryptoKeyElementSize=32, CryptoKeyElementReadAccess=RA_ALLOWED, CryptoKeyElementAllowPartialAccess=false, CryptoKeyElementWriteAccess=WA_ALLOWED
        Crypto_30_LibCv_Signature_EcDsa_SECp160r1_private: CryptoKeyElementId=1, CryptoKeyElementSize=20, CryptoKeyElementReadAccess=RA_ALLOWED, CryptoKeyElementAllowPartialAccess=false, CryptoKeyElementWriteAccess=WA_ALLOWED
        Crypto_30_LibCv_Signature_EcDsa_SECp256r1_private: CryptoKeyElementId=1, CryptoKeyElementSize=32, CryptoKeyElementReadAccess=RA_ALLOWED, CryptoKeyElementAllowPartialAccess=false, CryptoKeyElementWriteAccess=WA_ALLOWED
        Crypto_30_LibCv_Signature_EcDsa_SECp384r1_private: CryptoKeyElementId=1, CryptoKeyElementSize=48, CryptoKeyElementReadAccess=RA_ALLOWED, CryptoKeyElementAllowPartialAccess=false, CryptoKeyElementWriteAccess=WA_ALLOWED
        Crypto_30_LibCv_Signature_EcDsa_SECp521r1_private: CryptoKeyElementId=1, CryptoKeyElementSize=66, CryptoKeyElementReadAccess=RA_ALLOWED, CryptoKeyElementAllowPartialAccess=false, CryptoKeyElementWriteAccess=WA_ALLOWED
        Crypto_30_LibCv_Signature_EdDsa_Ed25519_private: CryptoKeyElementId=1, CryptoKeyElementSize=32, CryptoKeyElementReadAccess=RA_ALLOWED, CryptoKeyElementAllowPartialAccess=false, CryptoKeyElementWriteAccess=WA_ALLOWED
        Crypto_30_LibCv_Signature_EdDsa_Ed448_public: CryptoKeyElementId=1, CryptoKeyElementSize=57, CryptoKeyElementReadAccess=RA_ALLOWED, CryptoKeyElementAllowPartialAccess=false, CryptoKeyElementWriteAccess=WA_ALLOWED
        Crypto_30_LibCv_Signature_EdDsa_Ed448_private: CryptoKeyElementId=1, CryptoKeyElementSize=57, CryptoKeyElementReadAccess=RA_ALLOWED, CryptoKeyElementAllowPartialAccess=false, CryptoKeyElementWriteAccess=WA_ALLOWED
        Crypto_30_LibCv_EdDsa_Context: CryptoKeyElementId=3061, CryptoKeyElementSize=16, CryptoKeyElementReadAccess=RA_ALLOWED, CryptoKeyElementAllowPartialAccess=false, CryptoKeyElementWriteAccess=WA_ALLOWED
        Crypto_30_LibCv_KeyExchange_Algorithm_P256R1_BD: CryptoKeyElementId=12, CryptoKeyElementInitValue=9, CryptoKeyElementSize=1, CryptoKeyElementReadAccess=RA_ALLOWED, CryptoKeyElementAllowPartialAccess=false, CryptoKeyElementWriteAccess=WA_ALLOWED
        Crypto_30_LibCv_KeyGenerate_Algorithm_Nist_Sec_P521R1: CryptoKeyElementId=17, CryptoKeyElementInitValue=4, CryptoKeyElementSize=1, CryptoKeyElementReadAccess=RA_ALLOWED, CryptoKeyElementAllowPartialAccess=false, CryptoKeyElementWriteAccess=WA_ALLOWED
        Crypto_30_LibCv_Signature_SlhDsaSha2_128s_public: CryptoKeyElementId=1, CryptoKeyElementSize=32, CryptoKeyElementReadAccess=RA_ALLOWED, CryptoKeyElementAllowPartialAccess=false, CryptoKeyElementWriteAccess=WA_ALLOWED
        Crypto_30_LibCv_Signature_Sm2_P256Sm2_private: CryptoKeyElementId=1, CryptoKeyElementSize=32, CryptoKeyElementReadAccess=RA_ALLOWED, CryptoKeyElementAllowPartialAccess=false, CryptoKeyElementWriteAccess=WA_ALLOWED
        Crypto_30_LibCv_Signature_Sm2Verify_P256Sm2_public: CryptoKeyElementId=1, CryptoKeyElementSize=64, CryptoKeyElementReadAccess=RA_ALLOWED, CryptoKeyElementAllowPartialAccess=false, CryptoKeyElementWriteAccess=WA_ALLOWED
        Crypto_30_LibCv_Signature_Sm2_ID: CryptoKeyElementId=3092, CryptoKeyElementSize=16, CryptoKeyElementReadAccess=RA_ALLOWED, CryptoKeyElementAllowPartialAccess=false, CryptoKeyElementWriteAccess=WA_ALLOWED
        Crypto_30_LibCv_Signature_Sm2Generate_P256Sm2_public: CryptoKeyElementId=3093, CryptoKeyElementSize=64, CryptoKeyElementReadAccess=RA_ALLOWED, CryptoKeyElementAllowPartialAccess=false, CryptoKeyElementWriteAccess=WA_ALLOWED
        Crypto_30_LibCv_KeyGenerate_Algorithm_Sm2P256v1: CryptoKeyElementId=17, CryptoKeyElementInitValue=5, CryptoKeyElementSize=1, CryptoKeyElementReadAccess=RA_ALLOWED, CryptoKeyElementAllowPartialAccess=false, CryptoKeyElementWriteAccess=WA_ALLOWED
        Crypto_30_LibCv_KeyDerivation_Algorithm_NIST800108_CTR_CMAC_AES: CryptoKeyElementId=15, CryptoKeyElementSize=1, CryptoKeyElementInitValue=8, CryptoKeyElementReadAccess=RA_ALLOWED, CryptoKeyElementAllowPartialAccess=false, CryptoKeyElementWriteAccess=WA_ALLOWED
        Crypto_30_LibCv_KeyDerivation_Context: CryptoKeyElementId=3061, CryptoKeyElementSize=16, CryptoKeyElementReadAccess=RA_ALLOWED, CryptoKeyElementAllowPartialAccess=false, CryptoKeyElementWriteAccess=WA_ALLOWED
        Crypto_30_LibCv_SlhDsa_Context: CryptoKeyElementId=3062, CryptoKeyElementSize=16, CryptoKeyElementReadAccess=RA_ALLOWED, CryptoKeyElementAllowPartialAccess=false, CryptoKeyElementWriteAccess=WA_ALLOWED
        Crypto_30_LibCv_KeyWrap_Aes_PlaintextKey: CryptoKeyElementId=1, CryptoKeyElementSize=16, CryptoKeyElementReadAccess=RA_ALLOWED, CryptoKeyElementAllowPartialAccess=false, CryptoKeyElementWriteAccess=WA_ALLOWED
        Crypto_30_LibCv_KeyWrap_Aes_Kek: CryptoKeyElementId=1, CryptoKeyElementSize=16, CryptoKeyElementReadAccess=RA_ALLOWED, CryptoKeyElementAllowPartialAccess=false, CryptoKeyElementWriteAccess=WA_ALLOWED
    CryptoKeyTypes
      101 x CryptoKeyType:
        CryptoKeyType_Fbl_Decrypt_Aes128: CryptoKeyElementRef=Crypto_30_LibCv_Fbl_Decrypt_Aes128_Key, CryptoKeyElementRef=Crypto_30_LibCv_Fbl_Decrypt_Aes128_IV
        CryptoKeyType_Fbl_Signature_ClassC: CryptoKeyElementRef=Crypto_30_LibCv_Fbl_Signature_ClassC
        CryptoKeyType_Fbl_Signature_Ed25519: CryptoKeyElementRef=Crypto_30_LibCv_Fbl_Signature_Ed25519
        CryptoKeyType_Fbl_Signature_Rsa1024: CryptoKeyElementRef=Crypto_30_LibCv_Fbl_Signature_Rsa1024_Exp, CryptoKeyElementRef=Crypto_30_LibCv_Fbl_Signature_Rsa1024_Mod
        CryptoKeyType_Fbl_Signature_Rsa2048: CryptoKeyElementRef=Crypto_30_LibCv_Fbl_Signature_Rsa2048_Exp, CryptoKeyElementRef=Crypto_30_LibCv_Fbl_Signature_Rsa2048_Mod
        CryptoKeyType_Fbl_Signature_Rsa3072: CryptoKeyElementRef=Crypto_30_LibCv_Fbl_Signature_Rsa3072_Mod, CryptoKeyElementRef=Crypto_30_LibCv_Fbl_Signature_Rsa3072_Exp
        Cipher: CryptoKeyElementRef=Crypto_30_LibCv_Cipher_Key, CryptoKeyElementRef=Crypto_30_LibCv_Cipher_IV
        KeyExchange_X25519: CryptoKeyElementRef=Crypto_30_LibCv_KeyExchange_Algorithm_X25519, CryptoKeyElementRef=Crypto_30_LibCv_KeyExchange_OwnPubKey, CryptoKeyElementRef=Crypto_30_LibCv_KeyExchange_PrivKey, CryptoKeyElementRef=Crypto_30_LibCv_KeyExchange_SharedValue
        KeyGenerate: CryptoKeyElementRef=Crypto_30_LibCv_KeyGenerate_Algorithm, CryptoKeyElementRef=Crypto_30_LibCv_KeyGenerate_Seed, CryptoKeyElementRef=Crypto_30_LibCv_KeyGenerate_Key
        Signature: CryptoKeyElementRef=Crypto_30_LibCv_Signature_Key
        Mac: CryptoKeyElementRef=Crypto_30_LibCv_Mac_Key
        KeyDerive: CryptoKeyElementRef=Crypto_30_LibCv_KeyDerivation_Password, CryptoKeyElementRef=Crypto_30_LibCv_KeyDerive_Algorithm, CryptoKeyElementRef=Crypto_30_LibCv_KeyDerivation_Salt, CryptoKeyElementRef=Crypto_30_LibCv_KeyDerivation_Label, CryptoKeyElementRef=Crypto_30_LibCv_KeyDerivation_Iterations_PBKDF2
        Random_Fips186_Sha1: CryptoKeyElementRef=Crypto_30_LibCv_Random_Algorithm_Fips186_Sha1, CryptoKeyElementRef=Crypto_30_LibCv_Random_Seed
        Hash: CryptoKeyElementRef=Crypto_30_LibCv_Hash_Result
        Signature_Rsa_Pkcs1_Verify: CryptoKeyElementRef=Crypto_30_LibCv_Rsa_Modulus, CryptoKeyElementRef=Crypto_30_LibCv_Rsa_Pub_Exponent
        Signature_Rsa_Pkcs1_Generate: CryptoKeyElementRef=Crypto_30_LibCv_Rsa_Modulus, CryptoKeyElementRef=Crypto_30_LibCv_Rsa_Priv_Exponent
        Signature_Rsa_Pss_Verify: CryptoKeyElementRef=Crypto_30_LibCv_Rsa_Modulus, CryptoKeyElementRef=Crypto_30_LibCv_Rsa_Pub_Exponent, CryptoKeyElementRef=Crypto_30_LibCv_Rsa_SaltLength
        Signature_Rsa_Pss_Generate: CryptoKeyElementRef=Crypto_30_LibCv_Rsa_Modulus, CryptoKeyElementRef=Crypto_30_LibCv_Rsa_Priv_Exponent, CryptoKeyElementRef=Crypto_30_LibCv_Rsa_Salt
        Signature_Rsa_Pss_Verify_AutoSalt: CryptoKeyElementRef=Crypto_30_LibCv_Rsa_Modulus, CryptoKeyElementRef=Crypto_30_LibCv_Rsa_Pub_Exponent
        KeyExchange_ANSIP256R1: CryptoKeyElementRef=Crypto_30_LibCv_KeyExchange_Algorithm_ANSIP256R1, CryptoKeyElementRef=Crypto_30_LibCv_KeyExchange_OwnPubKey, CryptoKeyElementRef=Crypto_30_LibCv_KeyExchange_PrivKey, CryptoKeyElementRef=Crypto_30_LibCv_KeyExchange_SharedValue
        KeyDerive_NIST80056A: CryptoKeyElementRef=Crypto_30_LibCv_KeyDerivation_Password, CryptoKeyElementRef=Crypto_30_LibCv_KeyDerivation_Algorithm_NIST80056A, CryptoKeyElementRef=Crypto_30_LibCv_KeyExchange_PartnerPubKey, CryptoKeyElementRef=Crypto_30_LibCv_KeyDerivation_AdditionalInfo
        KeyDerive_ISO15118_ProvCert: CryptoKeyElementRef=Crypto_30_LibCv_Signature_Key, CryptoKeyElementRef=Crypto_30_LibCv_KeyDerivation_Algorithm_ISO15118, CryptoKeyElementRef=Crypto_30_LibCv_KeyExchange_OwnPubKey, CryptoKeyElementRef=Crypto_30_LibCv_KeyExchange_PrivKey
        KeyDerive_SYM_NIST800108: CryptoKeyElementRef=Crypto_30_LibCv_KeyDerivation_Password, CryptoKeyElementRef=Crypto_30_LibCv_KeyDerivation_Algorithm_SYM_NIST800108, CryptoKeyElementRef=Crypto_30_LibCv_KeyDerivation_Salt, CryptoKeyElementRef=Crypto_30_LibCv_KeyDerivation_Label
        KeyDerive_ASM_NISTFIPS1864: CryptoKeyElementRef=Crypto_30_LibCv_KeyDerivation_Password, CryptoKeyElementRef=Crypto_30_LibCv_KeyDerivation_Algorithm_ASM_NISTFIPS1864, CryptoKeyElementRef=Crypto_30_LibCv_KeyDerivation_Salt, CryptoKeyElementRef=Crypto_30_LibCv_KeyDerivation_Label
        KeyDerive_ISO15118_ContrCert: CryptoKeyElementRef=Crypto_30_LibCv_Signature_Key, CryptoKeyElementRef=Crypto_30_LibCv_KeyDerivation_Algorithm_ISO15118, CryptoKeyElementRef=Crypto_30_LibCv_KeyExchange_PartnerPubKey, CryptoKeyElementRef=Crypto_30_LibCv_SCC_Contract_PubKey, CryptoKeyElementRef=Crypto_30_LibCv_SCC_IV_And_Encrypted_PrivKey
        CipherWithoutIv: CryptoKeyElementRef=Crypto_30_LibCv_Cipher_Key
        CipherShe: CryptoKeyElementRef=Crypto_30_LibCv_Cipher_Key_She, CryptoKeyElementRef=Crypto_30_LibCv_Cipher_IV, CryptoKeyElementRef=Crypto_30_LibCv_Cipher_Proof, CryptoKeyElementRef=Crypto_30_LibCv_She_Counter
        MacShe: CryptoKeyElementRef=Crypto_30_LibCv_Mac_Key_She, CryptoKeyElementRef=Crypto_30_LibCv_Mac_Proof, CryptoKeyElementRef=Crypto_30_LibCv_She_Counter
        Random_Nist_800_90A_DRBG_AES_DF: CryptoKeyElementRef=Crypto_30_LibCv_Random_Algorithm_Nist_800_90A_DRBG_AES128_DF, CryptoKeyElementRef=Crypto_30_LibCv_Random_Seed_Nist_800_90A_DRBG_AES128, CryptoKeyElementRef=Crypto_30_LibCv_Random_PrivateString, CryptoKeyElementRef=Crypto_30_LibCv_Random_AdditionalInput, CryptoKeyElementRef=Crypto_30_LibCv_Random_Reseed_Counter, CryptoKeyElementRef=Crypto_30_LibCv_Random_Nonce
        Random_Nist_800_90A_DRBG_AES_NoDF: CryptoKeyElementRef=Crypto_30_LibCv_Random_Algorithm_Nist_800_90A_DRBG_AES128, CryptoKeyElementRef=Crypto_30_LibCv_Random_Seed_Nist_800_90A_DRBG_AES128, CryptoKeyElementRef=Crypto_30_LibCv_Random_PrivateString, CryptoKeyElementRef=Crypto_30_LibCv_Random_AdditionalInput, CryptoKeyElementRef=Crypto_30_LibCv_Random_Reseed_Counter
        Signature_RsaCrt_Pkcs1_Generate: CryptoKeyElementRef=Crypto_30_LibCv_Rsa_PrimeP, CryptoKeyElementRef=Crypto_30_LibCv_Rsa_PrimeQ, CryptoKeyElementRef=Crypto_30_LibCv_Rsa_ExponentDp, CryptoKeyElementRef=Crypto_30_LibCv_Rsa_ExponentDq, CryptoKeyElementRef=Crypto_30_LibCv_Rsa_InverseQi
        KeyExchange_SECP256R1: CryptoKeyElementRef=Crypto_30_LibCv_KeyExchange_Algorithm_SECP256R1, CryptoKeyElementRef=Crypto_30_LibCv_KeyExchange_OwnPubKey, CryptoKeyElementRef=Crypto_30_LibCv_KeyExchange_PrivKey, CryptoKeyElementRef=Crypto_30_LibCv_KeyExchange_SharedValue
        SheInfoKey: CryptoKeyElementRef=Crypto_30_LibCv_She_UId, CryptoKeyElementRef=Crypto_30_LibCv_She_BootProtection, CryptoKeyElementRef=Crypto_30_LibCv_She_DebuggerProtection
        Cipher_Rsa_Oaep_Encrypt: CryptoKeyElementRef=Crypto_30_LibCv_Rsa_Modulus, CryptoKeyElementRef=Crypto_30_LibCv_Rsa_Pub_Exponent
        Cipher_Rsa_Oaep_Decrypt: CryptoKeyElementRef=Crypto_30_LibCv_Rsa_Modulus, CryptoKeyElementRef=Crypto_30_LibCv_Rsa_Priv_Exponent
        Cipher_RsaCrt_Oaep_Decrypt: CryptoKeyElementRef=Crypto_30_LibCv_Rsa_PrimeP, CryptoKeyElementRef=Crypto_30_LibCv_Rsa_PrimeQ, CryptoKeyElementRef=Crypto_30_LibCv_Rsa_ExponentDp, CryptoKeyElementRef=Crypto_30_LibCv_Rsa_ExponentDq, CryptoKeyElementRef=Crypto_30_LibCv_Rsa_InverseQi
        Cipher_Rsa_Pkcs1_Encrypt: CryptoKeyElementRef=Crypto_30_LibCv_Rsa_Modulus, CryptoKeyElementRef=Crypto_30_LibCv_Rsa_Pub_Exponent
        Cipher_Rsa_Pkcs1_Decrypt: CryptoKeyElementRef=Crypto_30_LibCv_Rsa_Modulus, CryptoKeyElementRef=Crypto_30_LibCv_Rsa_Priv_Exponent
        Cipher_Rsa_Oaep_Encrypt_With_Label: CryptoKeyElementRef=Crypto_30_LibCv_Rsa_Modulus, CryptoKeyElementRef=Crypto_30_LibCv_Rsa_Pub_Exponent, CryptoKeyElementRef=Crypto_30_LibCv_Label
        Cipher_Rsa_Oaep_Decrypt_With_Label: CryptoKeyElementRef=Crypto_30_LibCv_Rsa_Modulus, CryptoKeyElementRef=Crypto_30_LibCv_Rsa_Priv_Exponent, CryptoKeyElementRef=Crypto_30_LibCv_Label
        Cipher_RsaCrt_Oaep_Decrypt_With_Label: CryptoKeyElementRef=Crypto_30_LibCv_Rsa_PrimeP, CryptoKeyElementRef=Crypto_30_LibCv_Rsa_PrimeQ, CryptoKeyElementRef=Crypto_30_LibCv_Rsa_ExponentDp, CryptoKeyElementRef=Crypto_30_LibCv_Rsa_ExponentDq, CryptoKeyElementRef=Crypto_30_LibCv_Rsa_InverseQi, CryptoKeyElementRef=Crypto_30_LibCv_Label
        KeyExchange_SECP384R1: CryptoKeyElementRef=Crypto_30_LibCv_KeyExchange_Algorithm_SECP384R1, CryptoKeyElementRef=Crypto_30_LibCv_KeyExchange_OwnPubKey, CryptoKeyElementRef=Crypto_30_LibCv_KeyExchange_PrivKey, CryptoKeyElementRef=Crypto_30_LibCv_KeyExchange_SharedValue
        Cipher_Rsa_Pkcs1_Decrypt_Pub: CryptoKeyElementRef=Crypto_30_LibCv_Rsa_Modulus, CryptoKeyElementRef=Crypto_30_LibCv_Rsa_Pub_Exponent
        KeyDerive_KDF_X963_SHA256: CryptoKeyElementRef=Crypto_30_LibCv_KeyDerivation_Password, CryptoKeyElementRef=Crypto_30_LibCv_KeyDerivation_Salt, CryptoKeyElementRef=Crypto_30_LibCv_KeyDerivation_Algorithm_KDF_X963_SHA256
        CipherSheRam: CryptoKeyElementRef=Crypto_30_LibCv_Cipher_Key_She_Ram, CryptoKeyElementRef=Crypto_30_LibCv_Cipher_IV, CryptoKeyElementRef=Crypto_30_LibCv_Cipher_Proof
        MacSheRam: CryptoKeyElementRef=Crypto_30_LibCv_Mac_Key_She_Ram, CryptoKeyElementRef=Crypto_30_LibCv_Mac_Proof
        MacGmac: CryptoKeyElementRef=Crypto_30_LibCv_Mac_Key, CryptoKeyElementRef=Crypto_30_LibCv_Cipher_IV
        KeyGenerate_Symmetric_Generic: CryptoKeyElementRef=Crypto_30_LibCv_KeyGenerate_Key, CryptoKeyElementRef=Crypto_30_LibCv_KeyGenerate_Algorithm_Symmetric_Generic
        KeyGenerate_Ansi_Nist_Sec_P256R1: CryptoKeyElementRef=Crypto_30_LibCv_KeyGenerate_Key, CryptoKeyElementRef=Crypto_30_LibCv_KeyExchange_OwnPubKey, CryptoKeyElementRef=Crypto_30_LibCv_KeyGenerate_Algorithm_Ansi_Nist_Sec_P256R1
        KeyGenerate_Nist_Sec_P384R1: CryptoKeyElementRef=Crypto_30_LibCv_KeyGenerate_Key, CryptoKeyElementRef=Crypto_30_LibCv_KeyExchange_OwnPubKey, CryptoKeyElementRef=Crypto_30_LibCv_KeyGenerate_Algorithm_Nist_Sec_P384R1
        KeyDerive_PBKDF2_HMAC_SHA1: CryptoKeyElementRef=Crypto_30_LibCv_KeyDerivation_Password, CryptoKeyElementRef=Crypto_30_LibCv_KeyDerivation_Salt, CryptoKeyElementRef=Crypto_30_LibCv_KeyDerivation_Iterations_PBKDF2, CryptoKeyElementRef=Crypto_30_LibCv_KeyDerivation_Algorithm_PBKDF2_HMAC_SHA1
        KeyDerive_PBKDF2_HMAC_SHA256: CryptoKeyElementRef=Crypto_30_LibCv_KeyDerivation_Password, CryptoKeyElementRef=Crypto_30_LibCv_KeyDerivation_Salt, CryptoKeyElementRef=Crypto_30_LibCv_KeyDerivation_Iterations_PBKDF2, CryptoKeyElementRef=Crypto_30_LibCv_KeyDerivation_Algorithm_PBKDF2_HMAC_SHA256
        KeyDerive_KDF_X963_SHA512: CryptoKeyElementRef=Crypto_30_LibCv_KeyDerivation_Password, CryptoKeyElementRef=Crypto_30_LibCv_KeyDerivation_Salt, CryptoKeyElementRef=Crypto_30_LibCv_KeyDerivation_Algorithm_KDF_X963_SHA512
        AEAD_ChaCha20_Poly1305: CryptoKeyElementRef=Crypto_30_LibCv_Aead_ChaCha_Key, CryptoKeyElementRef=Crypto_30_LibCv_Aead_ChaCha_Nonce
        Random_Nist_800_90A_DRBG_HASH_SHA2_512: CryptoKeyElementRef=Crypto_30_LibCv_Random_Algorithm_Nist_800_90A_DRBG_HASH_SHA2_512, CryptoKeyElementRef=Crypto_30_LibCv_Random_Seed_Nist_800_90A_DRBG_HASH_SHA2_512, CryptoKeyElementRef=Crypto_30_LibCv_Random_PrivateString, CryptoKeyElementRef=Crypto_30_LibCv_Random_AdditionalInput, CryptoKeyElementRef=Crypto_30_LibCv_Random_Reseed_Counter, CryptoKeyElementRef=Crypto_30_LibCv_Random_Nonce
        Random_Nist_800_90A_DRBG_AES256_NoDF: CryptoKeyElementRef=Crypto_30_LibCv_Random_Algorithm_Nist_800_90A_DRBG_AES256, CryptoKeyElementRef=Crypto_30_LibCv_Random_Seed_Nist_800_90A_DRBG_AES256, CryptoKeyElementRef=Crypto_30_LibCv_Random_PrivateString, CryptoKeyElementRef=Crypto_30_LibCv_Random_AdditionalInput, CryptoKeyElementRef=Crypto_30_LibCv_Random_Reseed_Counter
        Random_Nist_800_90A_DRBG_AES256_DF: CryptoKeyElementRef=Crypto_30_LibCv_Random_Algorithm_Nist_800_90A_DRBG_AES256Df, CryptoKeyElementRef=Crypto_30_LibCv_Random_Seed_Nist_800_90A_DRBG_AES256, CryptoKeyElementRef=Crypto_30_LibCv_Random_PrivateString, CryptoKeyElementRef=Crypto_30_LibCv_Random_AdditionalInput, CryptoKeyElementRef=Crypto_30_LibCv_Random_Reseed_Counter, CryptoKeyElementRef=Crypto_30_LibCv_Random_Nonce
        KeyDerive_HKDF_HMAC_SHA256: CryptoKeyElementRef=Crypto_30_LibCv_KeyDerivation_Password, CryptoKeyElementRef=Crypto_30_LibCv_KeyDerivation_Salt, CryptoKeyElementRef=Crypto_30_LibCv_KeyDerivation_Iterations_HKDF, CryptoKeyElementRef=Crypto_30_LibCv_KeyDerivation_Algorithm_HKDF_HMAC_SHA256, CryptoKeyElementRef=Crypto_30_LibCv_KeyDerivation_AdditionalInfo
        KeyDerive_Spake2Plus_P256R1: CryptoKeyElementRef=Crypto_30_LibCv_KeyDerivation_Password, CryptoKeyElementRef=Crypto_30_LibCv_KeyDerivation_Algorithm_Spake2Plus_P256R1
        KeyExchange_Spake2Plus_A_Suite8_1: CryptoKeyElementRef=Crypto_30_LibCv_KeyExchange_Algorithm_Spake2Plus_Suite8_1, CryptoKeyElementRef=Crypto_30_LibCv_W0, CryptoKeyElementRef=Crypto_30_LibCv_W1, CryptoKeyElementRef=Crypto_30_LibCv_AdditionalInfo, CryptoKeyElementRef=Crypto_30_LibCv_KeyExchange_SharedValue, CryptoKeyElementRef=Crypto_30_LibCv_Verification_Result, CryptoKeyElementRef=Crypto_30_LibCv_Verification
        KeyExchange_Spake2Plus_B_Suite8_1: CryptoKeyElementRef=Crypto_30_LibCv_KeyExchange_Algorithm_Spake2Plus_Suite8_1, CryptoKeyElementRef=Crypto_30_LibCv_W0, CryptoKeyElementRef=Crypto_30_LibCv_L, CryptoKeyElementRef=Crypto_30_LibCv_AdditionalInfo, CryptoKeyElementRef=Crypto_30_LibCv_KeyExchange_SharedValue, CryptoKeyElementRef=Crypto_30_LibCv_Verification_Result, CryptoKeyElementRef=Crypto_30_LibCv_Verification
        KeyExchange_Spake2Plus_A_Suite8: CryptoKeyElementRef=Crypto_30_LibCv_KeyExchange_Algorithm_Spake2Plus_Suite8, CryptoKeyElementRef=Crypto_30_LibCv_W0, CryptoKeyElementRef=Crypto_30_LibCv_W1, CryptoKeyElementRef=Crypto_30_LibCv_AdditionalInfo, CryptoKeyElementRef=Crypto_30_LibCv_KeyExchange_SharedValue, CryptoKeyElementRef=Crypto_30_LibCv_Verification_Result, CryptoKeyElementRef=Crypto_30_LibCv_Verification
        KeyExchange_Spake2Plus_B_Suite8: CryptoKeyElementRef=Crypto_30_LibCv_KeyExchange_Algorithm_Spake2Plus_Suite8, CryptoKeyElementRef=Crypto_30_LibCv_W0, CryptoKeyElementRef=Crypto_30_LibCv_L, CryptoKeyElementRef=Crypto_30_LibCv_AdditionalInfo, CryptoKeyElementRef=Crypto_30_LibCv_KeyExchange_SharedValue, CryptoKeyElementRef=Crypto_30_LibCv_Verification_Result, CryptoKeyElementRef=Crypto_30_LibCv_Verification
        KeyGenerate_ED25519: CryptoKeyElementRef=Crypto_30_LibCv_KeyGenerate_Key, CryptoKeyElementRef=Crypto_30_LibCv_KeyExchange_OwnPubKey, CryptoKeyElementRef=Crypto_30_LibCv_KeyGenerate_Algorithm_Ed25519
        KeyExchange_NISTP224R1_BD: CryptoKeyElementRef=Crypto_30_LibCv_KeyExchange_Algorithm_NISTP224R1_BD, CryptoKeyElementRef=Crypto_30_LibCv_KeyExchange_OwnPubKey, CryptoKeyElementRef=Crypto_30_LibCv_KeyExchange_PrivKey, CryptoKeyElementRef=Crypto_30_LibCv_KeyExchange_SharedValue, CryptoKeyElementRef=Crypto_30_LibCv_KeyExchange_NumEcu, CryptoKeyElementRef=Crypto_30_LibCv_KeyExchange_EcuId, CryptoKeyElementRef=Crypto_30_LibCv_KeyExchange_Intermediate, CryptoKeyElementRef=Crypto_30_LibCv_KeyExchange_PartnerPubKey, CryptoKeyElementRef=Crypto_30_LibCv_KeyExchange_PartnerPubKey_2
        KeyDerive_Hkdf_Option1_Sha256: CryptoKeyElementRef=Crypto_30_LibCv_KeyDerivation_Password, CryptoKeyElementRef=Crypto_30_LibCv_KeyDerivation_AdditionalInfo, CryptoKeyElementRef=Crypto_30_LibCv_KeyDerivation_Algorithm_HKDF_Option1_SHA256
        KeyExchange_SECP521R1: CryptoKeyElementRef=Crypto_30_LibCv_KeyExchange_Algorithm_SECP521R1, CryptoKeyElementRef=Crypto_30_LibCv_KeyExchange_OwnPubKey, CryptoKeyElementRef=Crypto_30_LibCv_KeyExchange_PrivKey, CryptoKeyElementRef=Crypto_30_LibCv_KeyExchange_SharedValue
        KeyDerive_HKDF_HMAC_SHA384: CryptoKeyElementRef=Crypto_30_LibCv_KeyDerivation_Password, CryptoKeyElementRef=Crypto_30_LibCv_KeyDerivation_Salt, CryptoKeyElementRef=Crypto_30_LibCv_KeyDerivation_Iterations_HKDF, CryptoKeyElementRef=Crypto_30_LibCv_KeyDerivation_Algorithm_HKDF_HMAC_SHA384, CryptoKeyElementRef=Crypto_30_LibCv_KeyDerivation_AdditionalInfo
        KeyDerive_Hkdf_Option1_Sha512: CryptoKeyElementRef=Crypto_30_LibCv_KeyDerivation_Password, CryptoKeyElementRef=Crypto_30_LibCv_KeyDerivation_AdditionalInfo, CryptoKeyElementRef=Crypto_30_LibCv_KeyDerivation_Algorithm_HKDF_Option1_SHA512
        KeyDerive_ISO15118_20_ProvCert: CryptoKeyElementRef=Crypto_30_LibCv_KeyDerivation_Password, CryptoKeyElementRef=Crypto_30_LibCv_KeyDerivation_Algorithm_ISO15118_20, CryptoKeyElementRef=Crypto_30_LibCv_KeyExchange_OwnPubKey
        KeyDerive_ISO15118_20_ContrCert: CryptoKeyElementRef=Crypto_30_LibCv_KeyDerivation_Password, CryptoKeyElementRef=Crypto_30_LibCv_KeyDerivation_Algorithm_ISO15118_20, CryptoKeyElementRef=Crypto_30_LibCv_KeyExchange_PartnerPubKey, CryptoKeyElementRef=Crypto_30_LibCv_SCC_Contract_PubKey, CryptoKeyElementRef=Crypto_30_LibCv_SCC_IV_And_Encrypted_PrivKey, CryptoKeyElementRef=Crypto_30_LibCv_SCC_Contract_AAD
        KeyExchange_X448: CryptoKeyElementRef=Crypto_30_LibCv_KeyExchange_Algorithm_X448, CryptoKeyElementRef=Crypto_30_LibCv_KeyExchange_OwnPubKey, CryptoKeyElementRef=Crypto_30_LibCv_KeyExchange_PrivKey, CryptoKeyElementRef=Crypto_30_LibCv_KeyExchange_SharedValue
        Signature_EcDsa_SECp160r1_public: CryptoKeyElementRef=Crypto_30_LibCv_Signature_EcDsa_SECp160r1_public
        Signature_EcDsa_SECp256r1_public: CryptoKeyElementRef=Crypto_30_LibCv_Signature_EcDsa_SECp256r1_public
        Signature_EcDsa_SECp384r1_public: CryptoKeyElementRef=Crypto_30_LibCv_Signature_EcDsa_SECp384r1_public
        Signature_EcDsa_SECp521r1_public: CryptoKeyElementRef=Crypto_30_LibCv_Signature_EcDsa_SECp521r1_public
        Signature_EdDsa_Ed25519_public: CryptoKeyElementRef=Crypto_30_LibCv_Signature_EdDsa_Ed25519_public
        Signature_EcDsa_SECp160r1_private: CryptoKeyElementRef=Crypto_30_LibCv_Signature_EcDsa_SECp160r1_private
        Signature_EcDsa_SECp256r1_private: CryptoKeyElementRef=Crypto_30_LibCv_Signature_EcDsa_SECp256r1_private
        Signature_EcDsa_SECp384r1_private: CryptoKeyElementRef=Crypto_30_LibCv_Signature_EcDsa_SECp384r1_private
        Signature_EcDsa_SECp521r1_private: CryptoKeyElementRef=Crypto_30_LibCv_Signature_EcDsa_SECp521r1_private
        Signature_EdDsa_Ed25519_private: CryptoKeyElementRef=Crypto_30_LibCv_Signature_EdDsa_Ed25519_private
        Signature_EdDsa_Ed448_public: CryptoKeyElementRef=Crypto_30_LibCv_Signature_EdDsa_Ed448_public
        Signature_EdDsa_Ed448_private: CryptoKeyElementRef=Crypto_30_LibCv_Signature_EdDsa_Ed448_private
        Signature_EdDsa_Ed448_public_ctx: CryptoKeyElementRef=Crypto_30_LibCv_Signature_EdDsa_Ed448_public, CryptoKeyElementRef=Crypto_30_LibCv_EdDsa_Context
        Signature_EdDsa_Ed448_private_ctx: CryptoKeyElementRef=Crypto_30_LibCv_Signature_EdDsa_Ed448_private, CryptoKeyElementRef=Crypto_30_LibCv_EdDsa_Context
        Signature_EdDsa_Ed25519_public_ctx: CryptoKeyElementRef=Crypto_30_LibCv_Signature_EdDsa_Ed25519_public, CryptoKeyElementRef=Crypto_30_LibCv_EdDsa_Context
        Signature_EdDsa_Ed25519_private_ctx: CryptoKeyElementRef=Crypto_30_LibCv_Signature_EdDsa_Ed25519_private, CryptoKeyElementRef=Crypto_30_LibCv_EdDsa_Context
        KeyExchange_P256R1_BD: CryptoKeyElementRef=Crypto_30_LibCv_KeyExchange_Algorithm_P256R1_BD, CryptoKeyElementRef=Crypto_30_LibCv_KeyExchange_OwnPubKey, CryptoKeyElementRef=Crypto_30_LibCv_KeyExchange_PrivKey, CryptoKeyElementRef=Crypto_30_LibCv_KeyExchange_SharedValue, CryptoKeyElementRef=Crypto_30_LibCv_KeyExchange_NumEcu, CryptoKeyElementRef=Crypto_30_LibCv_KeyExchange_EcuId, CryptoKeyElementRef=Crypto_30_LibCv_KeyExchange_Intermediate, CryptoKeyElementRef=Crypto_30_LibCv_KeyExchange_PartnerPubKey, CryptoKeyElementRef=Crypto_30_LibCv_KeyExchange_PartnerPubKey_2
        KeyGenerate_Nist_Sec_P521R1: CryptoKeyElementRef=Crypto_30_LibCv_KeyGenerate_Key, CryptoKeyElementRef=Crypto_30_LibCv_KeyExchange_OwnPubKey, CryptoKeyElementRef=Crypto_30_LibCv_KeyGenerate_Algorithm_Nist_Sec_P521R1
        Signature_SlhDsaSha2_128s_public: CryptoKeyElementRef=Crypto_30_LibCv_Signature_SlhDsaSha2_128s_public
        Signature_Sm2_P256Sm2_Generate_withoutID: CryptoKeyElementRef=Crypto_30_LibCv_Signature_Sm2_P256Sm2_private, CryptoKeyElementRef=Crypto_30_LibCv_Signature_Sm2Generate_P256Sm2_public
        Signature_Sm2_P256Sm2_Verify_withoutID: CryptoKeyElementRef=Crypto_30_LibCv_Signature_Sm2Verify_P256Sm2_public
        Signature_Sm2_P256Sm2_Generate: CryptoKeyElementRef=Crypto_30_LibCv_Signature_Sm2_P256Sm2_private, CryptoKeyElementRef=Crypto_30_LibCv_Signature_Sm2Generate_P256Sm2_public, CryptoKeyElementRef=Crypto_30_LibCv_Signature_Sm2_ID
        Signature_Sm2_P256Sm2_Verify: CryptoKeyElementRef=Crypto_30_LibCv_Signature_Sm2Verify_P256Sm2_public, CryptoKeyElementRef=Crypto_30_LibCv_Signature_Sm2_ID
        KeyGenerate_Sm2P256V1: CryptoKeyElementRef=Crypto_30_LibCv_KeyGenerate_Key, CryptoKeyElementRef=Crypto_30_LibCv_KeyExchange_OwnPubKey, CryptoKeyElementRef=Crypto_30_LibCv_KeyGenerate_Algorithm_Sm2P256v1
        KeyDerive_NIST800108_CTR_CMAC_AES: CryptoKeyElementRef=Crypto_30_LibCv_KeyDerivation_Password, CryptoKeyElementRef=Crypto_30_LibCv_KeyDerivation_Algorithm_NIST800108_CTR_CMAC_AES, CryptoKeyElementRef=Crypto_30_LibCv_KeyDerivation_Label, CryptoKeyElementRef=Crypto_30_LibCv_KeyDerivation_Context
        KeyDerive_NIST800108_CTR: CryptoKeyElementRef=Crypto_30_LibCv_KeyDerivation_Password, CryptoKeyElementRef=Crypto_30_LibCv_KeyDerivation_Label, CryptoKeyElementRef=Crypto_30_LibCv_KeyDerivation_Context
        Signature_SlhDsaSha2_128s_public_ctx: CryptoKeyElementRef=Crypto_30_LibCv_Signature_SlhDsaSha2_128s_public, CryptoKeyElementRef=Crypto_30_LibCv_SlhDsa_Context
        KeyWrap_Aes_PlaintextKey: CryptoKeyElementRef=Crypto_30_LibCv_KeyWrap_Aes_PlaintextKey
        KeyWrap_Aes_Kek: CryptoKeyElementRef=Crypto_30_LibCv_KeyWrap_Aes_Kek
    CryptoDriverObjects
      Crypto_30_LibCv (CryptoDriverObject):
        CryptoDriverObjectId = 1
        CryptoDriverObjectQueueSize = 1
        CryptoPrimitiveRef = AesCmacVerify
        CryptoPrimitiveRef = HmacSha1Verify
        CryptoPrimitiveRef = EdDsaEd25519PhVerify
        CryptoPrimitiveRef = RsaPkcs1Sha1Verify
        CryptoPrimitiveRef = RsaPssSha256Verify
        CryptoPrimitiveRef = SHA512
      Crypto_30_LibCv_Aes (CryptoDriverObject): CryptoDriverObjectId=0, CryptoDriverObjectQueueSize=1, CryptoPrimitiveRef=AesDecrypt
    CryptoGeneral:
      CryptoUseVStdLib = true
      CryptoWatchdogTriggerFunction = FblRealTimeSupportVoid
      CryptoNvMEnableSetRamBlockStatus = false
      CryptoVersionInfoApi = false
      CryptoMainFunctionPeriod = 0.01
      CryptoDevErrorDetect = true
      CryptoSafeBswChecks = false
      CryptoKeyElementDelete = false
      CryptoAlignKeyStorage = false
      CryptoRedirection = false
      CryptoDefaultRandomMaxRetries = 10
      CryptoNumberOfLongTermPrimitiveWorkspace = 0
      CryptoStrictLengthCheckForKeyElementGet = true
      CryptoEnableKeyLocking = true
      CryptoMultiPartitionRuntimeChecks = false
      CryptoKeyExchangePrimitives
      CryptoKeyDerivePrimitives
      CryptoMacPrimitives: CryptoCmacAesRoundkeyReuse=false
      CryptoCipherPrimitives: CryptoEnableAES192=false, CryptoEnableAES256=false
      CryptoKeyGeneratePrimitives: CryptoKeyGenerateMaxLength=32
      CryptoConfigurableCallouts
    CryptoKeys
      7 x CryptoKey, all with CryptoKeyDeriveIterations=1:
        CryptoKey_Fbl_Decrypt_Aes128: CryptoKeyNvId=0, CryptoKeyId=0, CryptoKeyTypeRef=CryptoKeyType_Fbl_Decrypt_Aes128
        CryptoKey_Fbl_Signature_Ed25519: CryptoKeyNvId=2, CryptoKeyId=2, CryptoKeyTypeRef=CryptoKeyType_Fbl_Signature_Ed25519
        CryptoKey_Fbl_Signature_Class_C: CryptoKeyNvId=1, CryptoKeyId=1, CryptoKeyTypeRef=CryptoKeyType_Fbl_Signature_ClassC
        CryptoKey_Fbl_Signature_Rsa1024: CryptoKeyNvId=3, CryptoKeyId=3, CryptoKeyTypeRef=CryptoKeyType_Fbl_Signature_Rsa1024
        CryptoKey_Fbl_Signature_Rsa2048: CryptoKeyNvId=4, CryptoKeyId=4, CryptoKeyTypeRef=CryptoKeyType_Fbl_Signature_Rsa2048
        CryptoKey_Fbl_Signature_Rsa3072: CryptoKeyNvId=5, CryptoKeyId=5, CryptoKeyTypeRef=CryptoKeyType_Fbl_Signature_Rsa3072
        CryptoKey_Fbl_HashDummy: CryptoKeyNvId=6, CryptoKeyId=6, CryptoKeyTypeRef=Hash
    CryptoPrimitives
      147 x CryptoPrimitive:
        AesGCMEncrypt: CryptoPrimitiveAlgorithmSecondaryFamily=CRYPTO_ALGOFAM_NOT_SET, CryptoPrimitiveAlgorithmMode=CRYPTO_ALGOMODE_GCM, CryptoPrimitiveService=CRYPTO_AEADENCRYPT, CryptoPrimitiveAlgorithmFamily=CRYPTO_ALGOFAM_AES
        AesGCMDecrypt: CryptoPrimitiveAlgorithmSecondaryFamily=CRYPTO_ALGOFAM_NOT_SET, CryptoPrimitiveAlgorithmMode=CRYPTO_ALGOMODE_GCM, CryptoPrimitiveService=CRYPTO_AEADDECRYPT, CryptoPrimitiveAlgorithmFamily=CRYPTO_ALGOFAM_AES
        AesEncrypt: CryptoPrimitiveAlgorithmSecondaryFamily=CRYPTO_ALGOFAM_NOT_SET, CryptoPrimitiveAlgorithmMode=CRYPTO_ALGOMODE_ECB, CryptoPrimitiveService=CRYPTO_ENCRYPT, CryptoPrimitiveAlgorithmFamily=CRYPTO_ALGOFAM_AES, CryptoPrimitiveAlgorithmMode=CRYPTO_ALGOMODE_CBC, CryptoPrimitiveAlgorithmSecondaryFamily=CRYPTO_ALGOFAM_CUSTOM_PADDING_PKCS7, CryptoPrimitiveAlgorithmSecondaryFamily=CRYPTO_ALGOFAM_PADDING_ONEWITHZEROS, CryptoPrimitiveAlgorithmMode=CRYPTO_ALGOMODE_CTR, CryptoPrimitiveAlgorithmSecondaryFamily=CRYPTO_ALGOFAM_PADDING_PKCS7, CryptoPrimitiveAlgorithmSecondaryFamilyCustomRef=Crypto_30_LibCv_PaddingPKCS7
        AesDecrypt: CryptoPrimitiveAlgorithmSecondaryFamily=CRYPTO_ALGOFAM_NOT_SET, CryptoPrimitiveAlgorithmMode=CRYPTO_ALGOMODE_ECB, CryptoPrimitiveService=CRYPTO_DECRYPT, CryptoPrimitiveAlgorithmFamily=CRYPTO_ALGOFAM_AES, CryptoPrimitiveAlgorithmMode=CRYPTO_ALGOMODE_CBC, CryptoPrimitiveAlgorithmSecondaryFamily=CRYPTO_ALGOFAM_CUSTOM_PADDING_PKCS7, CryptoPrimitiveAlgorithmSecondaryFamily=CRYPTO_ALGOFAM_PADDING_ONEWITHZEROS, CryptoPrimitiveAlgorithmMode=CRYPTO_ALGOMODE_CTR, CryptoPrimitiveAlgorithmSecondaryFamily=CRYPTO_ALGOFAM_PADDING_PKCS7, CryptoPrimitiveAlgorithmSecondaryFamilyCustomRef=Crypto_30_LibCv_PaddingPKCS7
        SHA1: CryptoPrimitiveAlgorithmSecondaryFamily=CRYPTO_ALGOFAM_NOT_SET, CryptoPrimitiveAlgorithmMode=CRYPTO_ALGOMODE_NOT_SET, CryptoPrimitiveService=CRYPTO_HASH, CryptoPrimitiveAlgorithmFamily=CRYPTO_ALGOFAM_SHA1
        SHA256: CryptoPrimitiveAlgorithmSecondaryFamily=CRYPTO_ALGOFAM_NOT_SET, CryptoPrimitiveAlgorithmMode=CRYPTO_ALGOMODE_NOT_SET, CryptoPrimitiveService=CRYPTO_HASH, CryptoPrimitiveAlgorithmFamily=CRYPTO_ALGOFAM_SHA2_256
        SHA512: CryptoPrimitiveAlgorithmSecondaryFamily=CRYPTO_ALGOFAM_NOT_SET, CryptoPrimitiveAlgorithmMode=CRYPTO_ALGOMODE_NOT_SET, CryptoPrimitiveService=CRYPTO_HASH, CryptoPrimitiveAlgorithmFamily=CRYPTO_ALGOFAM_SHA2_512
        AesCmacGenerate: CryptoPrimitiveAlgorithmSecondaryFamily=CRYPTO_ALGOFAM_NOT_SET, CryptoPrimitiveAlgorithmMode=CRYPTO_ALGOMODE_CMAC, CryptoPrimitiveService=CRYPTO_MAC_GENERATE, CryptoPrimitiveAlgorithmFamily=CRYPTO_ALGOFAM_AES
        AesCmacVerify: CryptoPrimitiveAlgorithmSecondaryFamily=CRYPTO_ALGOFAM_NOT_SET, CryptoPrimitiveAlgorithmMode=CRYPTO_ALGOMODE_CMAC, CryptoPrimitiveService=CRYPTO_MAC_VERIFY, CryptoPrimitiveAlgorithmFamily=CRYPTO_ALGOFAM_AES
        RngFips186Sha1: CryptoPrimitiveAlgorithmMode=CRYPTO_ALGOMODE_NOT_SET, CryptoPrimitiveService=CRYPTO_RANDOM, CryptoPrimitiveAlgorithmFamily=CRYPTO_ALGOFAM_CUSTOM_FIPS186, CryptoPrimitiveAlgorithmSecondaryFamily=CRYPTO_ALGOFAM_SHA1, CryptoPrimitiveAlgorithmFamily=CRYPTO_ALGOFAM_CUSTOM, CryptoPrimitiveAlgorithmFamilyCustomRef=Crypto_30_LibCv_FIPS186
        EcDsaEd25519Generate: CryptoPrimitiveAlgorithmSecondaryFamily=CRYPTO_ALGOFAM_NOT_SET, CryptoPrimitiveAlgorithmMode=CRYPTO_ALGOMODE_NOT_SET, CryptoPrimitiveService=CRYPTO_SIGNATURE_GENERATE, CryptoPrimitiveAlgorithmFamily=CRYPTO_ALGOFAM_ED25519, CryptoPrimitiveAlgorithmSecondaryFamily=CRYPTO_ALGOFAM_SHA2_512
        EcDsaEd25519Verify: CryptoPrimitiveAlgorithmSecondaryFamily=CRYPTO_ALGOFAM_NOT_SET, CryptoPrimitiveAlgorithmMode=CRYPTO_ALGOMODE_NOT_SET, CryptoPrimitiveService=CRYPTO_SIGNATURE_VERIFY, CryptoPrimitiveAlgorithmFamily=CRYPTO_ALGOFAM_ED25519, CryptoPrimitiveAlgorithmSecondaryFamily=CRYPTO_ALGOFAM_SHA2_512
        SipHashGenerate: CryptoPrimitiveService=CRYPTO_MAC_GENERATE, CryptoPrimitiveAlgorithmFamily=CRYPTO_ALGOFAM_SIPHASH, CryptoPrimitiveAlgorithmMode=CRYPTO_ALGOMODE_SIPHASH_2_4, CryptoPrimitiveAlgorithmSecondaryFamily=CRYPTO_ALGOFAM_NOT_SET
        SipHashVerify: CryptoPrimitiveService=CRYPTO_MAC_VERIFY, CryptoPrimitiveAlgorithmFamily=CRYPTO_ALGOFAM_SIPHASH, CryptoPrimitiveAlgorithmMode=CRYPTO_ALGOMODE_SIPHASH_2_4, CryptoPrimitiveAlgorithmSecondaryFamily=CRYPTO_ALGOFAM_NOT_SET
        RsaPkcs1Sha1Generate: CryptoPrimitiveAlgorithmFamily=CRYPTO_ALGOFAM_RSA, CryptoPrimitiveService=CRYPTO_SIGNATURE_GENERATE, CryptoPrimitiveAlgorithmMode=CRYPTO_ALGOMODE_RSASSA_PKCS1_v1_5, CryptoPrimitiveAlgorithmSecondaryFamily=CRYPTO_ALGOFAM_SHA1
        RsaPkcs1Sha1Verify: CryptoPrimitiveAlgorithmFamily=CRYPTO_ALGOFAM_RSA, CryptoPrimitiveService=CRYPTO_SIGNATURE_VERIFY, CryptoPrimitiveAlgorithmMode=CRYPTO_ALGOMODE_RSASSA_PKCS1_v1_5, CryptoPrimitiveAlgorithmSecondaryFamily=CRYPTO_ALGOFAM_SHA1
        RsaPkcs1Sha256Generate: CryptoPrimitiveAlgorithmFamily=CRYPTO_ALGOFAM_RSA, CryptoPrimitiveService=CRYPTO_SIGNATURE_GENERATE, CryptoPrimitiveAlgorithmMode=CRYPTO_ALGOMODE_RSASSA_PKCS1_v1_5, CryptoPrimitiveAlgorithmSecondaryFamily=CRYPTO_ALGOFAM_SHA2_256
        RsaPkcs1Sha256Verify: CryptoPrimitiveAlgorithmFamily=CRYPTO_ALGOFAM_RSA, CryptoPrimitiveService=CRYPTO_SIGNATURE_VERIFY, CryptoPrimitiveAlgorithmMode=CRYPTO_ALGOMODE_RSASSA_PKCS1_v1_5, CryptoPrimitiveAlgorithmSecondaryFamily=CRYPTO_ALGOFAM_SHA2_256
        RsaPssSha1Generate: CryptoPrimitiveAlgorithmFamily=CRYPTO_ALGOFAM_RSA, CryptoPrimitiveService=CRYPTO_SIGNATURE_GENERATE, CryptoPrimitiveAlgorithmMode=CRYPTO_ALGOMODE_RSASSA_PSS, CryptoPrimitiveAlgorithmSecondaryFamily=CRYPTO_ALGOFAM_SHA1
        RsaPssSha1Verify: CryptoPrimitiveAlgorithmFamily=CRYPTO_ALGOFAM_RSA, CryptoPrimitiveService=CRYPTO_SIGNATURE_VERIFY, CryptoPrimitiveAlgorithmMode=CRYPTO_ALGOMODE_RSASSA_PSS, CryptoPrimitiveAlgorithmSecondaryFamily=CRYPTO_ALGOFAM_SHA1
        RsaPssSha256Generate: CryptoPrimitiveAlgorithmFamily=CRYPTO_ALGOFAM_RSA, CryptoPrimitiveService=CRYPTO_SIGNATURE_GENERATE, CryptoPrimitiveAlgorithmMode=CRYPTO_ALGOMODE_RSASSA_PSS, CryptoPrimitiveAlgorithmSecondaryFamily=CRYPTO_ALGOFAM_SHA2_256
        RsaPssSha256Verify: CryptoPrimitiveAlgorithmFamily=CRYPTO_ALGOFAM_RSA, CryptoPrimitiveService=CRYPTO_SIGNATURE_VERIFY, CryptoPrimitiveAlgorithmMode=CRYPTO_ALGOMODE_RSASSA_PSS, CryptoPrimitiveAlgorithmSecondaryFamily=CRYPTO_ALGOFAM_SHA2_256
        RsaPkcs1Decrypt: CryptoPrimitiveAlgorithmFamily=CRYPTO_ALGOFAM_RSA, CryptoPrimitiveService=CRYPTO_DECRYPT, CryptoPrimitiveAlgorithmMode=CRYPTO_ALGOMODE_RSAES_PKCS1_v1_5, CryptoPrimitiveAlgorithmSecondaryFamily=CRYPTO_ALGOFAM_NOT_SET
        RsaPkcs1Encrypt: CryptoPrimitiveAlgorithmFamily=CRYPTO_ALGOFAM_RSA, CryptoPrimitiveService=CRYPTO_ENCRYPT, CryptoPrimitiveAlgorithmMode=CRYPTO_ALGOMODE_RSAES_PKCS1_v1_5, CryptoPrimitiveAlgorithmSecondaryFamily=CRYPTO_ALGOFAM_NOT_SET
        EccNistP256R1GenerateWithoutPreHashing: CryptoPrimitiveAlgorithmFamily=CRYPTO_ALGOFAM_ECCNIST, CryptoPrimitiveAlgorithmMode=CRYPTO_ALGOMODE_CUSTOM_P256R1, CryptoPrimitiveService=CRYPTO_SIGNATURE_GENERATE, CryptoPrimitiveAlgorithmSecondaryFamily=CRYPTO_ALGOFAM_NOT_SET, CryptoPrimitiveAlgorithmMode=CRYPTO_ALGOMODE_CUSTOM, CryptoPrimitiveAlgorithmModeCustomRef=Crypto_30_LibCv_P256r1
        EccNistP256R1VerifyWithoutPreHashing: CryptoPrimitiveAlgorithmFamily=CRYPTO_ALGOFAM_ECCNIST, CryptoPrimitiveAlgorithmMode=CRYPTO_ALGOMODE_CUSTOM_P256R1, CryptoPrimitiveService=CRYPTO_SIGNATURE_VERIFY, CryptoPrimitiveAlgorithmSecondaryFamily=CRYPTO_ALGOFAM_NOT_SET, CryptoPrimitiveAlgorithmMode=CRYPTO_ALGOMODE_CUSTOM, CryptoPrimitiveAlgorithmModeCustomRef=Crypto_30_LibCv_P256r1
        EccAnsiP256R1GenerateWithoutPreHashing: CryptoPrimitiveAlgorithmFamily=CRYPTO_ALGOFAM_CUSTOM_ECCANSI, CryptoPrimitiveAlgorithmMode=CRYPTO_ALGOMODE_CUSTOM_P256R1, CryptoPrimitiveService=CRYPTO_SIGNATURE_GENERATE, CryptoPrimitiveAlgorithmSecondaryFamily=CRYPTO_ALGOFAM_NOT_SET, CryptoPrimitiveAlgorithmMode=CRYPTO_ALGOMODE_CUSTOM, CryptoPrimitiveAlgorithmFamily=CRYPTO_ALGOFAM_CUSTOM, CryptoPrimitiveAlgorithmFamily=CRYPTO_ALGOFAM_ECCANSI, CryptoPrimitiveAlgorithmFamilyCustomRef=Crypto_30_LibCv_ECCANSI, CryptoPrimitiveAlgorithmModeCustomRef=Crypto_30_LibCv_P256r1
        EccSecP256R1GenerateWithoutPreHashing: CryptoPrimitiveAlgorithmFamily=CRYPTO_ALGOFAM_CUSTOM_ECCSEC, CryptoPrimitiveAlgorithmMode=CRYPTO_ALGOMODE_CUSTOM_P256R1, CryptoPrimitiveService=CRYPTO_SIGNATURE_GENERATE, CryptoPrimitiveAlgorithmSecondaryFamily=CRYPTO_ALGOFAM_NOT_SET, CryptoPrimitiveAlgorithmMode=CRYPTO_ALGOMODE_CUSTOM, CryptoPrimitiveAlgorithmFamily=CRYPTO_ALGOFAM_CUSTOM, CryptoPrimitiveAlgorithmFamily=CRYPTO_ALGOFAM_ECCSEC, CryptoPrimitiveAlgorithmFamilyCustomRef=Crypto_30_LibCv_ECCSEC, CryptoPrimitiveAlgorithmModeCustomRef=Crypto_30_LibCv_P256r1
        EccAnsiP256R1VerifyWithoutPreHashing: CryptoPrimitiveAlgorithmFamily=CRYPTO_ALGOFAM_CUSTOM_ECCANSI, CryptoPrimitiveAlgorithmMode=CRYPTO_ALGOMODE_CUSTOM_P256R1, CryptoPrimitiveService=CRYPTO_SIGNATURE_VERIFY, CryptoPrimitiveAlgorithmSecondaryFamily=CRYPTO_ALGOFAM_NOT_SET, CryptoPrimitiveAlgorithmMode=CRYPTO_ALGOMODE_CUSTOM, CryptoPrimitiveAlgorithmFamily=CRYPTO_ALGOFAM_CUSTOM, CryptoPrimitiveAlgorithmFamily=CRYPTO_ALGOFAM_ECCANSI, CryptoPrimitiveAlgorithmFamilyCustomRef=Crypto_30_LibCv_ECCANSI, CryptoPrimitiveAlgorithmModeCustomRef=Crypto_30_LibCv_P256r1
        EccSecP256R1VerifyWithoutPreHashing: CryptoPrimitiveAlgorithmFamily=CRYPTO_ALGOFAM_CUSTOM_ECCSEC, CryptoPrimitiveAlgorithmMode=CRYPTO_ALGOMODE_CUSTOM_P256R1, CryptoPrimitiveService=CRYPTO_SIGNATURE_VERIFY, CryptoPrimitiveAlgorithmSecondaryFamily=CRYPTO_ALGOFAM_NOT_SET, CryptoPrimitiveAlgorithmMode=CRYPTO_ALGOMODE_CUSTOM, CryptoPrimitiveAlgorithmFamily=CRYPTO_ALGOFAM_CUSTOM, CryptoPrimitiveAlgorithmFamily=CRYPTO_ALGOFAM_ECCSEC, CryptoPrimitiveAlgorithmFamilyCustomRef=Crypto_30_LibCv_ECCSEC, CryptoPrimitiveAlgorithmModeCustomRef=Crypto_30_LibCv_P256r1
        HmacSha1Generate: CryptoPrimitiveAlgorithmFamily=CRYPTO_ALGOFAM_SHA1, CryptoPrimitiveAlgorithmMode=CRYPTO_ALGOMODE_HMAC, CryptoPrimitiveAlgorithmSecondaryFamily=CRYPTO_ALGOFAM_NOT_SET, CryptoPrimitiveService=CRYPTO_MAC_GENERATE
        HmacSha1Verify: CryptoPrimitiveAlgorithmFamily=CRYPTO_ALGOFAM_SHA1, CryptoPrimitiveAlgorithmMode=CRYPTO_ALGOMODE_HMAC, CryptoPrimitiveAlgorithmSecondaryFamily=CRYPTO_ALGOFAM_NOT_SET, CryptoPrimitiveService=CRYPTO_MAC_VERIFY
        HmacSha256Generate: CryptoPrimitiveAlgorithmFamily=CRYPTO_ALGOFAM_SHA2_256, CryptoPrimitiveAlgorithmMode=CRYPTO_ALGOMODE_HMAC, CryptoPrimitiveAlgorithmSecondaryFamily=CRYPTO_ALGOFAM_NOT_SET, CryptoPrimitiveService=CRYPTO_MAC_GENERATE
        HmacSha256Verify: CryptoPrimitiveAlgorithmFamily=CRYPTO_ALGOFAM_SHA2_256, CryptoPrimitiveAlgorithmMode=CRYPTO_ALGOMODE_HMAC, CryptoPrimitiveAlgorithmSecondaryFamily=CRYPTO_ALGOFAM_NOT_SET, CryptoPrimitiveService=CRYPTO_MAC_VERIFY
        EccNistP256R1GenerateSha1: CryptoPrimitiveAlgorithmFamily=CRYPTO_ALGOFAM_ECCNIST, CryptoPrimitiveAlgorithmMode=CRYPTO_ALGOMODE_CUSTOM_P256R1, CryptoPrimitiveService=CRYPTO_SIGNATURE_GENERATE, CryptoPrimitiveAlgorithmSecondaryFamily=CRYPTO_ALGOFAM_SHA1, CryptoPrimitiveAlgorithmMode=CRYPTO_ALGOMODE_CUSTOM, CryptoPrimitiveAlgorithmModeCustomRef=Crypto_30_LibCv_P256r1
        EccNistP256R1GenerateSha256: CryptoPrimitiveAlgorithmFamily=CRYPTO_ALGOFAM_ECCNIST, CryptoPrimitiveAlgorithmMode=CRYPTO_ALGOMODE_CUSTOM_P256R1, CryptoPrimitiveService=CRYPTO_SIGNATURE_GENERATE, CryptoPrimitiveAlgorithmSecondaryFamily=CRYPTO_ALGOFAM_SHA2_256, CryptoPrimitiveAlgorithmMode=CRYPTO_ALGOMODE_CUSTOM, CryptoPrimitiveAlgorithmModeCustomRef=Crypto_30_LibCv_P256r1
        EccNistP256R1VerifySha1: CryptoPrimitiveAlgorithmFamily=CRYPTO_ALGOFAM_ECCNIST, CryptoPrimitiveAlgorithmMode=CRYPTO_ALGOMODE_CUSTOM_P256R1, CryptoPrimitiveService=CRYPTO_SIGNATURE_VERIFY, CryptoPrimitiveAlgorithmSecondaryFamily=CRYPTO_ALGOFAM_SHA1, CryptoPrimitiveAlgorithmMode=CRYPTO_ALGOMODE_CUSTOM, CryptoPrimitiveAlgorithmModeCustomRef=Crypto_30_LibCv_P256r1
        EccNistP256R1VerifySha256: CryptoPrimitiveAlgorithmFamily=CRYPTO_ALGOFAM_ECCNIST, CryptoPrimitiveAlgorithmMode=CRYPTO_ALGOMODE_CUSTOM_P256R1, CryptoPrimitiveService=CRYPTO_SIGNATURE_VERIFY, CryptoPrimitiveAlgorithmSecondaryFamily=CRYPTO_ALGOFAM_SHA2_256, CryptoPrimitiveAlgorithmMode=CRYPTO_ALGOMODE_CUSTOM, CryptoPrimitiveAlgorithmModeCustomRef=Crypto_30_LibCv_P256r1
        EccAnsiP256R1GenerateSha1: CryptoPrimitiveAlgorithmFamily=CRYPTO_ALGOFAM_CUSTOM_ECCANSI, CryptoPrimitiveAlgorithmMode=CRYPTO_ALGOMODE_CUSTOM_P256R1, CryptoPrimitiveService=CRYPTO_SIGNATURE_GENERATE, CryptoPrimitiveAlgorithmSecondaryFamily=CRYPTO_ALGOFAM_SHA1, CryptoPrimitiveAlgorithmMode=CRYPTO_ALGOMODE_CUSTOM, CryptoPrimitiveAlgorithmFamily=CRYPTO_ALGOFAM_CUSTOM, CryptoPrimitiveAlgorithmFamily=CRYPTO_ALGOFAM_ECCANSI, CryptoPrimitiveAlgorithmFamilyCustomRef=Crypto_30_LibCv_ECCANSI, CryptoPrimitiveAlgorithmModeCustomRef=Crypto_30_LibCv_P256r1
        EccAnsiP256R1GenerateSha256: CryptoPrimitiveAlgorithmFamily=CRYPTO_ALGOFAM_CUSTOM_ECCANSI, CryptoPrimitiveAlgorithmMode=CRYPTO_ALGOMODE_CUSTOM_P256R1, CryptoPrimitiveService=CRYPTO_SIGNATURE_GENERATE, CryptoPrimitiveAlgorithmSecondaryFamily=CRYPTO_ALGOFAM_SHA2_256, CryptoPrimitiveAlgorithmMode=CRYPTO_ALGOMODE_CUSTOM, CryptoPrimitiveAlgorithmFamily=CRYPTO_ALGOFAM_CUSTOM, CryptoPrimitiveAlgorithmFamily=CRYPTO_ALGOFAM_ECCANSI, CryptoPrimitiveAlgorithmFamilyCustomRef=Crypto_30_LibCv_ECCANSI, CryptoPrimitiveAlgorithmModeCustomRef=Crypto_30_LibCv_P256r1
        EccAnsiP256R1VerifySha1: CryptoPrimitiveAlgorithmFamily=CRYPTO_ALGOFAM_CUSTOM_ECCANSI, CryptoPrimitiveAlgorithmMode=CRYPTO_ALGOMODE_CUSTOM_P256R1, CryptoPrimitiveService=CRYPTO_SIGNATURE_VERIFY, CryptoPrimitiveAlgorithmSecondaryFamily=CRYPTO_ALGOFAM_SHA1, CryptoPrimitiveAlgorithmMode=CRYPTO_ALGOMODE_CUSTOM, CryptoPrimitiveAlgorithmFamily=CRYPTO_ALGOFAM_CUSTOM, CryptoPrimitiveAlgorithmFamily=CRYPTO_ALGOFAM_ECCANSI, CryptoPrimitiveAlgorithmFamilyCustomRef=Crypto_30_LibCv_ECCANSI, CryptoPrimitiveAlgorithmModeCustomRef=Crypto_30_LibCv_P256r1
        EccAnsiP256R1VerifySha256: CryptoPrimitiveAlgorithmFamily=CRYPTO_ALGOFAM_CUSTOM_ECCANSI, CryptoPrimitiveAlgorithmMode=CRYPTO_ALGOMODE_CUSTOM_P256R1, CryptoPrimitiveService=CRYPTO_SIGNATURE_VERIFY, CryptoPrimitiveAlgorithmSecondaryFamily=CRYPTO_ALGOFAM_SHA2_256, CryptoPrimitiveAlgorithmMode=CRYPTO_ALGOMODE_CUSTOM, CryptoPrimitiveAlgorithmFamily=CRYPTO_ALGOFAM_CUSTOM, CryptoPrimitiveAlgorithmFamily=CRYPTO_ALGOFAM_ECCANSI, CryptoPrimitiveAlgorithmFamilyCustomRef=Crypto_30_LibCv_ECCANSI, CryptoPrimitiveAlgorithmModeCustomRef=Crypto_30_LibCv_P256r1
        EccSecP256R1GenerateSha1: CryptoPrimitiveAlgorithmFamily=CRYPTO_ALGOFAM_CUSTOM_ECCSEC, CryptoPrimitiveAlgorithmMode=CRYPTO_ALGOMODE_CUSTOM_P256R1, CryptoPrimitiveService=CRYPTO_SIGNATURE_GENERATE, CryptoPrimitiveAlgorithmSecondaryFamily=CRYPTO_ALGOFAM_SHA1, CryptoPrimitiveAlgorithmMode=CRYPTO_ALGOMODE_CUSTOM, CryptoPrimitiveAlgorithmFamily=CRYPTO_ALGOFAM_CUSTOM, CryptoPrimitiveAlgorithmFamily=CRYPTO_ALGOFAM_ECCSEC, CryptoPrimitiveAlgorithmFamilyCustomRef=Crypto_30_LibCv_ECCSEC, CryptoPrimitiveAlgorithmModeCustomRef=Crypto_30_LibCv_P256r1
        EccSecP256R1GenerateSha256: CryptoPrimitiveAlgorithmFamily=CRYPTO_ALGOFAM_CUSTOM_ECCSEC, CryptoPrimitiveAlgorithmMode=CRYPTO_ALGOMODE_CUSTOM_P256R1, CryptoPrimitiveService=CRYPTO_SIGNATURE_GENERATE, CryptoPrimitiveAlgorithmSecondaryFamily=CRYPTO_ALGOFAM_SHA2_256, CryptoPrimitiveAlgorithmMode=CRYPTO_ALGOMODE_CUSTOM, CryptoPrimitiveAlgorithmFamily=CRYPTO_ALGOFAM_CUSTOM, CryptoPrimitiveAlgorithmFamily=CRYPTO_ALGOFAM_ECCSEC, CryptoPrimitiveAlgorithmFamilyCustomRef=Crypto_30_LibCv_ECCSEC, CryptoPrimitiveAlgorithmModeCustomRef=Crypto_30_LibCv_P256r1
        EccSecP256R1VerifySha1: CryptoPrimitiveAlgorithmFamily=CRYPTO_ALGOFAM_CUSTOM_ECCSEC, CryptoPrimitiveAlgorithmMode=CRYPTO_ALGOMODE_CUSTOM_P256R1, CryptoPrimitiveService=CRYPTO_SIGNATURE_VERIFY, CryptoPrimitiveAlgorithmSecondaryFamily=CRYPTO_ALGOFAM_SHA1, CryptoPrimitiveAlgorithmMode=CRYPTO_ALGOMODE_CUSTOM, CryptoPrimitiveAlgorithmFamily=CRYPTO_ALGOFAM_CUSTOM, CryptoPrimitiveAlgorithmFamily=CRYPTO_ALGOFAM_ECCSEC, CryptoPrimitiveAlgorithmFamilyCustomRef=Crypto_30_LibCv_ECCSEC, CryptoPrimitiveAlgorithmModeCustomRef=Crypto_30_LibCv_P256r1
        EccSecP256R1VerifySha256: CryptoPrimitiveAlgorithmFamily=CRYPTO_ALGOFAM_CUSTOM_ECCSEC, CryptoPrimitiveAlgorithmMode=CRYPTO_ALGOMODE_CUSTOM_P256R1, CryptoPrimitiveService=CRYPTO_SIGNATURE_VERIFY, CryptoPrimitiveAlgorithmSecondaryFamily=CRYPTO_ALGOFAM_SHA2_256, CryptoPrimitiveAlgorithmMode=CRYPTO_ALGOMODE_CUSTOM, CryptoPrimitiveAlgorithmFamily=CRYPTO_ALGOFAM_CUSTOM, CryptoPrimitiveAlgorithmFamily=CRYPTO_ALGOFAM_ECCSEC, CryptoPrimitiveAlgorithmFamilyCustomRef=Crypto_30_LibCv_ECCSEC, CryptoPrimitiveAlgorithmModeCustomRef=Crypto_30_LibCv_P256r1
        RngFips186: CryptoPrimitiveAlgorithmMode=CRYPTO_ALGOMODE_NOT_SET, CryptoPrimitiveService=CRYPTO_RANDOM, CryptoPrimitiveAlgorithmFamily=CRYPTO_ALGOFAM_RNG, CryptoPrimitiveAlgorithmSecondaryFamily=CRYPTO_ALGOFAM_NOT_SET
        RngDrbgAes128: CryptoPrimitiveAlgorithmMode=CRYPTO_ALGOMODE_NOT_SET, CryptoPrimitiveService=CRYPTO_RANDOM, CryptoPrimitiveAlgorithmFamily=CRYPTO_ALGOFAM_CUSTOM_DRBG, CryptoPrimitiveAlgorithmSecondaryFamily=CRYPTO_ALGOFAM_AES, CryptoPrimitiveAlgorithmFamily=CRYPTO_ALGOFAM_CUSTOM, CryptoPrimitiveAlgorithmFamilyCustomRef=Crypto_30_LibCv_DRBG
        RngDrbgAes128Df: CryptoPrimitiveAlgorithmMode=CRYPTO_ALGOMODE_CUSTOM_USE_DF, CryptoPrimitiveService=CRYPTO_RANDOM, CryptoPrimitiveAlgorithmFamily=CRYPTO_ALGOFAM_CUSTOM_DRBG, CryptoPrimitiveAlgorithmSecondaryFamily=CRYPTO_ALGOFAM_AES, CryptoPrimitiveAlgorithmFamily=CRYPTO_ALGOFAM_CUSTOM, CryptoPrimitiveAlgorithmMode=CRYPTO_ALGOMODE_CUSTOM, CryptoPrimitiveAlgorithmFamilyCustomRef=Crypto_30_LibCv_DRBG, CryptoPrimitiveAlgorithmModeCustomRef=Crypto_30_LibCv_UseDF
        RsaPkcs1CrtSha1Generate: CryptoPrimitiveAlgorithmFamily=CRYPTO_ALGOFAM_RSA, CryptoPrimitiveService=CRYPTO_SIGNATURE_GENERATE, CryptoPrimitiveAlgorithmMode=CRYPTO_ALGOMODE_CUSTOM_RSASSA_PKCS1_v1_5_CRT, CryptoPrimitiveAlgorithmSecondaryFamily=CRYPTO_ALGOFAM_SHA1, CryptoPrimitiveAlgorithmMode=CRYPTO_ALGOMODE_CUSTOM, CryptoPrimitiveAlgorithmModeCustomRef=Crypto_30_LibCv_RSASSA_PKCS1_v1_5_CRT
        RsaPkcs1CrtSha256Generate: CryptoPrimitiveAlgorithmFamily=CRYPTO_ALGOFAM_RSA, CryptoPrimitiveService=CRYPTO_SIGNATURE_GENERATE, CryptoPrimitiveAlgorithmMode=CRYPTO_ALGOMODE_CUSTOM_RSASSA_PKCS1_v1_5_CRT, CryptoPrimitiveAlgorithmSecondaryFamily=CRYPTO_ALGOFAM_SHA2_256, CryptoPrimitiveAlgorithmMode=CRYPTO_ALGOMODE_CUSTOM, CryptoPrimitiveAlgorithmModeCustomRef=Crypto_30_LibCv_RSASSA_PKCS1_v1_5_CRT
        EccNistP384R1GenerateWithoutPreHashing: CryptoPrimitiveAlgorithmFamily=CRYPTO_ALGOFAM_ECCNIST, CryptoPrimitiveAlgorithmMode=CRYPTO_ALGOMODE_CUSTOM_P384R1, CryptoPrimitiveService=CRYPTO_SIGNATURE_GENERATE, CryptoPrimitiveAlgorithmSecondaryFamily=CRYPTO_ALGOFAM_NOT_SET, CryptoPrimitiveAlgorithmMode=CRYPTO_ALGOMODE_CUSTOM, CryptoPrimitiveAlgorithmModeCustomRef=Crypto_30_LibCv_P384r1
        EccNistP384R1VerifyWithoutPreHashing: CryptoPrimitiveAlgorithmFamily=CRYPTO_ALGOFAM_ECCNIST, CryptoPrimitiveAlgorithmMode=CRYPTO_ALGOMODE_CUSTOM_P384R1, CryptoPrimitiveService=CRYPTO_SIGNATURE_VERIFY, CryptoPrimitiveAlgorithmSecondaryFamily=CRYPTO_ALGOFAM_NOT_SET, CryptoPrimitiveAlgorithmMode=CRYPTO_ALGOMODE_CUSTOM, CryptoPrimitiveAlgorithmModeCustomRef=Crypto_30_LibCv_P384r1
        EccSecP384R1GenerateWithoutPreHashing: CryptoPrimitiveAlgorithmFamily=CRYPTO_ALGOFAM_CUSTOM_ECCSEC, CryptoPrimitiveAlgorithmMode=CRYPTO_ALGOMODE_CUSTOM_P384R1, CryptoPrimitiveService=CRYPTO_SIGNATURE_GENERATE, CryptoPrimitiveAlgorithmSecondaryFamily=CRYPTO_ALGOFAM_NOT_SET, CryptoPrimitiveAlgorithmFamily=CRYPTO_ALGOFAM_CUSTOM, CryptoPrimitiveAlgorithmMode=CRYPTO_ALGOMODE_CUSTOM, CryptoPrimitiveAlgorithmFamily=CRYPTO_ALGOFAM_ECCSEC, CryptoPrimitiveAlgorithmModeCustomRef=Crypto_30_LibCv_P384r1, CryptoPrimitiveAlgorithmFamilyCustomRef=Crypto_30_LibCv_ECCSEC
        EccSecP384R1VerifyWithoutPreHashing: CryptoPrimitiveAlgorithmFamily=CRYPTO_ALGOFAM_CUSTOM_ECCSEC, CryptoPrimitiveAlgorithmMode=CRYPTO_ALGOMODE_CUSTOM_P384R1, CryptoPrimitiveService=CRYPTO_SIGNATURE_VERIFY, CryptoPrimitiveAlgorithmSecondaryFamily=CRYPTO_ALGOFAM_NOT_SET, CryptoPrimitiveAlgorithmFamily=CRYPTO_ALGOFAM_CUSTOM, CryptoPrimitiveAlgorithmMode=CRYPTO_ALGOMODE_CUSTOM, CryptoPrimitiveAlgorithmFamily=CRYPTO_ALGOFAM_ECCSEC, CryptoPrimitiveAlgorithmModeCustomRef=Crypto_30_LibCv_P384r1, CryptoPrimitiveAlgorithmFamilyCustomRef=Crypto_30_LibCv_ECCSEC
        EccNistP384R1GenerateSha1: CryptoPrimitiveAlgorithmFamily=CRYPTO_ALGOFAM_ECCNIST, CryptoPrimitiveAlgorithmMode=CRYPTO_ALGOMODE_CUSTOM_P384R1, CryptoPrimitiveService=CRYPTO_SIGNATURE_GENERATE, CryptoPrimitiveAlgorithmSecondaryFamily=CRYPTO_ALGOFAM_SHA1, CryptoPrimitiveAlgorithmMode=CRYPTO_ALGOMODE_CUSTOM, CryptoPrimitiveAlgorithmModeCustomRef=Crypto_30_LibCv_P384r1
        EccNistP384R1GenerateSha256: CryptoPrimitiveAlgorithmFamily=CRYPTO_ALGOFAM_ECCNIST, CryptoPrimitiveAlgorithmMode=CRYPTO_ALGOMODE_CUSTOM_P384R1, CryptoPrimitiveService=CRYPTO_SIGNATURE_GENERATE, CryptoPrimitiveAlgorithmSecondaryFamily=CRYPTO_ALGOFAM_SHA2_256, CryptoPrimitiveAlgorithmMode=CRYPTO_ALGOMODE_CUSTOM, CryptoPrimitiveAlgorithmModeCustomRef=Crypto_30_LibCv_P384r1
        EccNistP384R1VerifySha1: CryptoPrimitiveAlgorithmFamily=CRYPTO_ALGOFAM_ECCNIST, CryptoPrimitiveAlgorithmMode=CRYPTO_ALGOMODE_CUSTOM_P384R1, CryptoPrimitiveService=CRYPTO_SIGNATURE_VERIFY, CryptoPrimitiveAlgorithmSecondaryFamily=CRYPTO_ALGOFAM_SHA1, CryptoPrimitiveAlgorithmMode=CRYPTO_ALGOMODE_CUSTOM, CryptoPrimitiveAlgorithmModeCustomRef=Crypto_30_LibCv_P384r1
        EccNistP384R1VerifySha256: CryptoPrimitiveAlgorithmFamily=CRYPTO_ALGOFAM_ECCNIST, CryptoPrimitiveAlgorithmMode=CRYPTO_ALGOMODE_CUSTOM_P384R1, CryptoPrimitiveService=CRYPTO_SIGNATURE_VERIFY, CryptoPrimitiveAlgorithmSecondaryFamily=CRYPTO_ALGOFAM_SHA2_256, CryptoPrimitiveAlgorithmMode=CRYPTO_ALGOMODE_CUSTOM, CryptoPrimitiveAlgorithmModeCustomRef=Crypto_30_LibCv_P384r1
        EccSecP384R1GenerateSha1: CryptoPrimitiveAlgorithmFamily=CRYPTO_ALGOFAM_CUSTOM_ECCSEC, CryptoPrimitiveAlgorithmMode=CRYPTO_ALGOMODE_CUSTOM_P384R1, CryptoPrimitiveService=CRYPTO_SIGNATURE_GENERATE, CryptoPrimitiveAlgorithmSecondaryFamily=CRYPTO_ALGOFAM_SHA1, CryptoPrimitiveAlgorithmFamily=CRYPTO_ALGOFAM_CUSTOM, CryptoPrimitiveAlgorithmMode=CRYPTO_ALGOMODE_CUSTOM, CryptoPrimitiveAlgorithmFamily=CRYPTO_ALGOFAM_ECCSEC, CryptoPrimitiveAlgorithmFamilyCustomRef=Crypto_30_LibCv_ECCSEC, CryptoPrimitiveAlgorithmModeCustomRef=Crypto_30_LibCv_P384r1
        EccSecP384R1GenerateSha256: CryptoPrimitiveAlgorithmFamily=CRYPTO_ALGOFAM_CUSTOM_ECCSEC, CryptoPrimitiveAlgorithmMode=CRYPTO_ALGOMODE_CUSTOM_P384R1, CryptoPrimitiveService=CRYPTO_SIGNATURE_GENERATE, CryptoPrimitiveAlgorithmSecondaryFamily=CRYPTO_ALGOFAM_SHA2_256, CryptoPrimitiveAlgorithmFamily=CRYPTO_ALGOFAM_CUSTOM, CryptoPrimitiveAlgorithmMode=CRYPTO_ALGOMODE_CUSTOM, CryptoPrimitiveAlgorithmFamily=CRYPTO_ALGOFAM_ECCSEC, CryptoPrimitiveAlgorithmFamilyCustomRef=Crypto_30_LibCv_ECCSEC, CryptoPrimitiveAlgorithmModeCustomRef=Crypto_30_LibCv_P384r1
        EccSecP384R1VerifySha1: CryptoPrimitiveAlgorithmFamily=CRYPTO_ALGOFAM_CUSTOM_ECCSEC, CryptoPrimitiveAlgorithmMode=CRYPTO_ALGOMODE_CUSTOM_P384R1, CryptoPrimitiveService=CRYPTO_SIGNATURE_VERIFY, CryptoPrimitiveAlgorithmSecondaryFamily=CRYPTO_ALGOFAM_SHA1, CryptoPrimitiveAlgorithmFamily=CRYPTO_ALGOFAM_CUSTOM, CryptoPrimitiveAlgorithmMode=CRYPTO_ALGOMODE_CUSTOM, CryptoPrimitiveAlgorithmFamily=CRYPTO_ALGOFAM_ECCSEC, CryptoPrimitiveAlgorithmFamilyCustomRef=Crypto_30_LibCv_ECCSEC, CryptoPrimitiveAlgorithmModeCustomRef=Crypto_30_LibCv_P384r1
        EccSecP384R1VerifySha256: CryptoPrimitiveAlgorithmFamily=CRYPTO_ALGOFAM_CUSTOM_ECCSEC, CryptoPrimitiveAlgorithmMode=CRYPTO_ALGOMODE_CUSTOM_P384R1, CryptoPrimitiveService=CRYPTO_SIGNATURE_VERIFY, CryptoPrimitiveAlgorithmSecondaryFamily=CRYPTO_ALGOFAM_SHA2_256, CryptoPrimitiveAlgorithmFamily=CRYPTO_ALGOFAM_CUSTOM, CryptoPrimitiveAlgorithmMode=CRYPTO_ALGOMODE_CUSTOM, CryptoPrimitiveAlgorithmFamily=CRYPTO_ALGOFAM_ECCSEC, CryptoPrimitiveAlgorithmFamilyCustomRef=Crypto_30_LibCv_ECCSEC, CryptoPrimitiveAlgorithmModeCustomRef=Crypto_30_LibCv_P384r1
        RsaOaepSha1Encrypt: CryptoPrimitiveAlgorithmFamily=CRYPTO_ALGOFAM_RSA, CryptoPrimitiveAlgorithmMode=CRYPTO_ALGOMODE_RSAES_OAEP, CryptoPrimitiveAlgorithmSecondaryFamily=CRYPTO_ALGOFAM_SHA1, CryptoPrimitiveService=CRYPTO_ENCRYPT
        RsaOaepSha1Decrypt: CryptoPrimitiveAlgorithmFamily=CRYPTO_ALGOFAM_RSA, CryptoPrimitiveAlgorithmMode=CRYPTO_ALGOMODE_RSAES_OAEP, CryptoPrimitiveAlgorithmSecondaryFamily=CRYPTO_ALGOFAM_SHA1, CryptoPrimitiveService=CRYPTO_DECRYPT
        RsaOaepSha256Encrypt: CryptoPrimitiveAlgorithmFamily=CRYPTO_ALGOFAM_RSA, CryptoPrimitiveAlgorithmMode=CRYPTO_ALGOMODE_RSAES_OAEP, CryptoPrimitiveAlgorithmSecondaryFamily=CRYPTO_ALGOFAM_SHA2_256, CryptoPrimitiveService=CRYPTO_ENCRYPT
        RsaOaepSha256Decrypt: CryptoPrimitiveAlgorithmFamily=CRYPTO_ALGOFAM_RSA, CryptoPrimitiveAlgorithmMode=CRYPTO_ALGOMODE_RSAES_OAEP, CryptoPrimitiveAlgorithmSecondaryFamily=CRYPTO_ALGOFAM_SHA2_256, CryptoPrimitiveService=CRYPTO_DECRYPT
        RsaOaepCrtSha1Decrypt: CryptoPrimitiveAlgorithmFamily=CRYPTO_ALGOFAM_RSA, CryptoPrimitiveAlgorithmMode=CRYPTO_ALGOMODE_CUSTOM_RSAES_OAEP_CRT, CryptoPrimitiveAlgorithmSecondaryFamily=CRYPTO_ALGOFAM_SHA1, CryptoPrimitiveService=CRYPTO_DECRYPT, CryptoPrimitiveAlgorithmMode=CRYPTO_ALGOMODE_CUSTOM, CryptoPrimitiveAlgorithmModeCustomRef=Crypto_30_LibCv_RSAES_OAEP_CRT
        RsaOaepCrtSha256Decrypt: CryptoPrimitiveAlgorithmFamily=CRYPTO_ALGOFAM_RSA, CryptoPrimitiveAlgorithmMode=CRYPTO_ALGOMODE_CUSTOM_RSAES_OAEP_CRT, CryptoPrimitiveAlgorithmSecondaryFamily=CRYPTO_ALGOFAM_SHA2_256, CryptoPrimitiveService=CRYPTO_DECRYPT, CryptoPrimitiveAlgorithmMode=CRYPTO_ALGOMODE_CUSTOM, CryptoPrimitiveAlgorithmModeCustomRef=Crypto_30_LibCv_RSAES_OAEP_CRT
        EccNistP256R1GenerateSha512: CryptoPrimitiveAlgorithmFamily=CRYPTO_ALGOFAM_ECCNIST, CryptoPrimitiveAlgorithmMode=CRYPTO_ALGOMODE_CUSTOM_P256R1, CryptoPrimitiveService=CRYPTO_SIGNATURE_GENERATE, CryptoPrimitiveAlgorithmSecondaryFamily=CRYPTO_ALGOFAM_SHA2_512, CryptoPrimitiveAlgorithmMode=CRYPTO_ALGOMODE_CUSTOM, CryptoPrimitiveAlgorithmModeCustomRef=Crypto_30_LibCv_P256r1
        EccNistP256R1VerifySha512: CryptoPrimitiveAlgorithmFamily=CRYPTO_ALGOFAM_ECCNIST, CryptoPrimitiveAlgorithmMode=CRYPTO_ALGOMODE_CUSTOM_P256R1, CryptoPrimitiveService=CRYPTO_SIGNATURE_VERIFY, CryptoPrimitiveAlgorithmSecondaryFamily=CRYPTO_ALGOFAM_SHA2_512, CryptoPrimitiveAlgorithmMode=CRYPTO_ALGOMODE_CUSTOM, CryptoPrimitiveAlgorithmModeCustomRef=Crypto_30_LibCv_P256r1
        EccAnsiP256R1GenerateSha512: CryptoPrimitiveAlgorithmFamily=CRYPTO_ALGOFAM_CUSTOM_ECCANSI, CryptoPrimitiveAlgorithmMode=CRYPTO_ALGOMODE_CUSTOM_P256R1, CryptoPrimitiveService=CRYPTO_SIGNATURE_GENERATE, CryptoPrimitiveAlgorithmSecondaryFamily=CRYPTO_ALGOFAM_SHA2_512, CryptoPrimitiveAlgorithmFamily=CRYPTO_ALGOFAM_CUSTOM, CryptoPrimitiveAlgorithmMode=CRYPTO_ALGOMODE_CUSTOM, CryptoPrimitiveAlgorithmFamily=CRYPTO_ALGOFAM_ECCANSI, CryptoPrimitiveAlgorithmFamilyCustomRef=Crypto_30_LibCv_ECCANSI, CryptoPrimitiveAlgorithmModeCustomRef=Crypto_30_LibCv_P256r1
        EccAnsiP256R1VerifySha512: CryptoPrimitiveAlgorithmFamily=CRYPTO_ALGOFAM_CUSTOM_ECCANSI, CryptoPrimitiveAlgorithmMode=CRYPTO_ALGOMODE_CUSTOM_P256R1, CryptoPrimitiveService=CRYPTO_SIGNATURE_VERIFY, CryptoPrimitiveAlgorithmSecondaryFamily=CRYPTO_ALGOFAM_SHA2_512, CryptoPrimitiveAlgorithmFamily=CRYPTO_ALGOFAM_CUSTOM, CryptoPrimitiveAlgorithmMode=CRYPTO_ALGOMODE_CUSTOM, CryptoPrimitiveAlgorithmFamily=CRYPTO_ALGOFAM_ECCANSI, CryptoPrimitiveAlgorithmFamilyCustomRef=Crypto_30_LibCv_ECCANSI, CryptoPrimitiveAlgorithmModeCustomRef=Crypto_30_LibCv_P256r1
        EccSecP256R1GenerateSha512: CryptoPrimitiveAlgorithmFamily=CRYPTO_ALGOFAM_CUSTOM_ECCSEC, CryptoPrimitiveAlgorithmMode=CRYPTO_ALGOMODE_CUSTOM_P256R1, CryptoPrimitiveService=CRYPTO_SIGNATURE_GENERATE, CryptoPrimitiveAlgorithmSecondaryFamily=CRYPTO_ALGOFAM_SHA2_512, CryptoPrimitiveAlgorithmFamily=CRYPTO_ALGOFAM_CUSTOM, CryptoPrimitiveAlgorithmMode=CRYPTO_ALGOMODE_CUSTOM, CryptoPrimitiveAlgorithmFamily=CRYPTO_ALGOFAM_ECCSEC, CryptoPrimitiveAlgorithmFamilyCustomRef=Crypto_30_LibCv_ECCSEC, CryptoPrimitiveAlgorithmModeCustomRef=Crypto_30_LibCv_P256r1
        EccSecP256R1VerifySha512: CryptoPrimitiveAlgorithmFamily=CRYPTO_ALGOFAM_CUSTOM_ECCSEC, CryptoPrimitiveAlgorithmMode=CRYPTO_ALGOMODE_CUSTOM_P256R1, CryptoPrimitiveService=CRYPTO_SIGNATURE_VERIFY, CryptoPrimitiveAlgorithmSecondaryFamily=CRYPTO_ALGOFAM_SHA2_512, CryptoPrimitiveAlgorithmFamily=CRYPTO_ALGOFAM_CUSTOM, CryptoPrimitiveAlgorithmMode=CRYPTO_ALGOMODE_CUSTOM, CryptoPrimitiveAlgorithmFamily=CRYPTO_ALGOFAM_ECCSEC, CryptoPrimitiveAlgorithmFamilyCustomRef=Crypto_30_LibCv_ECCSEC, CryptoPrimitiveAlgorithmModeCustomRef=Crypto_30_LibCv_P256r1
        EccNistP384R1GenerateSha512: CryptoPrimitiveAlgorithmFamily=CRYPTO_ALGOFAM_ECCNIST, CryptoPrimitiveAlgorithmMode=CRYPTO_ALGOMODE_CUSTOM_P384R1, CryptoPrimitiveService=CRYPTO_SIGNATURE_GENERATE, CryptoPrimitiveAlgorithmSecondaryFamily=CRYPTO_ALGOFAM_SHA2_512, CryptoPrimitiveAlgorithmMode=CRYPTO_ALGOMODE_CUSTOM, CryptoPrimitiveAlgorithmModeCustomRef=Crypto_30_LibCv_P384r1
        EccNistP384R1VerifySha512: CryptoPrimitiveAlgorithmFamily=CRYPTO_ALGOFAM_ECCNIST, CryptoPrimitiveAlgorithmMode=CRYPTO_ALGOMODE_CUSTOM_P384R1, CryptoPrimitiveService=CRYPTO_SIGNATURE_VERIFY, CryptoPrimitiveAlgorithmSecondaryFamily=CRYPTO_ALGOFAM_SHA2_512, CryptoPrimitiveAlgorithmMode=CRYPTO_ALGOMODE_CUSTOM, CryptoPrimitiveAlgorithmModeCustomRef=Crypto_30_LibCv_P384r1
        EccSecP384R1GenerateSha512: CryptoPrimitiveAlgorithmFamily=CRYPTO_ALGOFAM_CUSTOM_ECCSEC, CryptoPrimitiveAlgorithmMode=CRYPTO_ALGOMODE_CUSTOM_P384R1, CryptoPrimitiveService=CRYPTO_SIGNATURE_GENERATE, CryptoPrimitiveAlgorithmSecondaryFamily=CRYPTO_ALGOFAM_SHA2_512, CryptoPrimitiveAlgorithmFamily=CRYPTO_ALGOFAM_CUSTOM, CryptoPrimitiveAlgorithmMode=CRYPTO_ALGOMODE_CUSTOM, CryptoPrimitiveAlgorithmFamily=CRYPTO_ALGOFAM_ECCSEC, CryptoPrimitiveAlgorithmFamilyCustomRef=Crypto_30_LibCv_ECCSEC, CryptoPrimitiveAlgorithmModeCustomRef=Crypto_30_LibCv_P384r1
        EccSecP384R1VerifySha512: CryptoPrimitiveAlgorithmFamily=CRYPTO_ALGOFAM_CUSTOM_ECCSEC, CryptoPrimitiveAlgorithmMode=CRYPTO_ALGOMODE_CUSTOM_P384R1, CryptoPrimitiveService=CRYPTO_SIGNATURE_VERIFY, CryptoPrimitiveAlgorithmSecondaryFamily=CRYPTO_ALGOFAM_SHA2_512, CryptoPrimitiveAlgorithmFamily=CRYPTO_ALGOFAM_CUSTOM, CryptoPrimitiveAlgorithmMode=CRYPTO_ALGOMODE_CUSTOM, CryptoPrimitiveAlgorithmFamily=CRYPTO_ALGOFAM_ECCSEC, CryptoPrimitiveAlgorithmFamilyCustomRef=Crypto_30_LibCv_ECCSEC, CryptoPrimitiveAlgorithmModeCustomRef=Crypto_30_LibCv_P384r1
        SHA384: CryptoPrimitiveAlgorithmSecondaryFamily=CRYPTO_ALGOFAM_NOT_SET, CryptoPrimitiveAlgorithmMode=CRYPTO_ALGOMODE_NOT_SET, CryptoPrimitiveService=CRYPTO_HASH, CryptoPrimitiveAlgorithmFamily=CRYPTO_ALGOFAM_SHA2_384
        EccNistP256R1GenerateSha384: CryptoPrimitiveAlgorithmFamily=CRYPTO_ALGOFAM_ECCNIST, CryptoPrimitiveAlgorithmMode=CRYPTO_ALGOMODE_CUSTOM_P256R1, CryptoPrimitiveService=CRYPTO_SIGNATURE_GENERATE, CryptoPrimitiveAlgorithmSecondaryFamily=CRYPTO_ALGOFAM_SHA2_384, CryptoPrimitiveAlgorithmMode=CRYPTO_ALGOMODE_CUSTOM, CryptoPrimitiveAlgorithmModeCustomRef=Crypto_30_LibCv_P256r1
        EccNistP256R1VerifySha384: CryptoPrimitiveAlgorithmFamily=CRYPTO_ALGOFAM_ECCNIST, CryptoPrimitiveAlgorithmMode=CRYPTO_ALGOMODE_CUSTOM_P256R1, CryptoPrimitiveService=CRYPTO_SIGNATURE_VERIFY, CryptoPrimitiveAlgorithmSecondaryFamily=CRYPTO_ALGOFAM_SHA2_384, CryptoPrimitiveAlgorithmMode=CRYPTO_ALGOMODE_CUSTOM, CryptoPrimitiveAlgorithmModeCustomRef=Crypto_30_LibCv_P256r1
        EccAnsiP256R1GenerateSha384: CryptoPrimitiveAlgorithmFamily=CRYPTO_ALGOFAM_CUSTOM_ECCANSI, CryptoPrimitiveAlgorithmMode=CRYPTO_ALGOMODE_CUSTOM_P256R1, CryptoPrimitiveService=CRYPTO_SIGNATURE_GENERATE, CryptoPrimitiveAlgorithmSecondaryFamily=CRYPTO_ALGOFAM_SHA2_384, CryptoPrimitiveAlgorithmFamily=CRYPTO_ALGOFAM_CUSTOM, CryptoPrimitiveAlgorithmMode=CRYPTO_ALGOMODE_CUSTOM, CryptoPrimitiveAlgorithmFamily=CRYPTO_ALGOFAM_ECCANSI, CryptoPrimitiveAlgorithmFamilyCustomRef=Crypto_30_LibCv_ECCANSI, CryptoPrimitiveAlgorithmModeCustomRef=Crypto_30_LibCv_P256r1
        EccAnsiP256R1VerifySha384: CryptoPrimitiveAlgorithmFamily=CRYPTO_ALGOFAM_CUSTOM_ECCANSI, CryptoPrimitiveAlgorithmMode=CRYPTO_ALGOMODE_CUSTOM_P256R1, CryptoPrimitiveService=CRYPTO_SIGNATURE_VERIFY, CryptoPrimitiveAlgorithmSecondaryFamily=CRYPTO_ALGOFAM_SHA2_384, CryptoPrimitiveAlgorithmFamily=CRYPTO_ALGOFAM_CUSTOM, CryptoPrimitiveAlgorithmMode=CRYPTO_ALGOMODE_CUSTOM, CryptoPrimitiveAlgorithmFamily=CRYPTO_ALGOFAM_ECCANSI, CryptoPrimitiveAlgorithmFamilyCustomRef=Crypto_30_LibCv_ECCANSI, CryptoPrimitiveAlgorithmModeCustomRef=Crypto_30_LibCv_P256r1
        EccSecP256R1GenerateSha384: CryptoPrimitiveAlgorithmFamily=CRYPTO_ALGOFAM_CUSTOM_ECCSEC, CryptoPrimitiveAlgorithmMode=CRYPTO_ALGOMODE_CUSTOM_P256R1, CryptoPrimitiveService=CRYPTO_SIGNATURE_GENERATE, CryptoPrimitiveAlgorithmSecondaryFamily=CRYPTO_ALGOFAM_SHA2_384, CryptoPrimitiveAlgorithmFamily=CRYPTO_ALGOFAM_CUSTOM, CryptoPrimitiveAlgorithmMode=CRYPTO_ALGOMODE_CUSTOM, CryptoPrimitiveAlgorithmFamily=CRYPTO_ALGOFAM_ECCSEC, CryptoPrimitiveAlgorithmFamilyCustomRef=Crypto_30_LibCv_ECCSEC, CryptoPrimitiveAlgorithmModeCustomRef=Crypto_30_LibCv_P256r1
        EccSecP256R1VerifySha384: CryptoPrimitiveAlgorithmFamily=CRYPTO_ALGOFAM_CUSTOM_ECCSEC, CryptoPrimitiveAlgorithmMode=CRYPTO_ALGOMODE_CUSTOM_P256R1, CryptoPrimitiveService=CRYPTO_SIGNATURE_VERIFY, CryptoPrimitiveAlgorithmSecondaryFamily=CRYPTO_ALGOFAM_SHA2_384, CryptoPrimitiveAlgorithmFamily=CRYPTO_ALGOFAM_CUSTOM, CryptoPrimitiveAlgorithmMode=CRYPTO_ALGOMODE_CUSTOM, CryptoPrimitiveAlgorithmFamily=CRYPTO_ALGOFAM_ECCSEC, CryptoPrimitiveAlgorithmFamilyCustomRef=Crypto_30_LibCv_ECCSEC, CryptoPrimitiveAlgorithmModeCustomRef=Crypto_30_LibCv_P256r1
        EccNistP384R1GenerateSha384: CryptoPrimitiveAlgorithmFamily=CRYPTO_ALGOFAM_ECCNIST, CryptoPrimitiveAlgorithmMode=CRYPTO_ALGOMODE_CUSTOM_P384R1, CryptoPrimitiveService=CRYPTO_SIGNATURE_GENERATE, CryptoPrimitiveAlgorithmSecondaryFamily=CRYPTO_ALGOFAM_SHA2_384, CryptoPrimitiveAlgorithmMode=CRYPTO_ALGOMODE_CUSTOM, CryptoPrimitiveAlgorithmModeCustomRef=Crypto_30_LibCv_P384r1
        EccNistP384R1VerifySha384: CryptoPrimitiveAlgorithmFamily=CRYPTO_ALGOFAM_ECCNIST, CryptoPrimitiveAlgorithmMode=CRYPTO_ALGOMODE_CUSTOM_P384R1, CryptoPrimitiveService=CRYPTO_SIGNATURE_VERIFY, CryptoPrimitiveAlgorithmSecondaryFamily=CRYPTO_ALGOFAM_SHA2_384, CryptoPrimitiveAlgorithmMode=CRYPTO_ALGOMODE_CUSTOM, CryptoPrimitiveAlgorithmModeCustomRef=Crypto_30_LibCv_P384r1
        EccSecP384R1GenerateSha384: CryptoPrimitiveAlgorithmFamily=CRYPTO_ALGOFAM_CUSTOM_ECCSEC, CryptoPrimitiveAlgorithmMode=CRYPTO_ALGOMODE_CUSTOM_P384R1, CryptoPrimitiveService=CRYPTO_SIGNATURE_GENERATE, CryptoPrimitiveAlgorithmSecondaryFamily=CRYPTO_ALGOFAM_SHA2_384, CryptoPrimitiveAlgorithmFamily=CRYPTO_ALGOFAM_CUSTOM, CryptoPrimitiveAlgorithmMode=CRYPTO_ALGOMODE_CUSTOM, CryptoPrimitiveAlgorithmFamily=CRYPTO_ALGOFAM_ECCSEC, CryptoPrimitiveAlgorithmFamilyCustomRef=Crypto_30_LibCv_ECCSEC, CryptoPrimitiveAlgorithmModeCustomRef=Crypto_30_LibCv_P384r1
        EccSecP384R1VerifySha384: CryptoPrimitiveAlgorithmFamily=CRYPTO_ALGOFAM_CUSTOM_ECCSEC, CryptoPrimitiveAlgorithmMode=CRYPTO_ALGOMODE_CUSTOM_P384R1, CryptoPrimitiveService=CRYPTO_SIGNATURE_VERIFY, CryptoPrimitiveAlgorithmSecondaryFamily=CRYPTO_ALGOFAM_SHA2_384, CryptoPrimitiveAlgorithmFamily=CRYPTO_ALGOFAM_CUSTOM, CryptoPrimitiveAlgorithmMode=CRYPTO_ALGOMODE_CUSTOM, CryptoPrimitiveAlgorithmFamily=CRYPTO_ALGOFAM_ECCSEC, CryptoPrimitiveAlgorithmFamilyCustomRef=Crypto_30_LibCv_ECCSEC, CryptoPrimitiveAlgorithmModeCustomRef=Crypto_30_LibCv_P384r1
        GmacAesGenerate: CryptoPrimitiveAlgorithmSecondaryFamily=CRYPTO_ALGOFAM_NOT_SET, CryptoPrimitiveAlgorithmMode=CRYPTO_ALGOMODE_GMAC, CryptoPrimitiveService=CRYPTO_MAC_GENERATE, CryptoPrimitiveAlgorithmFamily=CRYPTO_ALGOFAM_AES
        GmacAesVerify: CryptoPrimitiveAlgorithmSecondaryFamily=CRYPTO_ALGOFAM_NOT_SET, CryptoPrimitiveAlgorithmMode=CRYPTO_ALGOMODE_GMAC, CryptoPrimitiveService=CRYPTO_MAC_VERIFY, CryptoPrimitiveAlgorithmFamily=CRYPTO_ALGOFAM_AES
        HmacSha384Generate: CryptoPrimitiveAlgorithmFamily=CRYPTO_ALGOFAM_SHA2_384, CryptoPrimitiveAlgorithmMode=CRYPTO_ALGOMODE_HMAC, CryptoPrimitiveAlgorithmSecondaryFamily=CRYPTO_ALGOFAM_NOT_SET, CryptoPrimitiveService=CRYPTO_MAC_GENERATE
        HmacSha384Verify: CryptoPrimitiveAlgorithmFamily=CRYPTO_ALGOFAM_SHA2_384, CryptoPrimitiveAlgorithmMode=CRYPTO_ALGOMODE_HMAC, CryptoPrimitiveAlgorithmSecondaryFamily=CRYPTO_ALGOFAM_NOT_SET, CryptoPrimitiveService=CRYPTO_MAC_VERIFY
        KeySetValid: CryptoPrimitiveService=CRYPTO_KEY_SET_VALID, CryptoPrimitiveAlgorithmFamily=CRYPTO_ALGOFAM_NOT_SET, CryptoPrimitiveAlgorithmMode=CRYPTO_ALGOMODE_NOT_SET, CryptoPrimitiveAlgorithmSecondaryFamily=CRYPTO_ALGOFAM_NOT_SET
        KeyDeriveX963SHA256: CryptoPrimitiveService=CRYPTO_KEY_DERIVE, CryptoPrimitiveAlgorithmFamily=CRYPTO_ALGOFAM_KDFX963, CryptoPrimitiveAlgorithmMode=CRYPTO_ALGOMODE_NOT_SET, CryptoPrimitiveAlgorithmSecondaryFamily=CRYPTO_ALGOFAM_SHA2_256
        KeyExchangeCalcPubValX25519: CryptoPrimitiveService=CRYPTO_KEY_EXCHANGE_CALC_PUBVAL, CryptoPrimitiveAlgorithmFamily=CRYPTO_ALGOFAM_CUSTOM_X25519, CryptoPrimitiveAlgorithmMode=CRYPTO_ALGOMODE_NOT_SET, CryptoPrimitiveAlgorithmSecondaryFamily=CRYPTO_ALGOFAM_NOT_SET, CryptoPrimitiveAlgorithmFamily=CRYPTO_ALGOFAM_CUSTOM, CryptoPrimitiveAlgorithmFamily=CRYPTO_ALGOFAM_X25519, CryptoPrimitiveAlgorithmFamilyCustomRef=Crypto_30_LibCv_X25519
        KeyExchangeCalcSecretX25519: CryptoPrimitiveService=CRYPTO_KEY_EXCHANGE_CALC_SECRET, CryptoPrimitiveAlgorithmFamily=CRYPTO_ALGOFAM_CUSTOM_X25519, CryptoPrimitiveAlgorithmMode=CRYPTO_ALGOMODE_NOT_SET, CryptoPrimitiveAlgorithmSecondaryFamily=CRYPTO_ALGOFAM_NOT_SET, CryptoPrimitiveAlgorithmFamily=CRYPTO_ALGOFAM_CUSTOM, CryptoPrimitiveAlgorithmFamily=CRYPTO_ALGOFAM_X25519, CryptoPrimitiveAlgorithmFamilyCustomRef=Crypto_30_LibCv_X25519
        KeyExchangeCalcPubValSecP256R1: CryptoPrimitiveService=CRYPTO_KEY_EXCHANGE_CALC_PUBVAL, CryptoPrimitiveAlgorithmFamily=CRYPTO_ALGOFAM_ECCSEC, CryptoPrimitiveAlgorithmMode=CRYPTO_ALGOMODE_CUSTOM_P256R1, CryptoPrimitiveAlgorithmSecondaryFamily=CRYPTO_ALGOFAM_NOT_SET, CryptoPrimitiveAlgorithmMode=CRYPTO_ALGOMODE_CUSTOM, CryptoPrimitiveAlgorithmModeCustomRef=Crypto_30_LibCv_P256r1
        KeyExchangeCalcPubValSecP384R1: CryptoPrimitiveService=CRYPTO_KEY_EXCHANGE_CALC_PUBVAL, CryptoPrimitiveAlgorithmFamily=CRYPTO_ALGOFAM_ECCSEC, CryptoPrimitiveAlgorithmMode=CRYPTO_ALGOMODE_CUSTOM_P384R1, CryptoPrimitiveAlgorithmSecondaryFamily=CRYPTO_ALGOFAM_NOT_SET, CryptoPrimitiveAlgorithmMode=CRYPTO_ALGOMODE_CUSTOM, CryptoPrimitiveAlgorithmModeCustomRef=Crypto_30_LibCv_P384r1
        KeyExchangeCalcSecretSecP256R1: CryptoPrimitiveService=CRYPTO_KEY_EXCHANGE_CALC_SECRET, CryptoPrimitiveAlgorithmFamily=CRYPTO_ALGOFAM_ECCSEC, CryptoPrimitiveAlgorithmMode=CRYPTO_ALGOMODE_CUSTOM_P256R1, CryptoPrimitiveAlgorithmSecondaryFamily=CRYPTO_ALGOFAM_NOT_SET, CryptoPrimitiveAlgorithmMode=CRYPTO_ALGOMODE_CUSTOM, CryptoPrimitiveAlgorithmModeCustomRef=Crypto_30_LibCv_P256r1
        KeyExchangeCalcSecretSecP384R1: CryptoPrimitiveService=CRYPTO_KEY_EXCHANGE_CALC_SECRET, CryptoPrimitiveAlgorithmFamily=CRYPTO_ALGOFAM_ECCSEC, CryptoPrimitiveAlgorithmMode=CRYPTO_ALGOMODE_CUSTOM_P384R1, CryptoPrimitiveAlgorithmSecondaryFamily=CRYPTO_ALGOFAM_NOT_SET, CryptoPrimitiveAlgorithmMode=CRYPTO_ALGOMODE_CUSTOM, CryptoPrimitiveAlgorithmModeCustomRef=Crypto_30_LibCv_P384r1
        KeyExchangeCalcPubValAnsiP256R1: CryptoPrimitiveService=CRYPTO_KEY_EXCHANGE_CALC_PUBVAL, CryptoPrimitiveAlgorithmFamily=CRYPTO_ALGOFAM_ECCANSI, CryptoPrimitiveAlgorithmMode=CRYPTO_ALGOMODE_CUSTOM_P256R1, CryptoPrimitiveAlgorithmSecondaryFamily=CRYPTO_ALGOFAM_NOT_SET, CryptoPrimitiveAlgorithmMode=CRYPTO_ALGOMODE_CUSTOM, CryptoPrimitiveAlgorithmModeCustomRef=Crypto_30_LibCv_P256r1
        KeyExchangeCalcSecretAnsiP256R1: CryptoPrimitiveService=CRYPTO_KEY_EXCHANGE_CALC_SECRET, CryptoPrimitiveAlgorithmFamily=CRYPTO_ALGOFAM_ECCANSI, CryptoPrimitiveAlgorithmMode=CRYPTO_ALGOMODE_CUSTOM_P256R1, CryptoPrimitiveAlgorithmSecondaryFamily=CRYPTO_ALGOFAM_NOT_SET, CryptoPrimitiveAlgorithmMode=CRYPTO_ALGOMODE_CUSTOM, CryptoPrimitiveAlgorithmModeCustomRef=Crypto_30_LibCv_P256r1
        KeyExchangeCalcPubValNistP256R1: CryptoPrimitiveService=CRYPTO_KEY_EXCHANGE_CALC_PUBVAL, CryptoPrimitiveAlgorithmFamily=CRYPTO_ALGOFAM_ECCNIST, CryptoPrimitiveAlgorithmMode=CRYPTO_ALGOMODE_CUSTOM_P256R1, CryptoPrimitiveAlgorithmSecondaryFamily=CRYPTO_ALGOFAM_NOT_SET, CryptoPrimitiveAlgorithmMode=CRYPTO_ALGOMODE_CUSTOM, CryptoPrimitiveAlgorithmModeCustomRef=Crypto_30_LibCv_P256r1
        KeyExchangeCalcSecretNistP256R1: CryptoPrimitiveService=CRYPTO_KEY_EXCHANGE_CALC_SECRET, CryptoPrimitiveAlgorithmFamily=CRYPTO_ALGOFAM_ECCNIST, CryptoPrimitiveAlgorithmMode=CRYPTO_ALGOMODE_CUSTOM_P256R1, CryptoPrimitiveAlgorithmSecondaryFamily=CRYPTO_ALGOFAM_NOT_SET, CryptoPrimitiveAlgorithmMode=CRYPTO_ALGOMODE_CUSTOM, CryptoPrimitiveAlgorithmModeCustomRef=Crypto_30_LibCv_P256r1
        KeyExchangeCalcPubValNistP384R1: CryptoPrimitiveService=CRYPTO_KEY_EXCHANGE_CALC_PUBVAL, CryptoPrimitiveAlgorithmFamily=CRYPTO_ALGOFAM_ECCNIST, CryptoPrimitiveAlgorithmMode=CRYPTO_ALGOMODE_CUSTOM_P384R1, CryptoPrimitiveAlgorithmSecondaryFamily=CRYPTO_ALGOFAM_NOT_SET, CryptoPrimitiveAlgorithmMode=CRYPTO_ALGOMODE_CUSTOM, CryptoPrimitiveAlgorithmModeCustomRef=Crypto_30_LibCv_P384r1
        KeyExchangeCalcSecretNistP384R1: CryptoPrimitiveService=CRYPTO_KEY_EXCHANGE_CALC_SECRET, CryptoPrimitiveAlgorithmFamily=CRYPTO_ALGOFAM_ECCNIST, CryptoPrimitiveAlgorithmMode=CRYPTO_ALGOMODE_CUSTOM_P384R1, CryptoPrimitiveAlgorithmSecondaryFamily=CRYPTO_ALGOFAM_NOT_SET, CryptoPrimitiveAlgorithmMode=CRYPTO_ALGOMODE_CUSTOM, CryptoPrimitiveAlgorithmModeCustomRef=Crypto_30_LibCv_P384r1
        RandomSeedRngFips186Sha1: CryptoPrimitiveAlgorithmMode=CRYPTO_ALGOMODE_NOT_SET, CryptoPrimitiveService=CRYPTO_RANDOM_SEED, CryptoPrimitiveAlgorithmFamily=CRYPTO_ALGOFAM_FIPS186, CryptoPrimitiveAlgorithmSecondaryFamily=CRYPTO_ALGOFAM_SHA1
        RandomSeedRngDrbgAes128: CryptoPrimitiveAlgorithmMode=CRYPTO_ALGOMODE_NOT_SET, CryptoPrimitiveService=CRYPTO_RANDOM_SEED, CryptoPrimitiveAlgorithmFamily=CRYPTO_ALGOFAM_DRBG, CryptoPrimitiveAlgorithmSecondaryFamily=CRYPTO_ALGOFAM_AES
        RandomSeedRngDrbgAes128Df: CryptoPrimitiveAlgorithmMode=CRYPTO_ALGOMODE_CUSTOM_USE_DF, CryptoPrimitiveService=CRYPTO_RANDOM_SEED, CryptoPrimitiveAlgorithmFamily=CRYPTO_ALGOFAM_DRBG, CryptoPrimitiveAlgorithmSecondaryFamily=CRYPTO_ALGOFAM_AES, CryptoPrimitiveAlgorithmMode=CRYPTO_ALGOMODE_CUSTOM, CryptoPrimitiveAlgorithmModeCustomRef=Crypto_30_LibCv_UseDF
        KeyDeriveIso15118: CryptoPrimitiveService=CRYPTO_KEY_DERIVE, CryptoPrimitiveAlgorithmFamily=CRYPTO_ALGOFAM_CUSTOM_ISO15118, CryptoPrimitiveAlgorithmMode=CRYPTO_ALGOMODE_NOT_SET, CryptoPrimitiveAlgorithmSecondaryFamily=CRYPTO_ALGOFAM_NOT_SET, CryptoPrimitiveAlgorithmFamily=CRYPTO_ALGOFAM_CUSTOM, CryptoPrimitiveAlgorithmFamilyCustomRef=Crypto_30_LibCv_ISO15118
        KeyDeriveSymNist800108CntModeSha256: CryptoPrimitiveService=CRYPTO_KEY_DERIVE, CryptoPrimitiveAlgorithmFamily=CRYPTO_ALGOFAM_NOT_SET, CryptoPrimitiveAlgorithmMode=CRYPTO_ALGOMODE_CTR, CryptoPrimitiveAlgorithmSecondaryFamily=CRYPTO_ALGOFAM_SHA2_256
        KeyDeriveAsymNistFips1864Erb: CryptoPrimitiveService=CRYPTO_KEY_DERIVE, CryptoPrimitiveAlgorithmFamily=CRYPTO_ALGOFAM_FIPS186, CryptoPrimitiveAlgorithmMode=CRYPTO_ALGOMODE_NOT_SET, CryptoPrimitiveAlgorithmSecondaryFamily=CRYPTO_ALGOFAM_SHA2_256
        KeyDeriveNist80056AOnePassSha256: CryptoPrimitiveService=CRYPTO_KEY_DERIVE, CryptoPrimitiveAlgorithmFamily=CRYPTO_ALGOFAM_DH, CryptoPrimitiveAlgorithmMode=CRYPTO_ALGOMODE_CUSTOM_P256R1, CryptoPrimitiveAlgorithmSecondaryFamily=CRYPTO_ALGOFAM_SHA2_256, CryptoPrimitiveAlgorithmMode=CRYPTO_ALGOMODE_CUSTOM, CryptoPrimitiveAlgorithmModeCustomRef=Crypto_30_LibCv_P256r1
        KeyGenerateSymmetricGeneric: CryptoPrimitiveService=CRYPTO_KEY_GENERATE, CryptoPrimitiveAlgorithmFamily=CRYPTO_ALGOFAM_NOT_SET, CryptoPrimitiveAlgorithmMode=CRYPTO_ALGOMODE_NOT_SET, CryptoPrimitiveAlgorithmSecondaryFamily=CRYPTO_ALGOFAM_NOT_SET
        KeyGenerateSecP256R1: CryptoPrimitiveService=CRYPTO_KEY_GENERATE, CryptoPrimitiveAlgorithmFamily=CRYPTO_ALGOFAM_ECCSEC, CryptoPrimitiveAlgorithmMode=CRYPTO_ALGOMODE_CUSTOM_P256R1, CryptoPrimitiveAlgorithmSecondaryFamily=CRYPTO_ALGOFAM_NOT_SET, CryptoPrimitiveAlgorithmMode=CRYPTO_ALGOMODE_CUSTOM, CryptoPrimitiveAlgorithmModeCustomRef=Crypto_30_LibCv_P256r1
        KeyGenerateSecP384R1: CryptoPrimitiveService=CRYPTO_KEY_GENERATE, CryptoPrimitiveAlgorithmFamily=CRYPTO_ALGOFAM_ECCSEC, CryptoPrimitiveAlgorithmMode=CRYPTO_ALGOMODE_CUSTOM_P384R1, CryptoPrimitiveAlgorithmSecondaryFamily=CRYPTO_ALGOFAM_NOT_SET, CryptoPrimitiveAlgorithmMode=CRYPTO_ALGOMODE_CUSTOM, CryptoPrimitiveAlgorithmModeCustomRef=Crypto_30_LibCv_P384r1
        KeyGenerateNistP256R1: CryptoPrimitiveService=CRYPTO_KEY_GENERATE, CryptoPrimitiveAlgorithmFamily=CRYPTO_ALGOFAM_ECCNIST, CryptoPrimitiveAlgorithmMode=CRYPTO_ALGOMODE_CUSTOM_P256R1, CryptoPrimitiveAlgorithmSecondaryFamily=CRYPTO_ALGOFAM_NOT_SET, CryptoPrimitiveAlgorithmMode=CRYPTO_ALGOMODE_CUSTOM, CryptoPrimitiveAlgorithmModeCustomRef=Crypto_30_LibCv_P256r1
        KeyGenerateNistP384R1: CryptoPrimitiveService=CRYPTO_KEY_GENERATE, CryptoPrimitiveAlgorithmFamily=CRYPTO_ALGOFAM_ECCNIST, CryptoPrimitiveAlgorithmMode=CRYPTO_ALGOMODE_CUSTOM_P384R1, CryptoPrimitiveAlgorithmSecondaryFamily=CRYPTO_ALGOFAM_NOT_SET, CryptoPrimitiveAlgorithmMode=CRYPTO_ALGOMODE_CUSTOM, CryptoPrimitiveAlgorithmModeCustomRef=Crypto_30_LibCv_P384r1
        KeyGenerateAnsiP256R1: CryptoPrimitiveService=CRYPTO_KEY_GENERATE, CryptoPrimitiveAlgorithmFamily=CRYPTO_ALGOFAM_ECCANSI, CryptoPrimitiveAlgorithmMode=CRYPTO_ALGOMODE_CUSTOM_P256R1, CryptoPrimitiveAlgorithmSecondaryFamily=CRYPTO_ALGOFAM_NOT_SET, CryptoPrimitiveAlgorithmMode=CRYPTO_ALGOMODE_CUSTOM, CryptoPrimitiveAlgorithmModeCustomRef=Crypto_30_LibCv_P256r1
        HmacRipemd160Generate: CryptoPrimitiveService=CRYPTO_MAC_GENERATE, CryptoPrimitiveAlgorithmMode=CRYPTO_ALGOMODE_HMAC, CryptoPrimitiveAlgorithmFamily=CRYPTO_ALGOFAM_RIPEMD160, CryptoPrimitiveAlgorithmSecondaryFamily=CRYPTO_ALGOFAM_NOT_SET
        HmacRipemd160Verify: CryptoPrimitiveService=CRYPTO_MAC_VERIFY, CryptoPrimitiveAlgorithmMode=CRYPTO_ALGOMODE_HMAC, CryptoPrimitiveAlgorithmFamily=CRYPTO_ALGOFAM_RIPEMD160, CryptoPrimitiveAlgorithmSecondaryFamily=CRYPTO_ALGOFAM_NOT_SET
        EccSecP160R1GenerateWithoutPreHashing: CryptoPrimitiveService=CRYPTO_SIGNATURE_GENERATE, CryptoPrimitiveAlgorithmMode=CRYPTO_ALGOMODE_CUSTOM_P160R1, CryptoPrimitiveAlgorithmFamily=CRYPTO_ALGOFAM_ECCSEC, CryptoPrimitiveAlgorithmSecondaryFamily=CRYPTO_ALGOFAM_NOT_SET, CryptoPrimitiveAlgorithmMode=CRYPTO_ALGOMODE_CUSTOM, CryptoPrimitiveAlgorithmModeCustomRef=Crypto_30_LibCv_P160r1
        EccSecP160R1VerifyWithoutPreHashing: CryptoPrimitiveService=CRYPTO_SIGNATURE_VERIFY, CryptoPrimitiveAlgorithmMode=CRYPTO_ALGOMODE_CUSTOM_P160R1, CryptoPrimitiveAlgorithmFamily=CRYPTO_ALGOFAM_ECCSEC, CryptoPrimitiveAlgorithmSecondaryFamily=CRYPTO_ALGOFAM_NOT_SET, CryptoPrimitiveAlgorithmMode=CRYPTO_ALGOMODE_CUSTOM, CryptoPrimitiveAlgorithmModeCustomRef=Crypto_30_LibCv_P160r1
        HashRipemd160: CryptoPrimitiveService=CRYPTO_HASH, CryptoPrimitiveAlgorithmMode=CRYPTO_ALGOMODE_NOT_SET, CryptoPrimitiveAlgorithmFamily=CRYPTO_ALGOFAM_RIPEMD160, CryptoPrimitiveAlgorithmSecondaryFamily=CRYPTO_ALGOFAM_NOT_SET
        KeyDerivePbkdf2HmacSha1: CryptoPrimitiveService=CRYPTO_KEY_DERIVE, CryptoPrimitiveAlgorithmFamily=CRYPTO_ALGOFAM_PBKDF2, CryptoPrimitiveAlgorithmMode=CRYPTO_ALGOMODE_HMAC, CryptoPrimitiveAlgorithmSecondaryFamily=CRYPTO_ALGOFAM_SHA1
        KeyDerivePbkdf2HmacSha256: CryptoPrimitiveService=CRYPTO_KEY_DERIVE, CryptoPrimitiveAlgorithmFamily=CRYPTO_ALGOFAM_PBKDF2, CryptoPrimitiveAlgorithmMode=CRYPTO_ALGOMODE_HMAC, CryptoPrimitiveAlgorithmSecondaryFamily=CRYPTO_ALGOFAM_SHA2_256
        KeyDeriveX963SHA512: CryptoPrimitiveService=CRYPTO_KEY_DERIVE, CryptoPrimitiveAlgorithmMode=CRYPTO_ALGOMODE_NOT_SET, CryptoPrimitiveAlgorithmFamily=CRYPTO_ALGOFAM_KDFX963, CryptoPrimitiveAlgorithmSecondaryFamily=CRYPTO_ALGOFAM_SHA2_512
        AeadChaCha20Poly1305Encrypt: CryptoPrimitiveService=CRYPTO_AEADENCRYPT, CryptoPrimitiveAlgorithmMode=CRYPTO_ALGOMODE_20ROUNDS, CryptoPrimitiveAlgorithmFamily=CRYPTO_ALGOFAM_CHACHA, CryptoPrimitiveAlgorithmSecondaryFamily=CRYPTO_ALGOFAM_CUSTOM, CryptoPrimitiveAlgorithmSecondaryFamily=CRYPTO_ALGOFAM_CUSTOM_POLY_1305, CryptoPrimitiveAlgorithmSecondaryFamily=CRYPTO_ALGOFAM_POLY1305, CryptoPrimitiveAlgorithmSecondaryFamilyCustomRef=Crypto_30_LibCv_POLY1305
        AeadChaCha20Poly1305Decrypt: CryptoPrimitiveService=CRYPTO_AEADDECRYPT, CryptoPrimitiveAlgorithmMode=CRYPTO_ALGOMODE_20ROUNDS, CryptoPrimitiveAlgorithmFamily=CRYPTO_ALGOFAM_CHACHA, CryptoPrimitiveAlgorithmSecondaryFamily=CRYPTO_ALGOFAM_CUSTOM, CryptoPrimitiveAlgorithmSecondaryFamily=CRYPTO_ALGOFAM_CUSTOM_POLY_1305, CryptoPrimitiveAlgorithmSecondaryFamily=CRYPTO_ALGOFAM_POLY1305, CryptoPrimitiveAlgorithmSecondaryFamilyCustomRef=Crypto_30_LibCv_POLY1305
        RngHashDrbgSha512: CryptoPrimitiveService=CRYPTO_RANDOM, CryptoPrimitiveAlgorithmMode=CRYPTO_ALGOMODE_NOT_SET, CryptoPrimitiveAlgorithmFamily=CRYPTO_ALGOFAM_DRBG, CryptoPrimitiveAlgorithmSecondaryFamily=CRYPTO_ALGOFAM_SHA2_512
        RandomSeedRngHashDrbgSha512: CryptoPrimitiveService=CRYPTO_RANDOM_SEED, CryptoPrimitiveAlgorithmMode=CRYPTO_ALGOMODE_NOT_SET, CryptoPrimitiveAlgorithmFamily=CRYPTO_ALGOFAM_DRBG, CryptoPrimitiveAlgorithmSecondaryFamily=CRYPTO_ALGOFAM_SHA2_512
        SHA3_256: CryptoPrimitiveService=CRYPTO_HASH, CryptoPrimitiveAlgorithmMode=CRYPTO_ALGOMODE_NOT_SET, CryptoPrimitiveAlgorithmFamily=CRYPTO_ALGOFAM_SHA3_256, CryptoPrimitiveAlgorithmSecondaryFamily=CRYPTO_ALGOFAM_NOT_SET
        RngDrbgAes256: CryptoPrimitiveService=CRYPTO_RANDOM, CryptoPrimitiveAlgorithmMode=CRYPTO_ALGOMODE_NOT_SET, CryptoPrimitiveAlgorithmFamily=CRYPTO_ALGOFAM_DRBG, CryptoPrimitiveAlgorithmSecondaryFamily=CRYPTO_ALGOFAM_AES
        RngDrbgAes256Df: CryptoPrimitiveService=CRYPTO_RANDOM, CryptoPrimitiveAlgorithmMode=CRYPTO_ALGOMODE_CUSTOM_USE_DF, CryptoPrimitiveAlgorithmFamily=CRYPTO_ALGOFAM_DRBG, CryptoPrimitiveAlgorithmSecondaryFamily=CRYPTO_ALGOFAM_AES, CryptoPrimitiveAlgorithmMode=CRYPTO_ALGOMODE_CUSTOM, CryptoPrimitiveAlgorithmModeCustomRef=Crypto_30_LibCv_UseDF
        RandomSeedRngDrbgAes256: CryptoPrimitiveService=CRYPTO_RANDOM_SEED, CryptoPrimitiveAlgorithmMode=CRYPTO_ALGOMODE_NOT_SET, CryptoPrimitiveAlgorithmFamily=CRYPTO_ALGOFAM_DRBG, CryptoPrimitiveAlgorithmSecondaryFamily=CRYPTO_ALGOFAM_AES
        RandomSeedRngDrbgAes256Df: CryptoPrimitiveService=CRYPTO_RANDOM_SEED, CryptoPrimitiveAlgorithmMode=CRYPTO_ALGOMODE_CUSTOM_USE_DF, CryptoPrimitiveAlgorithmFamily=CRYPTO_ALGOFAM_DRBG, CryptoPrimitiveAlgorithmSecondaryFamily=CRYPTO_ALGOFAM_AES, CryptoPrimitiveAlgorithmMode=CRYPTO_ALGOMODE_CUSTOM, CryptoPrimitiveAlgorithmModeCustomRef=Crypto_30_LibCv_UseDF
        SheCmdGetId: CryptoPrimitiveService=CRYPTO_MAC_GENERATE, CryptoPrimitiveAlgorithmMode=CRYPTO_ALGOMODE_CMAC, CryptoPrimitiveAlgorithmFamily=CRYPTO_ALGOFAM_AES, CryptoPrimitiveAlgorithmSecondaryFamily=CRYPTO_ALGOFAM_CUSTOM_CMD_GET_ID, CryptoPrimitiveAlgorithmSecondaryFamily=CRYPTO_ALGOFAM_CUSTOM, CryptoPrimitiveAlgorithmSecondaryFamilyCustomRef=Crypto_30_LibCv_CmdGetId
        AesCCMEncrypt: CryptoPrimitiveAlgorithmSecondaryFamily=CRYPTO_ALGOFAM_NOT_SET, CryptoPrimitiveAlgorithmMode=CRYPTO_ALGOMODE_CUSTOM_CCM, CryptoPrimitiveService=CRYPTO_AEADENCRYPT, CryptoPrimitiveAlgorithmFamily=CRYPTO_ALGOFAM_AES, CryptoPrimitiveAlgorithmMode=CRYPTO_ALGOMODE_CUSTOM, CryptoPrimitiveAlgorithmModeCustomRef=Crypto_30_LibCv_CCM
        AesCCMDecrypt: CryptoPrimitiveAlgorithmSecondaryFamily=CRYPTO_ALGOFAM_NOT_SET, CryptoPrimitiveAlgorithmMode=CRYPTO_ALGOMODE_CUSTOM_CCM, CryptoPrimitiveService=CRYPTO_AEADDECRYPT, CryptoPrimitiveAlgorithmFamily=CRYPTO_ALGOFAM_AES, CryptoPrimitiveAlgorithmMode=CRYPTO_ALGOMODE_CUSTOM, CryptoPrimitiveAlgorithmModeCustomRef=Crypto_30_LibCv_CCM
        KeyDeriveHkdfHmacSHA256: CryptoPrimitiveService=CRYPTO_KEY_DERIVE, CryptoPrimitiveAlgorithmFamily=CRYPTO_ALGOFAM_CUSTOM_HKDF, CryptoPrimitiveAlgorithmMode=CRYPTO_ALGOMODE_HMAC, CryptoPrimitiveAlgorithmSecondaryFamily=CRYPTO_ALGOFAM_SHA2_256, CryptoPrimitiveAlgorithmFamily=CRYPTO_ALGOFAM_CUSTOM, CryptoPrimitiveAlgorithmFamily=CRYPTO_ALGOFAM_HKDF, CryptoPrimitiveAlgorithmFamilyCustomRef=Crypto_30_LibCv_HKDF
        KeyExchangeCalcPubValSpake2PlusCipherSuite8: CryptoPrimitiveService=CRYPTO_KEY_EXCHANGE_CALC_PUBVAL, CryptoPrimitiveAlgorithmFamily=CRYPTO_ALGOFAM_CUSTOM_SPAKE2_PLUS, CryptoPrimitiveAlgorithmMode=CRYPTO_ALGOMODE_CUSTOM_MODE_1, CryptoPrimitiveAlgorithmSecondaryFamily=CRYPTO_ALGOFAM_CUSTOM_CIPHER_SUITE_8, CryptoPrimitiveAlgorithmMode=CRYPTO_ALGOMODE_NOT_SET, CryptoPrimitiveAlgorithmFamily=CRYPTO_ALGOFAM_CUSTOM, CryptoPrimitiveAlgorithmMode=CRYPTO_ALGOMODE_CUSTOM, CryptoPrimitiveAlgorithmSecondaryFamily=CRYPTO_ALGOFAM_CUSTOM, CryptoPrimitiveAlgorithmSecondaryFamilyCustomRef=Crypto_30_LibCv_CipherSuite8, CryptoPrimitiveAlgorithmFamilyCustomRef=Crypto_30_LibCv_SPAKE2PLUS, CryptoPrimitiveAlgorithmModeCustomRef=Crypto_30_LibCv_Mode1
        KeyExchangeCalcSecretSpake2PlusCipherSuite8: CryptoPrimitiveService=CRYPTO_KEY_EXCHANGE_CALC_SECRET, CryptoPrimitiveAlgorithmFamily=CRYPTO_ALGOFAM_CUSTOM_SPAKE2_PLUS, CryptoPrimitiveAlgorithmMode=CRYPTO_ALGOMODE_CUSTOM_MODE_1, CryptoPrimitiveAlgorithmSecondaryFamily=CRYPTO_ALGOFAM_CUSTOM_CIPHER_SUITE_8, CryptoPrimitiveAlgorithmMode=CRYPTO_ALGOMODE_NOT_SET, CryptoPrimitiveAlgorithmFamily=CRYPTO_ALGOFAM_CUSTOM, CryptoPrimitiveAlgorithmMode=CRYPTO_ALGOMODE_CUSTOM, CryptoPrimitiveAlgorithmSecondaryFamily=CRYPTO_ALGOFAM_CUSTOM, CryptoPrimitiveAlgorithmSecondaryFamilyCustomRef=Crypto_30_LibCv_CipherSuite8, CryptoPrimitiveAlgorithmFamilyCustomRef=Crypto_30_LibCv_SPAKE2PLUS, CryptoPrimitiveAlgorithmModeCustomRef=Crypto_30_LibCv_Mode1
        KeyDeriveSpake2PlusP256R1: CryptoPrimitiveService=CRYPTO_KEY_DERIVE, CryptoPrimitiveAlgorithmFamily=CRYPTO_ALGOFAM_CUSTOM_SPAKE2_PLUS, CryptoPrimitiveAlgorithmMode=CRYPTO_ALGOMODE_CUSTOM_P256R1, CryptoPrimitiveAlgorithmSecondaryFamily=CRYPTO_ALGOFAM_NOT_SET, CryptoPrimitiveAlgorithmFamily=CRYPTO_ALGOFAM_CUSTOM, CryptoPrimitiveAlgorithmMode=CRYPTO_ALGOMODE_CUSTOM, CryptoPrimitiveAlgorithmFamilyCustomRef=Crypto_30_LibCv_SPAKE2PLUS, CryptoPrimitiveAlgorithmModeCustomRef=Crypto_30_LibCv_P256r1
        HashMD5: CryptoPrimitiveService=CRYPTO_HASH, CryptoPrimitiveAlgorithmMode=CRYPTO_ALGOMODE_NOT_SET, CryptoPrimitiveAlgorithmFamily=CRYPTO_ALGOFAM_CUSTOM_MD5, CryptoPrimitiveAlgorithmSecondaryFamily=CRYPTO_ALGOFAM_NOT_SET, CryptoPrimitiveAlgorithmFamily=CRYPTO_ALGOFAM_CUSTOM, CryptoPrimitiveAlgorithmFamilyCustomRef=Crypto_30_LibCv_MD5
        KeyGenerateEd25519: CryptoPrimitiveService=CRYPTO_KEY_GENERATE, CryptoPrimitiveAlgorithmMode=CRYPTO_ALGOMODE_NOT_SET, CryptoPrimitiveAlgorithmFamily=CRYPTO_ALGOFAM_ED25519, CryptoPrimitiveAlgorithmSecondaryFamily=CRYPTO_ALGOFAM_NOT_SET
      13 x CryptoPrimitiveAlgorithmFamilyCustom:
        Crypto_30_LibCv_PaddingPKCS7: CryptoPrimitiveAlgorithmFamilyCustomId=133
        Crypto_30_LibCv_FIPS186: CryptoPrimitiveAlgorithmFamilyCustomId=132
        Crypto_30_LibCv_ECCANSI: CryptoPrimitiveAlgorithmFamilyCustomId=129
        Crypto_30_LibCv_ECCSEC: CryptoPrimitiveAlgorithmFamilyCustomId=130
        Crypto_30_LibCv_DRBG: CryptoPrimitiveAlgorithmFamilyCustomId=131
        Crypto_30_LibCv_X25519: CryptoPrimitiveAlgorithmFamilyCustomId=135
        Crypto_30_LibCv_ISO15118: CryptoPrimitiveAlgorithmFamilyCustomId=136
        Crypto_30_LibCv_POLY1305: CryptoPrimitiveAlgorithmFamilyCustomId=137
        Crypto_30_LibCv_CmdGetId: CryptoPrimitiveAlgorithmFamilyCustomId=140
        Crypto_30_LibCv_HKDF: CryptoPrimitiveAlgorithmFamilyCustomId=139
        Crypto_30_LibCv_SPAKE2PLUS: CryptoPrimitiveAlgorithmFamilyCustomId=138
        Crypto_30_LibCv_CipherSuite8: CryptoPrimitiveAlgorithmFamilyCustomId=157
        Crypto_30_LibCv_MD5: CryptoPrimitiveAlgorithmFamilyCustomId=191
      8 x CryptoPrimitiveAlgorithmModeCustom:
        Crypto_30_LibCv_CCM: CryptoPrimitiveAlgorithmModeCustomId=147
        Crypto_30_LibCv_Mode1: CryptoPrimitiveAlgorithmModeCustomId=150
        Crypto_30_LibCv_P160r1: CryptoPrimitiveAlgorithmModeCustomId=146
        Crypto_30_LibCv_P256r1: CryptoPrimitiveAlgorithmModeCustomId=128
        Crypto_30_LibCv_P384r1: CryptoPrimitiveAlgorithmModeCustomId=131
        Crypto_30_LibCv_RSAES_OAEP_CRT: CryptoPrimitiveAlgorithmModeCustomId=132
        Crypto_30_LibCv_RSASSA_PKCS1_v1_5_CRT: CryptoPrimitiveAlgorithmModeCustomId=129
        Crypto_30_LibCv_UseDF: CryptoPrimitiveAlgorithmModeCustomId=130
      KeyExchangeCalcPubValNistP224R1_BD (CryptoPrimitive):
        CryptoPrimitiveService = CRYPTO_KEY_EXCHANGE_CALC_PUBVAL
        CryptoPrimitiveAlgorithmFamily = CRYPTO_ALGOFAM_ECCNIST
        CryptoPrimitiveAlgorithmMode = CRYPTO_ALGOMODE_CUSTOM_P224R1
        CryptoPrimitiveAlgorithmSecondaryFamily = CRYPTO_ALGOFAM_CUSTOM_BD
        CryptoPrimitiveAlgorithmMode = CRYPTO_ALGOMODE_CUSTOM
        CryptoPrimitiveAlgorithmSecondaryFamily = CRYPTO_ALGOFAM_CUSTOM
        CryptoPrimitiveAlgorithmModeCustomRef = Crypto_30_LibCv_P224r1
        CryptoPrimitiveAlgorithmSecondaryFamilyCustomRef = Crypto_30_LibCv_BD
      KeyExchangeCalcSecretNistP224R1_BD (CryptoPrimitive):
        CryptoPrimitiveService = CRYPTO_KEY_EXCHANGE_CALC_SECRET
        CryptoPrimitiveAlgorithmFamily = CRYPTO_ALGOFAM_ECCNIST
        CryptoPrimitiveAlgorithmMode = CRYPTO_ALGOMODE_CUSTOM_P224R1
        CryptoPrimitiveAlgorithmSecondaryFamily = CRYPTO_ALGOFAM_CUSTOM_BD
        CryptoPrimitiveAlgorithmMode = CRYPTO_ALGOMODE_CUSTOM
        CryptoPrimitiveAlgorithmSecondaryFamily = CRYPTO_ALGOFAM_CUSTOM
        CryptoPrimitiveAlgorithmModeCustomRef = Crypto_30_LibCv_P224r1
        CryptoPrimitiveAlgorithmSecondaryFamilyCustomRef = Crypto_30_LibCv_BD
      Crypto_30_LibCv_P224r1 (CryptoPrimitiveAlgorithmModeCustom): CryptoPrimitiveAlgorithmModeCustomId=148
      Crypto_30_LibCv_BD (CryptoPrimitiveAlgorithmFamilyCustom): CryptoPrimitiveAlgorithmFamilyCustomId=141
      KeyDeriveHkdfOption1SHA256 (CryptoPrimitive):
        CryptoPrimitiveService = CRYPTO_KEY_DERIVE
        CryptoPrimitiveAlgorithmFamily = CRYPTO_ALGOFAM_CUSTOM_HKDF
        CryptoPrimitiveAlgorithmMode = CRYPTO_ALGOMODE_NOT_SET
        CryptoPrimitiveAlgorithmSecondaryFamily = CRYPTO_ALGOFAM_SHA2_256
        CryptoPrimitiveAlgorithmFamily = CRYPTO_ALGOFAM_CUSTOM
        CryptoPrimitiveAlgorithmFamily = CRYPTO_ALGOFAM_HKDF
        CryptoPrimitiveAlgorithmFamilyCustomRef = Crypto_30_LibCv_HKDF
      EccSecP521R1GenerateSha512 (CryptoPrimitive):
        CryptoPrimitiveAlgorithmFamily = CRYPTO_ALGOFAM_ECCSEC
        CryptoPrimitiveAlgorithmMode = CRYPTO_ALGOMODE_CUSTOM_P521R1
        CryptoPrimitiveAlgorithmSecondaryFamily = CRYPTO_ALGOFAM_SHA2_512
        CryptoPrimitiveService = CRYPTO_SIGNATURE_GENERATE
        CryptoPrimitiveAlgorithmMode = CRYPTO_ALGOMODE_CUSTOM
        CryptoPrimitiveAlgorithmModeCustomRef = Crypto_30_LibCv_P521r1
      Crypto_30_LibCv_P521r1 (CryptoPrimitiveAlgorithmModeCustom): CryptoPrimitiveAlgorithmModeCustomId=134
      15 x CryptoPrimitive:
        EccSecP521R1VerifySha512: CryptoPrimitiveAlgorithmFamily=CRYPTO_ALGOFAM_ECCSEC, CryptoPrimitiveAlgorithmMode=CRYPTO_ALGOMODE_CUSTOM_P521R1, CryptoPrimitiveAlgorithmSecondaryFamily=CRYPTO_ALGOFAM_SHA2_512, CryptoPrimitiveService=CRYPTO_SIGNATURE_VERIFY, CryptoPrimitiveAlgorithmMode=CRYPTO_ALGOMODE_CUSTOM, CryptoPrimitiveAlgorithmModeCustomRef=Crypto_30_LibCv_P521r1
        KeyExchangeCalcSecretSecP521R1: CryptoPrimitiveService=CRYPTO_KEY_EXCHANGE_CALC_SECRET, CryptoPrimitiveAlgorithmFamily=CRYPTO_ALGOFAM_ECCSEC, CryptoPrimitiveAlgorithmMode=CRYPTO_ALGOMODE_CUSTOM_P521R1, CryptoPrimitiveAlgorithmSecondaryFamily=CRYPTO_ALGOFAM_NOT_SET, CryptoPrimitiveAlgorithmMode=CRYPTO_ALGOMODE_CUSTOM, CryptoPrimitiveAlgorithmModeCustomRef=Crypto_30_LibCv_P521r1
        KeyExchangeCalcPubValSecP521R1: CryptoPrimitiveService=CRYPTO_KEY_EXCHANGE_CALC_PUBVAL, CryptoPrimitiveAlgorithmFamily=CRYPTO_ALGOFAM_ECCSEC, CryptoPrimitiveAlgorithmMode=CRYPTO_ALGOMODE_CUSTOM_P521R1, CryptoPrimitiveAlgorithmSecondaryFamily=CRYPTO_ALGOFAM_NOT_SET, CryptoPrimitiveAlgorithmMode=CRYPTO_ALGOMODE_CUSTOM, CryptoPrimitiveAlgorithmModeCustomRef=Crypto_30_LibCv_P521r1
        SHA3_224: CryptoPrimitiveService=CRYPTO_HASH, CryptoPrimitiveAlgorithmMode=CRYPTO_ALGOMODE_NOT_SET, CryptoPrimitiveAlgorithmFamily=CRYPTO_ALGOFAM_SHA3_224, CryptoPrimitiveAlgorithmSecondaryFamily=CRYPTO_ALGOFAM_NOT_SET
        SHA3_384: CryptoPrimitiveService=CRYPTO_HASH, CryptoPrimitiveAlgorithmMode=CRYPTO_ALGOMODE_NOT_SET, CryptoPrimitiveAlgorithmFamily=CRYPTO_ALGOFAM_SHA3_384, CryptoPrimitiveAlgorithmSecondaryFamily=CRYPTO_ALGOFAM_NOT_SET
        SHA3_512: CryptoPrimitiveService=CRYPTO_HASH, CryptoPrimitiveAlgorithmMode=CRYPTO_ALGOMODE_NOT_SET, CryptoPrimitiveAlgorithmFamily=CRYPTO_ALGOFAM_SHA3_512, CryptoPrimitiveAlgorithmSecondaryFamily=CRYPTO_ALGOFAM_NOT_SET
        SHAKE128: CryptoPrimitiveService=CRYPTO_HASH, CryptoPrimitiveAlgorithmMode=CRYPTO_ALGOMODE_NOT_SET, CryptoPrimitiveAlgorithmFamily=CRYPTO_ALGOFAM_SHAKE128, CryptoPrimitiveAlgorithmSecondaryFamily=CRYPTO_ALGOFAM_NOT_SET
        SHAKE256: CryptoPrimitiveService=CRYPTO_HASH, CryptoPrimitiveAlgorithmMode=CRYPTO_ALGOMODE_NOT_SET, CryptoPrimitiveAlgorithmFamily=CRYPTO_ALGOFAM_SHAKE256, CryptoPrimitiveAlgorithmSecondaryFamily=CRYPTO_ALGOFAM_NOT_SET
        EccNistP521R1GenerateSha512: CryptoPrimitiveAlgorithmFamily=CRYPTO_ALGOFAM_ECCNIST, CryptoPrimitiveAlgorithmMode=CRYPTO_ALGOMODE_CUSTOM_P521R1, CryptoPrimitiveAlgorithmSecondaryFamily=CRYPTO_ALGOFAM_SHA2_512, CryptoPrimitiveService=CRYPTO_SIGNATURE_GENERATE, CryptoPrimitiveAlgorithmMode=CRYPTO_ALGOMODE_CUSTOM, CryptoPrimitiveAlgorithmModeCustomRef=Crypto_30_LibCv_P521r1
        EccNistP521R1VerifySha512: CryptoPrimitiveAlgorithmFamily=CRYPTO_ALGOFAM_ECCNIST, CryptoPrimitiveAlgorithmMode=CRYPTO_ALGOMODE_CUSTOM_P521R1, CryptoPrimitiveAlgorithmSecondaryFamily=CRYPTO_ALGOFAM_SHA2_512, CryptoPrimitiveService=CRYPTO_SIGNATURE_VERIFY, CryptoPrimitiveAlgorithmMode=CRYPTO_ALGOMODE_CUSTOM, CryptoPrimitiveAlgorithmModeCustomRef=Crypto_30_LibCv_P521r1
        KeyExchangeCalcSecretNistP521R1: CryptoPrimitiveService=CRYPTO_KEY_EXCHANGE_CALC_SECRET, CryptoPrimitiveAlgorithmFamily=CRYPTO_ALGOFAM_ECCNIST, CryptoPrimitiveAlgorithmMode=CRYPTO_ALGOMODE_CUSTOM_P521R1, CryptoPrimitiveAlgorithmSecondaryFamily=CRYPTO_ALGOFAM_NOT_SET, CryptoPrimitiveAlgorithmMode=CRYPTO_ALGOMODE_CUSTOM, CryptoPrimitiveAlgorithmModeCustomRef=Crypto_30_LibCv_P521r1
        KeyExchangeCalcPubValNistP521R1: CryptoPrimitiveService=CRYPTO_KEY_EXCHANGE_CALC_PUBVAL, CryptoPrimitiveAlgorithmFamily=CRYPTO_ALGOFAM_ECCNIST, CryptoPrimitiveAlgorithmMode=CRYPTO_ALGOMODE_CUSTOM_P521R1, CryptoPrimitiveAlgorithmSecondaryFamily=CRYPTO_ALGOFAM_NOT_SET, CryptoPrimitiveAlgorithmMode=CRYPTO_ALGOMODE_CUSTOM, CryptoPrimitiveAlgorithmModeCustomRef=Crypto_30_LibCv_P521r1
        KeyDeriveHkdfHmacSHA384: CryptoPrimitiveService=CRYPTO_KEY_DERIVE, CryptoPrimitiveAlgorithmFamily=CRYPTO_ALGOFAM_CUSTOM_HKDF, CryptoPrimitiveAlgorithmMode=CRYPTO_ALGOMODE_HMAC, CryptoPrimitiveAlgorithmSecondaryFamily=CRYPTO_ALGOFAM_SHA2_384, CryptoPrimitiveAlgorithmFamily=CRYPTO_ALGOFAM_CUSTOM, CryptoPrimitiveAlgorithmFamily=CRYPTO_ALGOFAM_HKDF, CryptoPrimitiveAlgorithmFamilyCustomRef=Crypto_30_LibCv_HKDF
        KeyDeriveHkdfOption1SHA512: CryptoPrimitiveService=CRYPTO_KEY_DERIVE, CryptoPrimitiveAlgorithmFamily=CRYPTO_ALGOFAM_HKDF, CryptoPrimitiveAlgorithmMode=CRYPTO_ALGOMODE_NOT_SET, CryptoPrimitiveAlgorithmSecondaryFamily=CRYPTO_ALGOFAM_SHA2_512
        KeyDeriveIso15118_20: CryptoPrimitiveService=CRYPTO_KEY_DERIVE, CryptoPrimitiveAlgorithmFamily=CRYPTO_ALGOFAM_CUSTOM, CryptoPrimitiveAlgorithmMode=CRYPTO_ALGOMODE_NOT_SET, CryptoPrimitiveAlgorithmSecondaryFamily=CRYPTO_ALGOFAM_NOT_SET, CryptoPrimitiveAlgorithmFamilyCustomRef=Crypto_30_LibCv_ISO15118_20
      Crypto_30_LibCv_ISO15118_20 (CryptoPrimitiveAlgorithmFamilyCustom): CryptoPrimitiveAlgorithmFamilyCustomId=193
      KeyExchangeCalcPubValX448 (CryptoPrimitive):
        CryptoPrimitiveService = CRYPTO_KEY_EXCHANGE_CALC_PUBVAL
        CryptoPrimitiveAlgorithmFamily = CRYPTO_ALGOFAM_CUSTOM
        CryptoPrimitiveAlgorithmMode = CRYPTO_ALGOMODE_NOT_SET
        CryptoPrimitiveAlgorithmSecondaryFamily = CRYPTO_ALGOFAM_NOT_SET
        CryptoPrimitiveAlgorithmFamilyCustomRef = Crypto_30_LibCv_X448
      KeyExchangeCalcSecretX448 (CryptoPrimitive):
        CryptoPrimitiveService = CRYPTO_KEY_EXCHANGE_CALC_SECRET
        CryptoPrimitiveAlgorithmFamily = CRYPTO_ALGOFAM_CUSTOM
        CryptoPrimitiveAlgorithmMode = CRYPTO_ALGOMODE_NOT_SET
        CryptoPrimitiveAlgorithmSecondaryFamily = CRYPTO_ALGOFAM_NOT_SET
        CryptoPrimitiveAlgorithmFamilyCustomRef = Crypto_30_LibCv_X448
      Crypto_30_LibCv_X448 (CryptoPrimitiveAlgorithmFamilyCustom): CryptoPrimitiveAlgorithmFamilyCustomId=194
      Crypto_30_LibCv_ED448 (CryptoPrimitiveAlgorithmFamilyCustom): CryptoPrimitiveAlgorithmFamilyCustomId=195
      5 x CryptoPrimitiveAlgorithmModeCustom:
        Crypto_30_LibCv_EdDsaEd448Pure: CryptoPrimitiveAlgorithmModeCustomId=199
        Crypto_30_LibCv_EdDsaEd448Ph: CryptoPrimitiveAlgorithmModeCustomId=200
        Crypto_30_LibCv_EdDsaEd25519Pure: CryptoPrimitiveAlgorithmModeCustomId=174
        Crypto_30_LibCv_EdDsaEd25519Ctx: CryptoPrimitiveAlgorithmModeCustomId=175
        Crypto_30_LibCv_EdDsaEd25519Ph: CryptoPrimitiveAlgorithmModeCustomId=176
      12 x CryptoPrimitive:
        EdDsaEd448PhGenerate: CryptoPrimitiveAlgorithmMode=CRYPTO_ALGOMODE_CUSTOM, CryptoPrimitiveService=CRYPTO_SIGNATURE_GENERATE, CryptoPrimitiveAlgorithmFamily=CRYPTO_ALGOFAM_CUSTOM, CryptoPrimitiveAlgorithmSecondaryFamily=CRYPTO_ALGOFAM_SHAKE256, CryptoPrimitiveAlgorithmFamilyCustomRef=Crypto_30_LibCv_ED448, CryptoPrimitiveAlgorithmModeCustomRef=Crypto_30_LibCv_EdDsaEd448Ph
        EdDsaEd448PhVerify: CryptoPrimitiveAlgorithmMode=CRYPTO_ALGOMODE_CUSTOM, CryptoPrimitiveService=CRYPTO_SIGNATURE_VERIFY, CryptoPrimitiveAlgorithmFamily=CRYPTO_ALGOFAM_CUSTOM, CryptoPrimitiveAlgorithmSecondaryFamily=CRYPTO_ALGOFAM_SHAKE256, CryptoPrimitiveAlgorithmFamilyCustomRef=Crypto_30_LibCv_ED448, CryptoPrimitiveAlgorithmModeCustomRef=Crypto_30_LibCv_EdDsaEd448Ph
        EdDsaEd25519PureVerify: CryptoPrimitiveAlgorithmSecondaryFamily=CRYPTO_ALGOFAM_NOT_SET, CryptoPrimitiveService=CRYPTO_SIGNATURE_VERIFY, CryptoPrimitiveAlgorithmFamily=CRYPTO_ALGOFAM_ED25519, CryptoPrimitiveAlgorithmMode=CRYPTO_ALGOMODE_CUSTOM, CryptoPrimitiveAlgorithmModeCustomRef=Crypto_30_LibCv_EdDsaEd25519Pure
        EdDsaEd25519PhVerify: CryptoPrimitiveService=CRYPTO_SIGNATURE_VERIFY, CryptoPrimitiveAlgorithmFamily=CRYPTO_ALGOFAM_ED25519, CryptoPrimitiveAlgorithmSecondaryFamily=CRYPTO_ALGOFAM_SHA2_512, CryptoPrimitiveAlgorithmMode=CRYPTO_ALGOMODE_CUSTOM, CryptoPrimitiveAlgorithmModeCustomRef=Crypto_30_LibCv_EdDsaEd25519Ph
        EdDsaEd25519CtxVerify: CryptoPrimitiveService=CRYPTO_SIGNATURE_VERIFY, CryptoPrimitiveAlgorithmFamily=CRYPTO_ALGOFAM_ED25519, CryptoPrimitiveAlgorithmSecondaryFamily=CRYPTO_ALGOFAM_NOT_SET, CryptoPrimitiveAlgorithmMode=CRYPTO_ALGOMODE_CUSTOM, CryptoPrimitiveAlgorithmModeCustomRef=Crypto_30_LibCv_EdDsaEd25519Ctx
        EdDsaEd25519PhGenerate: CryptoPrimitiveService=CRYPTO_SIGNATURE_GENERATE, CryptoPrimitiveAlgorithmFamily=CRYPTO_ALGOFAM_ED25519, CryptoPrimitiveAlgorithmSecondaryFamily=CRYPTO_ALGOFAM_SHA2_512, CryptoPrimitiveAlgorithmMode=CRYPTO_ALGOMODE_CUSTOM, CryptoPrimitiveAlgorithmModeCustomRef=Crypto_30_LibCv_EdDsaEd25519Ph
        EdDsaEd25519CtxGenerate: CryptoPrimitiveService=CRYPTO_SIGNATURE_GENERATE, CryptoPrimitiveAlgorithmFamily=CRYPTO_ALGOFAM_ED25519, CryptoPrimitiveAlgorithmSecondaryFamily=CRYPTO_ALGOFAM_NOT_SET, CryptoPrimitiveAlgorithmMode=CRYPTO_ALGOMODE_CUSTOM, CryptoPrimitiveAlgorithmModeCustomRef=Crypto_30_LibCv_EdDsaEd25519Ctx
        EdDsaEd25519PureGenerate: CryptoPrimitiveAlgorithmSecondaryFamily=CRYPTO_ALGOFAM_NOT_SET, CryptoPrimitiveService=CRYPTO_SIGNATURE_GENERATE, CryptoPrimitiveAlgorithmFamily=CRYPTO_ALGOFAM_ED25519, CryptoPrimitiveAlgorithmMode=CRYPTO_ALGOMODE_CUSTOM, CryptoPrimitiveAlgorithmModeCustomRef=Crypto_30_LibCv_EdDsaEd25519Pure
        EdDsaEd448PureGenerate: CryptoPrimitiveAlgorithmSecondaryFamily=CRYPTO_ALGOFAM_NOT_SET, CryptoPrimitiveAlgorithmMode=CRYPTO_ALGOMODE_CUSTOM, CryptoPrimitiveService=CRYPTO_SIGNATURE_GENERATE, CryptoPrimitiveAlgorithmFamily=CRYPTO_ALGOFAM_CUSTOM, CryptoPrimitiveAlgorithmFamilyCustomRef=Crypto_30_LibCv_ED448, CryptoPrimitiveAlgorithmModeCustomRef=Crypto_30_LibCv_EdDsaEd448Pure
        EdDsaEd448PureVerify: CryptoPrimitiveAlgorithmSecondaryFamily=CRYPTO_ALGOFAM_NOT_SET, CryptoPrimitiveAlgorithmMode=CRYPTO_ALGOMODE_CUSTOM, CryptoPrimitiveService=CRYPTO_SIGNATURE_VERIFY, CryptoPrimitiveAlgorithmFamily=CRYPTO_ALGOFAM_CUSTOM, CryptoPrimitiveAlgorithmFamilyCustomRef=Crypto_30_LibCv_ED448, CryptoPrimitiveAlgorithmModeCustomRef=Crypto_30_LibCv_EdDsaEd448Pure
        HmacSha512Generate: CryptoPrimitiveAlgorithmFamily=CRYPTO_ALGOFAM_SHA2_512, CryptoPrimitiveAlgorithmMode=CRYPTO_ALGOMODE_HMAC, CryptoPrimitiveAlgorithmSecondaryFamily=CRYPTO_ALGOFAM_NOT_SET, CryptoPrimitiveService=CRYPTO_MAC_GENERATE
        HmacSha512Verify: CryptoPrimitiveAlgorithmFamily=CRYPTO_ALGOFAM_SHA2_512, CryptoPrimitiveAlgorithmMode=CRYPTO_ALGOMODE_HMAC, CryptoPrimitiveAlgorithmSecondaryFamily=CRYPTO_ALGOFAM_NOT_SET, CryptoPrimitiveService=CRYPTO_MAC_VERIFY
      Crypto_30_LibCv_HKDF_Expand (CryptoPrimitiveAlgorithmFamilyCustom): CryptoPrimitiveAlgorithmFamilyCustomId=197
      KeyDeriveHkdfExpandHmacSHA256 (CryptoPrimitive):
        CryptoPrimitiveAlgorithmFamily = CRYPTO_ALGOFAM_CUSTOM
        CryptoPrimitiveService = CRYPTO_KEY_DERIVE
        CryptoPrimitiveAlgorithmMode = CRYPTO_ALGOMODE_HMAC
        CryptoPrimitiveAlgorithmSecondaryFamily = CRYPTO_ALGOFAM_SHA2_256
        CryptoPrimitiveAlgorithmFamilyCustomRef = Crypto_30_LibCv_HKDF_Expand
      KeyDeriveHkdfExpandHmacSHA384 (CryptoPrimitive):
        CryptoPrimitiveAlgorithmFamily = CRYPTO_ALGOFAM_CUSTOM
        CryptoPrimitiveService = CRYPTO_KEY_DERIVE
        CryptoPrimitiveAlgorithmMode = CRYPTO_ALGOMODE_HMAC
        CryptoPrimitiveAlgorithmSecondaryFamily = CRYPTO_ALGOFAM_SHA2_384
        CryptoPrimitiveAlgorithmFamilyCustomRef = Crypto_30_LibCv_HKDF_Expand
      Crypto_30_LibCv_IsPrivateKeyOnCurve (CryptoPrimitiveAlgorithmFamilyCustom): CryptoPrimitiveAlgorithmFamilyCustomId=198
      Crypto_30_LibCv_IsPublicKeyOnCurve (CryptoPrimitiveAlgorithmFamilyCustom): CryptoPrimitiveAlgorithmFamilyCustomId=196
      11 x CryptoPrimitive:
        IsKeyOnCurveP160R1: CryptoPrimitiveService=CRYPTO_SIGNATURE_VERIFY, CryptoPrimitiveAlgorithmMode=CRYPTO_ALGOMODE_CUSTOM, CryptoPrimitiveAlgorithmFamily=CRYPTO_ALGOFAM_ECCSEC, CryptoPrimitiveAlgorithmSecondaryFamily=CRYPTO_ALGOFAM_CUSTOM, CryptoPrimitiveAlgorithmModeCustomRef=Crypto_30_LibCv_P160r1, CryptoPrimitiveAlgorithmSecondaryFamilyCustomRef=Crypto_30_LibCv_IsPrivateKeyOnCurve, CryptoPrimitiveAlgorithmSecondaryFamilyCustomRef=Crypto_30_LibCv_IsPublicKeyOnCurve
        IsKeyOnCurveP256R1: CryptoPrimitiveService=CRYPTO_SIGNATURE_VERIFY, CryptoPrimitiveAlgorithmMode=CRYPTO_ALGOMODE_CUSTOM, CryptoPrimitiveAlgorithmSecondaryFamily=CRYPTO_ALGOFAM_CUSTOM, CryptoPrimitiveAlgorithmFamily=CRYPTO_ALGOFAM_ECCNIST, CryptoPrimitiveAlgorithmFamily=CRYPTO_ALGOFAM_ECCANSI, CryptoPrimitiveAlgorithmFamily=CRYPTO_ALGOFAM_ECCSEC, CryptoPrimitiveAlgorithmModeCustomRef=Crypto_30_LibCv_P256r1, CryptoPrimitiveAlgorithmSecondaryFamilyCustomRef=Crypto_30_LibCv_IsPrivateKeyOnCurve, CryptoPrimitiveAlgorithmSecondaryFamilyCustomRef=Crypto_30_LibCv_IsPublicKeyOnCurve
        IsKeyOnCurveP384R1: CryptoPrimitiveService=CRYPTO_SIGNATURE_VERIFY, CryptoPrimitiveAlgorithmMode=CRYPTO_ALGOMODE_CUSTOM, CryptoPrimitiveAlgorithmSecondaryFamily=CRYPTO_ALGOFAM_CUSTOM, CryptoPrimitiveAlgorithmFamily=CRYPTO_ALGOFAM_ECCNIST, CryptoPrimitiveAlgorithmFamily=CRYPTO_ALGOFAM_ECCSEC, CryptoPrimitiveAlgorithmModeCustomRef=Crypto_30_LibCv_P384r1, CryptoPrimitiveAlgorithmSecondaryFamilyCustomRef=Crypto_30_LibCv_IsPrivateKeyOnCurve, CryptoPrimitiveAlgorithmSecondaryFamilyCustomRef=Crypto_30_LibCv_IsPublicKeyOnCurve
        IsKeyOnCurveP521R1: CryptoPrimitiveService=CRYPTO_SIGNATURE_VERIFY, CryptoPrimitiveAlgorithmMode=CRYPTO_ALGOMODE_CUSTOM, CryptoPrimitiveAlgorithmSecondaryFamily=CRYPTO_ALGOFAM_CUSTOM, CryptoPrimitiveAlgorithmFamily=CRYPTO_ALGOFAM_ECCNIST, CryptoPrimitiveAlgorithmFamily=CRYPTO_ALGOFAM_ECCSEC, CryptoPrimitiveAlgorithmModeCustomRef=Crypto_30_LibCv_P521r1, CryptoPrimitiveAlgorithmSecondaryFamilyCustomRef=Crypto_30_LibCv_IsPrivateKeyOnCurve, CryptoPrimitiveAlgorithmSecondaryFamilyCustomRef=Crypto_30_LibCv_IsPublicKeyOnCurve
        IsKeyOnCurveEd25519: CryptoPrimitiveService=CRYPTO_SIGNATURE_VERIFY, CryptoPrimitiveAlgorithmMode=CRYPTO_ALGOMODE_NOT_SET, CryptoPrimitiveAlgorithmFamily=CRYPTO_ALGOFAM_ED25519, CryptoPrimitiveAlgorithmSecondaryFamily=CRYPTO_ALGOFAM_CUSTOM, CryptoPrimitiveAlgorithmSecondaryFamilyCustomRef=Crypto_30_LibCv_IsPrivateKeyOnCurve, CryptoPrimitiveAlgorithmSecondaryFamilyCustomRef=Crypto_30_LibCv_IsPublicKeyOnCurve
        IsKeyOnCurveEd448: CryptoPrimitiveService=CRYPTO_SIGNATURE_VERIFY, CryptoPrimitiveAlgorithmMode=CRYPTO_ALGOMODE_NOT_SET, CryptoPrimitiveAlgorithmFamily=CRYPTO_ALGOFAM_CUSTOM, CryptoPrimitiveAlgorithmSecondaryFamily=CRYPTO_ALGOFAM_CUSTOM, CryptoPrimitiveAlgorithmFamilyCustomRef=Crypto_30_LibCv_ED448, CryptoPrimitiveAlgorithmSecondaryFamilyCustomRef=Crypto_30_LibCv_IsPrivateKeyOnCurve, CryptoPrimitiveAlgorithmSecondaryFamilyCustomRef=Crypto_30_LibCv_IsPublicKeyOnCurve
        KeyExchangeCalcPubValP256R1_BD: CryptoPrimitiveService=CRYPTO_KEY_EXCHANGE_CALC_PUBVAL, CryptoPrimitiveAlgorithmMode=CRYPTO_ALGOMODE_CUSTOM, CryptoPrimitiveAlgorithmSecondaryFamily=CRYPTO_ALGOFAM_CUSTOM, CryptoPrimitiveAlgorithmFamily=CRYPTO_ALGOFAM_ECCNIST, CryptoPrimitiveAlgorithmFamily=CRYPTO_ALGOFAM_ECCSEC, CryptoPrimitiveAlgorithmFamily=CRYPTO_ALGOFAM_ECCANSI, CryptoPrimitiveAlgorithmModeCustomRef=Crypto_30_LibCv_P256r1, CryptoPrimitiveAlgorithmSecondaryFamilyCustomRef=Crypto_30_LibCv_BD
        KeyExchangeCalcSecretP256R1_BD: CryptoPrimitiveService=CRYPTO_KEY_EXCHANGE_CALC_SECRET, CryptoPrimitiveAlgorithmMode=CRYPTO_ALGOMODE_CUSTOM, CryptoPrimitiveAlgorithmSecondaryFamily=CRYPTO_ALGOFAM_CUSTOM, CryptoPrimitiveAlgorithmFamily=CRYPTO_ALGOFAM_ECCSEC, CryptoPrimitiveAlgorithmFamily=CRYPTO_ALGOFAM_ECCANSI, CryptoPrimitiveAlgorithmFamily=CRYPTO_ALGOFAM_ECCNIST, CryptoPrimitiveAlgorithmModeCustomRef=Crypto_30_LibCv_P256r1, CryptoPrimitiveAlgorithmSecondaryFamilyCustomRef=Crypto_30_LibCv_BD
        KeyGenerateSecP521R1: CryptoPrimitiveService=CRYPTO_KEY_GENERATE, CryptoPrimitiveAlgorithmFamily=CRYPTO_ALGOFAM_ECCSEC, CryptoPrimitiveAlgorithmMode=CRYPTO_ALGOMODE_CUSTOM, CryptoPrimitiveAlgorithmSecondaryFamily=CRYPTO_ALGOFAM_NOT_SET, CryptoPrimitiveAlgorithmModeCustomRef=Crypto_30_LibCv_P521r1
        KeyGenerateNistP521R1: CryptoPrimitiveService=CRYPTO_KEY_GENERATE, CryptoPrimitiveAlgorithmFamily=CRYPTO_ALGOFAM_ECCNIST, CryptoPrimitiveAlgorithmMode=CRYPTO_ALGOMODE_CUSTOM, CryptoPrimitiveAlgorithmSecondaryFamily=CRYPTO_ALGOFAM_NOT_SET, CryptoPrimitiveAlgorithmModeCustomRef=Crypto_30_LibCv_P521r1
        SlhDsaSha2_128sVerifyPure: CryptoPrimitiveAlgorithmFamily=CRYPTO_ALGOFAM_CUSTOM, CryptoPrimitiveAlgorithmMode=CRYPTO_ALGOMODE_CUSTOM, CryptoPrimitiveService=CRYPTO_SIGNATURE_VERIFY, CryptoPrimitiveAlgorithmSecondaryFamily=CRYPTO_ALGOFAM_NOT_SET, CryptoPrimitiveAlgorithmFamilyCustomRef=Crypto_30_LibCv_SLH_DSA, CryptoPrimitiveAlgorithmModeCustomRef=Crypto_30_LibCv_SHA2_128S
      Crypto_30_LibCv_SLH_DSA (CryptoPrimitiveAlgorithmFamilyCustom): CryptoPrimitiveAlgorithmFamilyCustomId=199
      Crypto_30_LibCv_SHA2_128S (CryptoPrimitiveAlgorithmModeCustom): CryptoPrimitiveAlgorithmModeCustomId=201
      Crypto_30_LibCv_SM4 (CryptoPrimitiveAlgorithmFamilyCustom): CryptoPrimitiveAlgorithmFamilyCustomId=200
      5 x CryptoPrimitive, all with CryptoPrimitiveAlgorithmSecondaryFamily=CRYPTO_ALGOFAM_NOT_SET:
        Sm4Encrypt: CryptoPrimitiveService=CRYPTO_ENCRYPT, CryptoPrimitiveAlgorithmMode=CRYPTO_ALGOMODE_CBC, CryptoPrimitiveAlgorithmMode=CRYPTO_ALGOMODE_ECB, CryptoPrimitiveAlgorithmFamily=CRYPTO_ALGOFAM_CUSTOM, CryptoPrimitiveAlgorithmFamilyCustomRef=Crypto_30_LibCv_SM4
        Sm4Decrypt: CryptoPrimitiveService=CRYPTO_DECRYPT, CryptoPrimitiveAlgorithmMode=CRYPTO_ALGOMODE_CBC, CryptoPrimitiveAlgorithmMode=CRYPTO_ALGOMODE_ECB, CryptoPrimitiveAlgorithmFamily=CRYPTO_ALGOFAM_CUSTOM, CryptoPrimitiveAlgorithmFamilyCustomRef=Crypto_30_LibCv_SM4
        Sm3: CryptoPrimitiveService=CRYPTO_HASH, CryptoPrimitiveAlgorithmMode=CRYPTO_ALGOMODE_NOT_SET, CryptoPrimitiveAlgorithmFamily=CRYPTO_ALGOFAM_SM3
        Sm2Generate: CryptoPrimitiveService=CRYPTO_SIGNATURE_GENERATE, CryptoPrimitiveAlgorithmFamily=CRYPTO_ALGOFAM_SM2, CryptoPrimitiveAlgorithmMode=CRYPTO_ALGOMODE_CUSTOM, CryptoPrimitiveAlgorithmModeCustomRef=Crypto_30_LibCv_Sm2P256v1
        Sm2Verify: CryptoPrimitiveService=CRYPTO_SIGNATURE_VERIFY, CryptoPrimitiveAlgorithmFamily=CRYPTO_ALGOFAM_SM2, CryptoPrimitiveAlgorithmMode=CRYPTO_ALGOMODE_CUSTOM, CryptoPrimitiveAlgorithmModeCustomRef=Crypto_30_LibCv_Sm2P256v1
      Crypto_30_LibCv_Sm2P256v1 (CryptoPrimitiveAlgorithmModeCustom): CryptoPrimitiveAlgorithmModeCustomId=202
      5 x CryptoPrimitive:
        KeyGenerate_SM2_Sm2P256V1: CryptoPrimitiveService=CRYPTO_KEY_GENERATE, CryptoPrimitiveAlgorithmFamily=CRYPTO_ALGOFAM_SM2, CryptoPrimitiveAlgorithmSecondaryFamily=CRYPTO_ALGOFAM_NOT_SET, CryptoPrimitiveAlgorithmMode=CRYPTO_ALGOMODE_CUSTOM, CryptoPrimitiveAlgorithmModeCustomRef=Crypto_30_LibCv_Sm2P256v1
        RsaPssSha384Generate: CryptoPrimitiveAlgorithmFamily=CRYPTO_ALGOFAM_RSA, CryptoPrimitiveService=CRYPTO_SIGNATURE_GENERATE, CryptoPrimitiveAlgorithmMode=CRYPTO_ALGOMODE_RSASSA_PSS, CryptoPrimitiveAlgorithmSecondaryFamily=CRYPTO_ALGOFAM_SHA2_384
        RsaPssSha384Verify: CryptoPrimitiveAlgorithmFamily=CRYPTO_ALGOFAM_RSA, CryptoPrimitiveService=CRYPTO_SIGNATURE_VERIFY, CryptoPrimitiveAlgorithmMode=CRYPTO_ALGOMODE_RSASSA_PSS, CryptoPrimitiveAlgorithmSecondaryFamily=CRYPTO_ALGOFAM_SHA2_384
        KeySetInvalid: CryptoPrimitiveService=CRYPTO_KEYSETINVALID, CryptoPrimitiveAlgorithmFamily=CRYPTO_ALGOFAM_NOT_SET, CryptoPrimitiveAlgorithmMode=CRYPTO_ALGOMODE_NOT_SET, CryptoPrimitiveAlgorithmSecondaryFamily=CRYPTO_ALGOFAM_NOT_SET
        KeyDeriveNist800108CtrModeCmacAes: CryptoPrimitiveService=CRYPTO_KEY_DERIVE, CryptoPrimitiveAlgorithmMode=CRYPTO_ALGOMODE_CTR, CryptoPrimitiveAlgorithmSecondaryFamily=CRYPTO_ALGOFAM_AES, CryptoPrimitiveAlgorithmFamily=CRYPTO_ALGOFAM_CUSTOM, CryptoPrimitiveAlgorithmFamilyCustomRef=Crypto_30_LibCv_NIST800108
      Crypto_30_LibCv_NIST800108 (CryptoPrimitiveAlgorithmFamilyCustom): CryptoPrimitiveAlgorithmFamilyCustomId=202
      17 x CryptoPrimitive:
        SHA512_224: CryptoPrimitiveAlgorithmSecondaryFamily=CRYPTO_ALGOFAM_NOT_SET, CryptoPrimitiveAlgorithmMode=CRYPTO_ALGOMODE_NOT_SET, CryptoPrimitiveService=CRYPTO_HASH, CryptoPrimitiveAlgorithmFamily=CRYPTO_ALGOFAM_SHA2_512_224
        SHA512_256: CryptoPrimitiveAlgorithmSecondaryFamily=CRYPTO_ALGOFAM_NOT_SET, CryptoPrimitiveAlgorithmMode=CRYPTO_ALGOMODE_NOT_SET, CryptoPrimitiveService=CRYPTO_HASH, CryptoPrimitiveAlgorithmFamily=CRYPTO_ALGOFAM_SHA2_512_256
        SHA224: CryptoPrimitiveAlgorithmSecondaryFamily=CRYPTO_ALGOFAM_NOT_SET, CryptoPrimitiveAlgorithmMode=CRYPTO_ALGOMODE_NOT_SET, CryptoPrimitiveService=CRYPTO_HASH, CryptoPrimitiveAlgorithmFamily=CRYPTO_ALGOFAM_SHA2_224
        SlhDsaSha2_128sVerifyPhSha2_256: CryptoPrimitiveAlgorithmFamily=CRYPTO_ALGOFAM_CUSTOM, CryptoPrimitiveAlgorithmMode=CRYPTO_ALGOMODE_CUSTOM, CryptoPrimitiveService=CRYPTO_SIGNATURE_VERIFY, CryptoPrimitiveAlgorithmSecondaryFamily=CRYPTO_ALGOFAM_SHA2_256, CryptoPrimitiveAlgorithmFamilyCustomRef=Crypto_30_LibCv_SLH_DSA, CryptoPrimitiveAlgorithmModeCustomRef=Crypto_30_LibCv_SHA2_128S
        SlhDsaSha2_128sVerifyPhSha2_384: CryptoPrimitiveAlgorithmFamily=CRYPTO_ALGOFAM_CUSTOM, CryptoPrimitiveAlgorithmMode=CRYPTO_ALGOMODE_CUSTOM, CryptoPrimitiveService=CRYPTO_SIGNATURE_VERIFY, CryptoPrimitiveAlgorithmSecondaryFamily=CRYPTO_ALGOFAM_SHA2_384, CryptoPrimitiveAlgorithmFamilyCustomRef=Crypto_30_LibCv_SLH_DSA, CryptoPrimitiveAlgorithmModeCustomRef=Crypto_30_LibCv_SHA2_128S
        SlhDsaSha2_128sVerifyPhSha2_512: CryptoPrimitiveAlgorithmFamily=CRYPTO_ALGOFAM_CUSTOM, CryptoPrimitiveAlgorithmMode=CRYPTO_ALGOMODE_CUSTOM, CryptoPrimitiveService=CRYPTO_SIGNATURE_VERIFY, CryptoPrimitiveAlgorithmSecondaryFamily=CRYPTO_ALGOFAM_SHA2_512, CryptoPrimitiveAlgorithmFamilyCustomRef=Crypto_30_LibCv_SLH_DSA, CryptoPrimitiveAlgorithmModeCustomRef=Crypto_30_LibCv_SHA2_128S
        SlhDsaSha2_128sVerifyPhSha2_224: CryptoPrimitiveAlgorithmFamily=CRYPTO_ALGOFAM_CUSTOM, CryptoPrimitiveAlgorithmMode=CRYPTO_ALGOMODE_CUSTOM, CryptoPrimitiveService=CRYPTO_SIGNATURE_VERIFY, CryptoPrimitiveAlgorithmSecondaryFamily=CRYPTO_ALGOFAM_SHA2_224, CryptoPrimitiveAlgorithmFamilyCustomRef=Crypto_30_LibCv_SLH_DSA, CryptoPrimitiveAlgorithmModeCustomRef=Crypto_30_LibCv_SHA2_128S
        SlhDsaSha2_128sVerifyPhSha2_512_224: CryptoPrimitiveAlgorithmFamily=CRYPTO_ALGOFAM_CUSTOM, CryptoPrimitiveAlgorithmMode=CRYPTO_ALGOMODE_CUSTOM, CryptoPrimitiveService=CRYPTO_SIGNATURE_VERIFY, CryptoPrimitiveAlgorithmSecondaryFamily=CRYPTO_ALGOFAM_SHA2_512_224, CryptoPrimitiveAlgorithmFamilyCustomRef=Crypto_30_LibCv_SLH_DSA, CryptoPrimitiveAlgorithmModeCustomRef=Crypto_30_LibCv_SHA2_128S
        SlhDsaSha2_128sVerifyPhSha2_512_256: CryptoPrimitiveAlgorithmFamily=CRYPTO_ALGOFAM_CUSTOM, CryptoPrimitiveAlgorithmMode=CRYPTO_ALGOMODE_CUSTOM, CryptoPrimitiveService=CRYPTO_SIGNATURE_VERIFY, CryptoPrimitiveAlgorithmSecondaryFamily=CRYPTO_ALGOFAM_SHA2_512_256, CryptoPrimitiveAlgorithmFamilyCustomRef=Crypto_30_LibCv_SLH_DSA, CryptoPrimitiveAlgorithmModeCustomRef=Crypto_30_LibCv_SHA2_128S
        SlhDsaSha2_128sVerifyPhSha3_224: CryptoPrimitiveAlgorithmFamily=CRYPTO_ALGOFAM_CUSTOM, CryptoPrimitiveAlgorithmMode=CRYPTO_ALGOMODE_CUSTOM, CryptoPrimitiveService=CRYPTO_SIGNATURE_VERIFY, CryptoPrimitiveAlgorithmSecondaryFamily=CRYPTO_ALGOFAM_SHA3_224, CryptoPrimitiveAlgorithmFamilyCustomRef=Crypto_30_LibCv_SLH_DSA, CryptoPrimitiveAlgorithmModeCustomRef=Crypto_30_LibCv_SHA2_128S
        SlhDsaSha2_128sVerifyPhSha3_384: CryptoPrimitiveAlgorithmFamily=CRYPTO_ALGOFAM_CUSTOM, CryptoPrimitiveAlgorithmMode=CRYPTO_ALGOMODE_CUSTOM, CryptoPrimitiveService=CRYPTO_SIGNATURE_VERIFY, CryptoPrimitiveAlgorithmSecondaryFamily=CRYPTO_ALGOFAM_SHA3_384, CryptoPrimitiveAlgorithmFamilyCustomRef=Crypto_30_LibCv_SLH_DSA, CryptoPrimitiveAlgorithmModeCustomRef=Crypto_30_LibCv_SHA2_128S
        SlhDsaSha2_128sVerifyPhSha3_512: CryptoPrimitiveAlgorithmFamily=CRYPTO_ALGOFAM_CUSTOM, CryptoPrimitiveAlgorithmMode=CRYPTO_ALGOMODE_CUSTOM, CryptoPrimitiveService=CRYPTO_SIGNATURE_VERIFY, CryptoPrimitiveAlgorithmSecondaryFamily=CRYPTO_ALGOFAM_SHA3_512, CryptoPrimitiveAlgorithmFamilyCustomRef=Crypto_30_LibCv_SLH_DSA, CryptoPrimitiveAlgorithmModeCustomRef=Crypto_30_LibCv_SHA2_128S
        SlhDsaSha2_128sVerifyPhShake128: CryptoPrimitiveAlgorithmFamily=CRYPTO_ALGOFAM_CUSTOM, CryptoPrimitiveAlgorithmMode=CRYPTO_ALGOMODE_CUSTOM, CryptoPrimitiveService=CRYPTO_SIGNATURE_VERIFY, CryptoPrimitiveAlgorithmSecondaryFamily=CRYPTO_ALGOFAM_SHAKE128, CryptoPrimitiveAlgorithmFamilyCustomRef=Crypto_30_LibCv_SLH_DSA, CryptoPrimitiveAlgorithmModeCustomRef=Crypto_30_LibCv_SHA2_128S
        SlhDsaSha2_128sVerifyPhShake256: CryptoPrimitiveAlgorithmFamily=CRYPTO_ALGOFAM_CUSTOM, CryptoPrimitiveAlgorithmMode=CRYPTO_ALGOMODE_CUSTOM, CryptoPrimitiveService=CRYPTO_SIGNATURE_VERIFY, CryptoPrimitiveAlgorithmSecondaryFamily=CRYPTO_ALGOFAM_SHAKE256, CryptoPrimitiveAlgorithmFamilyCustomRef=Crypto_30_LibCv_SLH_DSA, CryptoPrimitiveAlgorithmModeCustomRef=Crypto_30_LibCv_SHA2_128S
        SlhDsaSha2_128sVerifyPhSha3_256: CryptoPrimitiveAlgorithmFamily=CRYPTO_ALGOFAM_CUSTOM, CryptoPrimitiveAlgorithmMode=CRYPTO_ALGOMODE_CUSTOM, CryptoPrimitiveService=CRYPTO_SIGNATURE_VERIFY, CryptoPrimitiveAlgorithmSecondaryFamily=CRYPTO_ALGOFAM_SHA3_256, CryptoPrimitiveAlgorithmFamilyCustomRef=Crypto_30_LibCv_SLH_DSA, CryptoPrimitiveAlgorithmModeCustomRef=Crypto_30_LibCv_SHA2_128S
        KeyWrapAes: CryptoPrimitiveAlgorithmMode=CRYPTO_ALGOMODE_AESKEYWRAP, CryptoPrimitiveAlgorithmSecondaryFamily=CRYPTO_ALGOFAM_NOT_SET, CryptoPrimitiveAlgorithmFamily=CRYPTO_ALGOFAM_AES, CryptoPrimitiveService=CRYPTO_KEYWRAP
        KeyUnwrapAes: CryptoPrimitiveAlgorithmFamily=CRYPTO_ALGOFAM_AES, CryptoPrimitiveAlgorithmMode=CRYPTO_ALGOMODE_AESKEYWRAP, CryptoPrimitiveAlgorithmSecondaryFamily=CRYPTO_ALGOFAM_NOT_SET, CryptoPrimitiveService=CRYPTO_KEYUNWRAP
    CryptoNvStorage: CryptoNvManagementDataPerKey=4, CryptoNvWriteBlockFctName=NvM_WriteBlock
