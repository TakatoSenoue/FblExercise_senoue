AUTOSAR XML (schema 00049)
package /ActiveEcuC
  module config PduR: implementation-config-variant=VARIANT-PRE-COMPILE, module-description=PduR_Impl
    PduRGeneral:
      PduRVersionInfoApi = false
      PduRDevErrorDetect = true
      PduRMetaDataSupport = false
      PduRPduCallback = false
      PduRSafeBswChecks = true
      PduREnableDeferredTransmission = false
      PduREnableDeferredReception = false
      PduRSupportMulticore = false
      PduRRoutingTypeGateway = false
      PduRSpinlockRetryCounter = 4294967295
      PduRExtendedErrorChecks = false
      PduRGeneration:
        PduROutOfBoundsWriteProtectionStrategy = NONE
        PduROutOfBoundsWriteSanitizer = false
        PduROutOfBoundsReadSanitizer = false
        PduRNumericalDataTypeMinimizationStrategy = WITH_CAST
        PduRReduceConstantData2Define = true
        PduRBoolDataInArrayOfStructStrategy = BITFIELD
        PduRDeduplicateIndirectedData = true
        PduRDataDeduplicationStrategy = WITH_CAST
        PduRReduceBoolDataByNegationThreshold = 2
        PduRReduceBoolDataByNumericalComparisonThreshold = 2
        PduRReduceBoolDataByNumericalRelationThreshold = 2
        PduRReduceBoolDataByNumericalOperandStrategy = WITH_ANY_VALUE
        PduRReduceNumericalDataByOffsetThreshold = 2
        PduRReduceNumericalDataByArraySubtractionThreshold = 2
        PduRReduceDataByStreaming = false
        PduRShortSymbols = false
        PduRInterfacesForDeactivatedData = false
        PduRReferringKeysInComments = false
        PduREnableAdditionalRAMDebugData = false
    PduRRoutingTables: PduRConfigurationId=0
      PduRRoutingTable
        6 x PduRRoutingPath, all with PduRRoutingPathCommunicationType=TRANSPORT_PROTOCOL, PduRMulticoreRoutingPath=false, PduRLockRef=PduRLock_PduRExclusiveArea:
          Demo_0_CAN_FD_Request_oDemoFBL_Vector_SLP3_6635a675_Rx
            Demo_0_CAN_FD_Request_oDemoFBL_Vector_SLP3_6635a675_Rx_425f3fdc_Rx (PduRDestPdu):
              PduRDestPduHandleId = 1
              PduRDestPduDirection = RECEIVE
              PduRDestPduRoutingType = API_FORWARDING
              PduRDestPduDataProcessing = IMMEDIATE
              PduRPduLengthHandlingStrategy = UNUSED
              PduRDestPduCrossPartitionDestination = false
              PduRDestPduRef = Demo_0_CAN_FD_Request_oDemoFBL_Vector_SLP3_67f6c3c9_Rx
              PduRDestPduPduRBswModulesRef = Dcm
            PduRSrcPdu_425f3fdc (PduRSrcPdu):
              PduRSourcePduHandleId = 1
              PduRSrcPduDirection = RECEIVE
              PduRSrcPduRef = Demo_0_CAN_FD_Request_oDemoFBL_Vector_SLP3_6635a675_Rx
              PduRSrcPduPduRBswModulesRef = CanTp
          Demo_0_CAN_FD_Response_oDemoFBL_Vector_SLP3_20_fac2fc54_Tx
            Demo_0_CAN_FD_Response_oDemoFBL_Vector_SLP3_20_50875972_Tx (PduRDestPdu):
              PduRDestPduHandleId = 1
              PduRDestPduDirection = TRANSMIT
              PduRDestPduRoutingType = API_FORWARDING
              PduRDestPduDataProcessing = IMMEDIATE
              PduRPduLengthHandlingStrategy = UNUSED
              PduRDestPduCrossPartitionDestination = false
              PduRDestPduRef = Demo_0_CAN_FD_Response_oDemoFBL_Vector_SLP3_20_50875972_Tx
              PduRDestPduPduRBswModulesRef = CanTp
            PduRSrcPdu_554525c7 (PduRSrcPdu):
              PduRSourcePduHandleId = 1
              PduRSrcPduDirection = TRANSMIT
              PduRSrcPduRef = Demo_0_CAN_FD_Response_oDemoFBL_Vector_SLP3_20_fac2fc54_Tx
              PduRSrcPduPduRBswModulesRef = Dcm
          Functional_CAN_FD_oDemoFBL_Vector_SLP3_ed563a98_Rx
            Functional_CAN_FD_oDemoFBL_Vector_SLP3_ed563a98_Rx_1cf8eade_Rx (PduRDestPdu):
              PduRDestPduHandleId = 2
              PduRDestPduDirection = RECEIVE
              PduRDestPduRoutingType = API_FORWARDING
              PduRDestPduDataProcessing = IMMEDIATE
              PduRPduLengthHandlingStrategy = UNUSED
              PduRDestPduCrossPartitionDestination = false
              PduRDestPduRef = Functional_CAN_FD_oDemoFBL_Vector_SLP3_3cffe9e9_Rx
              PduRDestPduPduRBswModulesRef = Dcm
            PduRSrcPdu_1cf8eade (PduRSrcPdu):
              PduRSourcePduHandleId = 3
              PduRSrcPduDirection = RECEIVE
              PduRSrcPduRef = Functional_CAN_FD_oDemoFBL_Vector_SLP3_ed563a98_Rx
              PduRSrcPduPduRBswModulesRef = CanTp
          Demo_0_CAN_FD_Response_oDemoFBL_Vector_SLP3_01a35bfe_Tx
            Demo_0_CAN_FD_Response_oDemoFBL_Vector_SLP3_8fbef359_Tx (PduRDestPdu):
              PduRDestPduHandleId = 0
              PduRDestPduDirection = TRANSMIT
              PduRDestPduRoutingType = API_FORWARDING
              PduRDestPduDataProcessing = IMMEDIATE
              PduRPduLengthHandlingStrategy = UNUSED
              PduRDestPduCrossPartitionDestination = false
              PduRDestPduRef = Demo_0_CAN_FD_Response_oDemoFBL_Vector_SLP3_8fbef359_Tx
              PduRDestPduPduRBswModulesRef = CanTp
            PduRSrcPdu_c8f30f5f (PduRSrcPdu):
              PduRSourcePduHandleId = 0
              PduRSrcPduDirection = TRANSMIT
              PduRSrcPduRef = Demo_0_CAN_FD_Response_oDemoFBL_Vector_SLP3_01a35bfe_Tx
              PduRSrcPduPduRBswModulesRef = Dcm
          Demo_0_CAN_FD_Request_oDemoFBL_Vector_SLP3_20_dc7615a6_Rx
            PduRSrcPdu_5b048e34 (PduRSrcPdu):
              PduRSourcePduHandleId = 0
              PduRSrcPduDirection = RECEIVE
              PduRSrcPduRef = Demo_0_CAN_FD_Request_oDemoFBL_Vector_SLP3_20_dc7615a6_Rx
              PduRSrcPduPduRBswModulesRef = CanTp
            Demo_0_CAN_FD_Request_oDemoFBL_Vector_SLP3_20_dc7615a6_Rx_5b048e34_Rx (PduRDestPdu):
              PduRDestPduHandleId = 0
              PduRDestPduDirection = RECEIVE
              PduRDestPduRoutingType = API_FORWARDING
              PduRDestPduDataProcessing = IMMEDIATE
              PduRPduLengthHandlingStrategy = UNUSED
              PduRDestPduCrossPartitionDestination = false
              PduRDestPduRef = Demo_0_CAN_FD_Request_oDemoFBL_Vector_SLP3_20_797faa4e_Rx
              PduRDestPduPduRBswModulesRef = Dcm
          Functional_CAN_FD_oDemoFBL_Vector_SLP3_20_7403a32a_Rx
            Functional_CAN_FD_oDemoFBL_Vector_SLP3_20_7403a32a_Rx_3d6136a3_Rx (PduRDestPdu):
              PduRDestPduHandleId = 3
              PduRDestPduDirection = RECEIVE
              PduRDestPduRoutingType = API_FORWARDING
              PduRDestPduDataProcessing = IMMEDIATE
              PduRPduLengthHandlingStrategy = UNUSED
              PduRDestPduCrossPartitionDestination = false
              PduRDestPduRef = Functional_CAN_FD_oDemoFBL_Vector_SLP3_20_57859879_Rx
              PduRDestPduPduRBswModulesRef = Dcm
            PduRSrcPdu_3d6136a3 (PduRSrcPdu):
              PduRSourcePduHandleId = 2
              PduRSrcPduDirection = RECEIVE
              PduRSrcPduRef = Functional_CAN_FD_oDemoFBL_Vector_SLP3_20_7403a32a_Rx
              PduRSrcPduPduRBswModulesRef = CanTp
      PduRLock_PduRExclusiveArea (PduRLock)
        PduRExclusiveArea: PduRExclusiveAreaId=0
    CanTp (PduRBswModules):
      PduRCancelReceive = false
      PduRCancelTransmit = false
      PduRChangeParameterRequestApi = false
      PduRCommunicationInterface = false
      PduRLowerModule = true
      PduRTransportProtocol = true
      PduRTriggertransmit = false
      PduRTxConfirmation = false
      PduRUpperModule = false
      PduRUseTag = false
      PduRBswModuleRef = CanTp
    Dcm (PduRBswModules):
      PduRCancelReceive = false
      PduRCancelTransmit = false
      PduRChangeParameterRequestApi = false
      PduRCommunicationInterface = false
      PduRLowerModule = false
      PduRTransportProtocol = true
      PduRTriggertransmit = false
      PduRTxConfirmation = false
      PduRUpperModule = true
      PduRUseTag = true
      PduRBswModuleRef = Dcm
