AUTOSAR XML (schema 00049)
package /ActiveEcuC
  module config WrapNv: implementation-config-variant=VARIANT-PRE-COMPILE, module-description=WrapNv_Impl
    WrapNvMemoryLayout
      8 x WrapNvDataBlock, all with WrapNvDbAccessMacro=false:
        ProgReqFlag: WrapNvDbDescription=Programming indication set by application software, WrapNvDbIndex=0, WrapNvDbType=SINGLE, WrapNvDbCount=1
          ProgReqFlag (WrapNvDataElement): WrapNvDeDescription=Programming indication set by application software, WrapNvDeIndex=0, WrapNvDeLength=1, WrapNvDeDefaultValue=0xFF
        ResetResponseFlag: WrapNvDbDescription=Flag if a response to a request received before response is required, WrapNvDbIndex=1, WrapNvDbType=SINGLE, WrapNvDbCount=1
          ResetResponseFlag (WrapNvDataElement):
            WrapNvDeDescription = Flag if a response to a request received before response is required
            WrapNvDeIndex = 0
            WrapNvDeLength = 1
            WrapNvDeDefaultValue = 0xFF
        ApplValidity: WrapNvDbDescription=Application validity flag, WrapNvDbIndex=2, WrapNvDbType=SINGLE, WrapNvDbCount=1
          ApplValidity (WrapNvDataElement): WrapNvDeDescription=Application validity flag, WrapNvDeIndex=0, WrapNvDeLength=1, WrapNvDeDefaultValue=0xFF
        ValidityFlags: WrapNvDbDescription=Logical block validity information, WrapNvDbIndex=3, WrapNvDbType=SINGLE, WrapNvDbCount=1
          ValidityFlags (WrapNvDataElement): WrapNvDeDescription=Logical block validity information, WrapNvDeIndex=0, WrapNvDeLength=1, WrapNvDeDefaultValue=0xFF
        SecAccessDelayFlag: WrapNvDbDescription=Security Access delay flag, WrapNvDbIndex=4, WrapNvDbType=SINGLE, WrapNvDbCount=1
          SecAccessDelayFlag (WrapNvDataElement): WrapNvDeDescription=Security Access delay flag, WrapNvDeIndex=0, WrapNvDeLength=1, WrapNvDeDefaultValue=0xFF
        SecAccessInvalidCount: WrapNvDbDescription=Invalid security access attempt counter, WrapNvDbIndex=5, WrapNvDbType=SINGLE, WrapNvDbCount=1
          SecAccessInvalidCount (WrapNvDataElement): WrapNvDeDescription=Invalid security access attempt counter, WrapNvDeIndex=0, WrapNvDeLength=1, WrapNvDeDefaultValue=0xFF
        DcmDslRxTesterSourceAddr: WrapNvDbDescription=Diagnostic connection tester source address to synchronize address between application and bootloader, WrapNvDbIndex=6, WrapNvDbType=SINGLE, WrapNvDbCount=1
          DcmDslRxTesterSourceAddr (WrapNvDataElement):
            WrapNvDeDescription = Diagnostic connection tester source address to synchronize address between application and bootloader
            WrapNvDeLength = 2
            WrapNvDeIndex = 0
            WrapNvDeDefaultValue = 0xFF
        MetaData: WrapNvDbDescription=Process data stored for each logical block, WrapNvDbCount=3, WrapNvDbIndex=16, WrapNvDbType=TABLE
          3 x WrapNvDataElement, all with WrapNvDeDefaultValue=0xFF:
            Fingerprint: WrapNvDeLength=9, WrapNvDeDescription=Fingerprint (programming date and tester serial number), WrapNvDeIndex=0
            ProgCounter: WrapNvDeLength=2, WrapNvDeDescription=Successful reprogramming attempts, WrapNvDeIndex=1
            ProgAttempts: WrapNvDeLength=2, WrapNvDeDescription=Reprogramming attempts, WrapNvDeIndex=2
    WrapNvGeneral:
      WrapNvMainFunctionPolling = true
      WrapNvEEPROMBaseAddress = 4277153800
      WrapNvFirstHandle = 1
      WrapNvNVMDataHandling = EXTERNAL_EEPROM_DRIVER
      WrapNvDevErrorDetect = true
      WrapNvHandleNvmApis = false
      WrapNvAutoSyncRamBlocks = false
