AUTOSAR XML (schema 00049)
package /ActiveEcuC
  module config FblBm: implementation-config-variant=VARIANT-PRE-COMPILE, module-description=FblBm_Impl
    FblBmGeneral:
      FblBmFailsafeUpdater = true
      FblBmExecutionInstance = FlashBootloader
      FblBmStandaloneMode = true
      FblBmSecureBoot = false
      FblBmIncludeOemConfiguration = false
      FblBmIncludeHardwareConfiguration = false
      FblBmHeaderAddress = 65264
      FblBmInitializeKeys = false
      FblBmInitializeMacOfBootloader = false
      FblBmFailsafeUpdaterUser = false
    FblBmBootOrder
      FblBmBootTarget_Appl (FblBmBootTarget): FblBmBootOrderId=0, FblBmBootTargetRef=Appl
