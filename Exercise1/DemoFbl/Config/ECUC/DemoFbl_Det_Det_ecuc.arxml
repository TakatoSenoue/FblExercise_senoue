AUTOSAR XML (schema 00049)
package /ActiveEcuC
  module config Det: implementation-config-variant=VARIANT-PRE-COMPILE, module-description=Det_Impl
    DetGeneral:
      DetVersionInfoApi = false
      DetEnableDet = true
      DetExtDebugSupport = false
      DetGlobalFilterSize = 0
      DetBreakFilterSize = 0
      DetLogBufferSize = 0
      DetReportErrorRecursionLimit = 0
      DetReportRuntimeErrorRecursionLimit = 0
      DetReportTransientFaultRecursionLimit = 0
      DetDltFilterSize = 0
      DetRuntimeErrorForwarding = false
    DetNotification:
      DetErrorHook = ApplFbl_DetEntryHandler
      DetReportRuntimeErrorCallout = ApplFbl_DetEntryHandler
      DetReportTransientFaultCallout = ApplFbl_DetEntryHandler
