AUTOSAR XML (schema 00049)
package /ActiveEcuC
  module config CanIf: implementation-config-variant=VARIANT-PRE-COMPILE, module-description=CanIf_Impl
    CanIfPublicCfg:
      CanIfPublicPnSupport = false
      CanIfPublicCddHeaderFile = CanIf_Cdd.h
      CanIfPublicVersionInfoApi = false
      CanIfPublicCancelTransmitSupport = false
      CanIfPublicDevErrorDetect = true
      CanIfPublicHandleTypeEnum = UINT8
      CanIfPublicMultipleDrvSupport = false
      CanIfPublicNumberOfCanHwUnits = 1
      CanIfPublicReadRxPduDataApi = false
      CanIfPublicReadRxPduNotifyStatusApi = false
      CanIfPublicReadTxPduNotifyStatusApi = false
      CanIfPublicSetDynamicTxIdApi = false
      CanIfPublicTxBuffering = true
      CanIfPublicTxConfirmPollingSupport = false
      CanIfPublicWakeupCheckValidSupport = false
      CanIfPnWakeupTxPduFilterSupport = false
      CanIfPnTrcvHandlingSupport = false
      CanIfJ1939DynAddrSupport = DISABLED
      CanIfSafeBswChecks = true
      CanIfBusMirroringSupport = false
      CanIfEnableSecurityEventReporting = false
      CanIfSupportMultipartition = false
      CanIfPublicSetDynamicRxIdApi = false
      CanIfPublicChangeBaudrateSupport = false
      CanIfSetBaudrateApi = false
      CanIfExtendedRamCheckSupport = false
    CanIfInitCfg
      CanIfInitHohCfg: CanIfInitRefCfgSet=CanConfigSet
        CN_DemoFBL_Vector_SLP3_dfd96cca_Rx (CanIfHrhCfg): CanIfHrhSoftwareFilter=true, CanIfHrhCanCtrlIdRef=CT_DemoFBL_Vector_SLP3_216858f6, CanIfHrhIdSymRef=CN_DemoFBL_Vector_SLP3_dfd96cca_Rx
        CN_DemoFBL_Vector_SLP3_abba4211_Tx (CanIfHthCfg): CanIfHthCanCtrlIdRef=CT_DemoFBL_Vector_SLP3_216858f6, CanIfHthIdSymRef=CN_DemoFBL_Vector_SLP3_abba4211_Tx
      CHNL_3b54cc70 (CanIfBufferCfg):
        CanIfBufferSize = 2
        CanIfTxBufferHandlingType = PRIO_BY_CANID
        CanIfTxBufferMappedTxPdus = 2
        CanIfTxBufferMaxPduLength = 64
        CanIfBufferHthRef = CN_DemoFBL_Vector_SLP3_abba4211_Tx
      Demo_0_CAN_FD_Response_Tp_oDemoFBL_Vector_SLP3_efb2f3be_Tx (CanIfTxPduCfg):
        CanIfTxPduCanId = 1458
        CanIfTxPduCanIdType = STANDARD_FD_CAN
        CanIfTxPduDlc = 64
        CanIfTxPduUserTxConfirmationName = CanTp_TxConfirmation
        CanIfTxPduUserTxConfirmationUL = CAN_TP
        CanIfTxPduId = 0
        CanIfTxPduReadNotifyStatus = false
        CanIfTxPduType = STATIC
        CanIfTxPduTruncation = true
        CanIfTxPduBufferRef = CHNL_3b54cc70
        CanIfTxPduRef = Demo_0_CAN_FD_Response_Tp_oDemoFBL_Vector_SLP3_126039d0_Tx
      Demo_0_CAN_FD_Request_Tp_oDemoFBL_Vector_SLP3_20_507d1247_Rx (CanIfRxPduCfg):
        CanIfRxPduCanId = 1442
        CanIfRxPduCanIdType = STANDARD_NO_FD_CAN
        CanIfRxPduDlc = 8
        CanIfRxPduUserRxIndicationName = CanTp_RxIndication
        CanIfRxPduUserRxIndicationType = PDUID_PDUINFOPTR
        CanIfRxPduUserRxIndicationUL = CAN_TP
        CanIfRxPduId = 3
        CanIfRxPduReadData = false
        CanIfRxPduReadNotifyStatus = false
        CanIfRxPduDlcCheck = false
        CanIfRxPduType = STATIC
        CanIfRxPduHrhIdRef = CN_DemoFBL_Vector_SLP3_dfd96cca_Rx
        CanIfRxPduRef = Demo_0_CAN_FD_Request_Tp_oDemoFBL_Vector_SLP3_20_f2ebe614_Rx
      Demo_0_CAN_FD_Response_Tp_oDemoFBL_Vector_SLP3_20_cf88ffc8_Tx (CanIfTxPduCfg):
        CanIfTxPduCanId = 1458
        CanIfTxPduCanIdType = STANDARD_CAN
        CanIfTxPduDlc = 8
        CanIfTxPduUserTxConfirmationName = CanTp_TxConfirmation
        CanIfTxPduUserTxConfirmationUL = CAN_TP
        CanIfTxPduId = 1
        CanIfTxPduReadNotifyStatus = false
        CanIfTxPduType = STATIC
        CanIfTxPduTruncation = true
        CanIfTxPduBufferRef = CHNL_3b54cc70
        CanIfTxPduRef = Demo_0_CAN_FD_Response_Tp_oDemoFBL_Vector_SLP3_20_ee1db9f7_Tx
      3 x CanIfRxPduCfg, all with CanIfRxPduUserRxIndicationName=CanTp_RxIndication, CanIfRxPduUserRxIndicationType=PDUID_PDUINFOPTR, CanIfRxPduUserRxIndicationUL=CAN_TP, CanIfRxPduReadData=false, CanIfRxPduReadNotifyStatus=false, CanIfRxPduDlcCheck=false, CanIfRxPduType=STATIC, CanIfRxPduHrhIdRef=CN_DemoFBL_Vector_SLP3_dfd96cca_Rx:
        Demo_0_CAN_FD_Request_Tp_oDemoFBL_Vector_SLP3_c807a36f_Rx: CanIfRxPduCanId=1442, CanIfRxPduCanIdType=STANDARD_FD_CAN, CanIfRxPduDlc=64, CanIfRxPduId=2, CanIfRxPduRef=Demo_0_CAN_FD_Request_Tp_oDemoFBL_Vector_SLP3_9e917504_Rx
        Functional_CAN_FD_Tp_oDemoFBL_Vector_SLP3_646360de_Rx: CanIfRxPduCanId=1913, CanIfRxPduCanIdType=STANDARD_FD_CAN, CanIfRxPduDlc=64, CanIfRxPduId=0, CanIfRxPduRef=Functional_CAN_FD_Tp_oDemoFBL_Vector_SLP3_36e4c388_Rx
        Functional_CAN_FD_Tp_oDemoFBL_Vector_SLP3_20_12cf71bb_Rx: CanIfRxPduCanId=1913, CanIfRxPduCanIdType=STANDARD_NO_FD_CAN, CanIfRxPduDlc=8, CanIfRxPduId=1, CanIfRxPduRef=Functional_CAN_FD_Tp_oDemoFBL_Vector_SLP3_20_883488d5_Rx
    CanIfPrivateCfg:
      CanIfPrivateSoftwareFilterType = DOUBLEHASH
      CanIfPrivateDlcCheck = false
      CanIfSupportTTCAN = false
      CanIfTransceiverMapping = false
      CanIfTransceiverHandling = false
      CanIfSupportExtendedIds = false
      CanIfSupportNmOsek = false
      CanIfWakeupSupport = false
      CanIfStaticFdTxBufferSupport = true
      CanIfRxSearchConsiderMsgType = true
      CanIfTxBufferFifoSupport = false
      CanIfSetPduReceptionModeSupport = false
      CanIfTxBufferPrioByCanIdSupport = true
      CanIfSupportCanXL = false
      CanIfDataChecksumRxSupport = false
      CanIfDataChecksumTxSupport = false
      CanIfDoubleHashAdditionalMemory = 21
      CanIfDoubleHashAdjustCount = 5
    CanIfDispatchCfg:
      CanIfDispatchUserCtrlBusOffName = FblCw_ControllerBusOff
      CanIfDispatchUserCtrlBusOffUL = CDD
      CanIfDispatchUserCtrlModeIndicationName = FblCw_ControllerModeIndication
      CanIfDispatchUserCtrlModeIndicationUL = CDD
    CanIfCtrlDrvCfg_7d254554 (CanIfCtrlDrvCfg):
      CanIfCtrlDrvTxCancellation = false
      CanIfCtrlDrvArVersion = CAN_DRV_EQC_MSRC
      CanIfCtrlDrvInitHohConfigRef = CanIfInitHohCfg
      CanIfCtrlDrvNameRef = CanGeneral
      CT_DemoFBL_Vector_SLP3_216858f6 (CanIfCtrlCfg):
        CanIfCtrlId = 0
        CanIfCtrlWakeupSupport = false
        CanIfCtrlJ1939DynAddrSupport = DISABLED
        CanIfDoubleHashRandom1 = 18236
        CanIfDoubleHashRandom2 = 42381
        CanIfCtrlCanCtrlRef = CT_DemoFBL_Vector_SLP3_216858f6
