AUTOSAR XML (schema 00049)
package /MICROSAR/Can_Rh850Rscanfd_ib_bswmd/BswModuleDescriptions
  bsw module description Can
    provided-entrys:
      Can_MainFunction_BusOff
      Can_MainFunction_Wakeup
      Can_MainFunction_Mode
      Can_MainFunction_Read
      Can_MainFunction_Write
    bsw internal behavior Can_Rh850RscanfdBehavior
      8 x exclusive area:
        CAN_EXCLUSIVE_AREA_{0..7}
      5 x bsw schedulable entity, all with can-enter-exclusive-area=[CAN_EXCLUSIVE_AREA_0, CAN_EXCLUSIVE_AREA_1, CAN_EXCLUSIVE_AREA_2, CAN_EXCLUSIVE_AREA_3, CAN_EXCLUSIVE_AREA_4, CAN_EXCLUSIVE_AREA_5, CAN_EXCLUSIVE_AREA_6, CAN_EXCLUSIVE_AREA_7]:
        Can_MainFunction_BusOff: implemented-entry=Can_MainFunction_BusOff
        Can_MainFunction_Wakeup: implemented-entry=Can_MainFunction_Wakeup
        Can_MainFunction_Mode: implemented-entry=Can_MainFunction_Mode
        Can_MainFunction_Read: implemented-entry=Can_MainFunction_Read
        Can_MainFunction_Write: implemented-entry=Can_MainFunction_Write
      5 x bsw timing event, all with period=0.01:
        Can_MainFunction_BusOffTimingEvent0: starts-on-event=Can_MainFunction_BusOff
        Can_MainFunction_WakeupTimingEvent0: starts-on-event=Can_MainFunction_Wakeup
        Can_MainFunction_ModeTimingEvent0: starts-on-event=Can_MainFunction_Mode
        Can_MainFunction_ReadTimingEvent0: starts-on-event=Can_MainFunction_Read
        Can_MainFunction_WriteTimingEvent0: starts-on-event=Can_MainFunction_Write
  5 x bsw module entry, all with call-type=SCHEDULED, execution-context=TASK:
    Can_MainFunction_BusOff
    Can_MainFunction_Wakeup
    Can_MainFunction_Mode
    Can_MainFunction_Read
    Can_MainFunction_Write
