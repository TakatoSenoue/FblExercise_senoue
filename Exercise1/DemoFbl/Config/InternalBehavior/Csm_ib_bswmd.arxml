AUTOSAR XML (schema 4-3-0)
package /MICROSAR/Csm_ib_bswmd/BswModuleDescriptions
  bsw module description Csm: provided-entrys=Csm_Virtual
    bsw internal behavior Behavior
      exclusive area CSM_EXCLUSIVE_AREA_0  # This critical section protects queuing resources that can be accessed from various contexts. Therefore the critical section enclosed with CSM_EXCLUSIVE_AREA_0 should never be interrupted by any Csm API which accesses queuing resources. For more details, see DocTechRef.
      bsw called entity Csm_Virtual: can-enter-exclusive-area=CSM_EXCLUSIVE_AREA_0, implemented-entry=Csm_Virtual
  bsw module entry Csm_Virtual: call-type=REGULAR, execution-context=TASK
