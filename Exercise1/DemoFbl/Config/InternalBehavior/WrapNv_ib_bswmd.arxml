AUTOSAR XML (schema 4-0-3)
package /MICROSAR/WrapNv_ib_bswmd/BswModuleDescriptions
  bsw module description WrapNv: provided-entrys=WrapNv_Virtual
    bsw internal behavior WrapNvBehavior
      exclusive area WRAPNV_EXCLUSIVE_AREA_0
      bsw called entity WrapNv_Virtual: can-enter-exclusive-area=WRAPNV_EXCLUSIVE_AREA_0, implemented-entry=WrapNv_Virtual
  bsw module entry WrapNv_Virtual: call-type=REGULAR, execution-context=TASK
