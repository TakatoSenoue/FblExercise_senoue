AUTOSAR XML (schema 00048)
package /MICROSAR/Crypto_30_LibCv_ib_bswmd/BswModuleDescriptions
  bsw module description Crypto: provided-entrys=Crypto_30_LibCv_MainFunction
    bsw internal behavior Crypto_30_LibCv
      exclusive area CRYPTO_30_LIBCV_EXCLUSIVE_AREA_0  # This critical section protects workspace locking resources, the job queue and the NvBlock state. Furthermore, it ensures the consistency of the global RAM variables for the last job and default random source data.Therefore the critical section enclosed with CRYPTO_30_LIBCV_EXCLUSIVE_AREA_0 should never be interrupted by any other API. For more details, see DocTechRef.
      exclusive area CRYPTO_30_LIBCV_EXCLUSIVE_AREA_1  # This critical section protects key locking resources and ensures the consistency of the key data. If the CRYPTO is accessed by multiple partitions, either key locking has to be disabled (then this critical section implementation can be configured as None) or this critical section implementation has to be configured as Spinlock.Therefore the critical section enclosed with CRYPTO_30_LIBCV_EXCLUSIVE_AREA_1 should never be interrupted by any other API. For more details, see DocTechRef.
      exclusive area CRYPTO_30_LIBCV_EXCLUSIVE_AREA_2  # This critical section protects long-term workspace locking resources. If the CRYPTO is accessed by multiple partitions, either the services which use a long-term workspace have only to be used on one partition or this critical section implementation has to be configured as Spinlock. Therefore the critical section enclosed with CRYPTO_30_LIBCV_EXCLUSIVE_AREA_2 should never be interrupted by any other API. For more details, see DocTechRef.
      bsw schedulable entity Crypto_30_LibCv_MainFunction: can-enter-exclusive-area=[CRYPTO_30_LIBCV_EXCLUSIVE_AREA_0, CRYPTO_30_LIBCV_EXCLUSIVE_AREA_1, CRYPTO_30_LIBCV_EXCLUSIVE_AREA_2], implemented-entry=Crypto_30_LibCv_MainFunction
      bsw timing event Crypto_30_LibCv_MainFunctionTimingEvent0: starts-on-event=Crypto_30_LibCv_MainFunction, period=0.01
  bsw module entry Crypto_30_LibCv_MainFunction: call-type=SCHEDULED, execution-context=TASK
