AUTOSAR XML (schema 00049)
package /ActiveEcuC
  ecuc value collection ActiveEcuC
    ecuc-values:
      MemMap
      Csm
      Can
      vSecPrim
      Crypto
      FblBm
      vBaseEnv
      FblHal
      Det
      EcuC
      Fbl
      FblBmHdr
      Smh
      Dcm
      vBRS
      vSet
      PduR
      WrapNv
      CanIf
      CanTp
      CryIf
      FblAsrStubs
      Os
      vLinkGen
      Mcu
      Port
      Dem
      FblMio
