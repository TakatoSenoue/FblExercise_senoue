AUTOSAR XML (schema 00049)
package /ActiveEcuC
  module config Fbl: implementation-config-variant=VARIANT-LINK-TIME, module-description=Fbl_Impl
    FblGeneral:
      FblDataProcessingBufferSize = 256
      FblDiagnosticBufferSize = 4095
      FblFlashDriverUsage = DOWNLOAD_DRIVER
      FblInternalMemoryCopy = true
      FblMaximumNumberOfSegments = 8
      FblOutputVerification = true
      FblP2Server = 10
      FblP2StarServer = 5000
      FblResponseAfterReset = true
      FblSleepTime = 300000
      FblUnalignedDataTransfer = true
      FblVerificationSegmentation = 256
      FblWriteSegmentation = 256
      FblApplicationStateTask = true
      FblApplicationTimerTask = true
      FblPresencePattern = true
      FblStartFunction = true
      FblAdaptiveDataTransferRcrrp = false
      FblGatewaySupport = false
      FblInputVerification = false
      FblOta = false
      FblHardwareSwap = false
      FblProcessedVerification = false
      FblOneStepUpdater = false
      FblS3ServerExtendedSession = 0
      FblS3ServerProgrammingSession = 0
      FblSuspendDriverOperation = false
      FblVerificationFunction = false
      FblReprogrammableLbt = false
      FblOsuFlashDriverRestoreStrategy = NO_FLASH_DRV_RESTORE
      FblProjectState = INTEGRATION
      FblStayInBoot = true
      FblSleepMode = false
      FblHeaderAddress = 65536
      FblGapFilling = false
      FblFillCode = 255
      FblCommonData = false
      FblUserSubfunction = false
      FblUserService = false
      FblUserRoutine = false
      FblWatchdogService = true
      FblWatchdogTriggerCycle = 1
      FblEncryptionMode = true
      FblCompressionMode = true
      FblPipelinedVerification = true
      FblPipelinedProgramming = true
      FblMaximumAmountOfLogicalBlocks = 1
      FblBlockStartAddress = 65536
      FblBlockLength = 262144
      FblXcpSupport = false
      FblEmbeddedVerificationData = false
      FblDelayFinalResponse = 0
    FblVector:
      FblAccessDelayTime = 10000
      FblCommunicationControlType = ENABLE_RX_AND_DISABLE_TX
      FblProcessDataStorage = true
      FblApplicationValidityFlag = true
      FblControlDTCOptionRecord = true
      FblCheckProgrammingPreconditionsService = true
    FblFlashBlockTable
      59 x FblFlashBlock:
        FblFlashBlock_0: FblFbStartAddress=0, FblFbEndAddress=8191, FblFbDescription=Flash Bank A Block0 (8KB)
        FblFlashBlock_1: FblFbStartAddress=8192, FblFbEndAddress=16383, FblFbDescription=Flash Bank A Block1 (8KB)
        FblFlashBlock_2: FblFbStartAddress=16384, FblFbEndAddress=24575, FblFbDescription=Flash Bank A Block2 (8KB)
        FblFlashBlock_3: FblFbStartAddress=24576, FblFbEndAddress=32767, FblFbDescription=Flash Bank A Block3 (8KB)
        FblFlashBlock_4: FblFbStartAddress=32768, FblFbEndAddress=40959, FblFbDescription=Flash Bank A Block4 (8KB)
        FblFlashBlock_5: FblFbStartAddress=40960, FblFbEndAddress=49151, FblFbDescription=Flash Bank A Block5 (8KB)
        FblFlashBlock_6: FblFbStartAddress=49152, FblFbEndAddress=57343, FblFbDescription=Flash Bank A Block6 (8KB)
        FblFlashBlock_7: FblFbStartAddress=57344, FblFbEndAddress=65535, FblFbDescription=Flash Bank A Block7 (8KB)
        FblFlashBlock_8: FblFbStartAddress=65536, FblFbEndAddress=98303, FblFbDescription=Flash Bank A Block8 (32KB), FblFbMemoryDeviceRef=Flash
        FblFlashBlock_9: FblFbStartAddress=98304, FblFbEndAddress=131071, FblFbDescription=Flash Bank A Block9 (32KB), FblFbMemoryDeviceRef=Flash
        FblFlashBlock_10: FblFbStartAddress=131072, FblFbEndAddress=163839, FblFbDescription=Flash Bank A Block10 (32KB), FblFbMemoryDeviceRef=Flash
        FblFlashBlock_11: FblFbStartAddress=163840, FblFbEndAddress=196607, FblFbDescription=Flash Bank A Block11 (32KB), FblFbMemoryDeviceRef=Flash
        FblFlashBlock_12: FblFbStartAddress=196608, FblFbEndAddress=229375, FblFbDescription=Flash Bank A Block12 (32KB), FblFbMemoryDeviceRef=Flash
        FblFlashBlock_13: FblFbStartAddress=229376, FblFbEndAddress=262143, FblFbDescription=Flash Bank A Block13 (32KB), FblFbMemoryDeviceRef=Flash
        FblFlashBlock_14: FblFbStartAddress=262144, FblFbEndAddress=294911, FblFbDescription=Flash Bank A Block14 (32KB), FblFbMemoryDeviceRef=Flash
        FblFlashBlock_15: FblFbStartAddress=294912, FblFbEndAddress=327679, FblFbDescription=Flash Bank A Block15 (32KB), FblFbMemoryDeviceRef=Flash
        FblFlashBlock_16: FblFbStartAddress=327680, FblFbEndAddress=335871, FblFbDescription=Flash Bank A Block16-0 (8KB), FblFbMemoryDeviceRef=Flash, FblFbLogicalBlockRef=DemoAppl
        FblFlashBlock_17: FblFbStartAddress=335872, FblFbEndAddress=344063, FblFbDescription=Flash Bank A Block16-1 (8KB), FblFbMemoryDeviceRef=Flash, FblFbLogicalBlockRef=DemoAppl
        FblFlashBlock_18: FblFbStartAddress=344064, FblFbEndAddress=352255, FblFbDescription=Flash Bank A Block16-2 (8KB), FblFbMemoryDeviceRef=Flash, FblFbLogicalBlockRef=DemoAppl
        FblFlashBlock_19: FblFbStartAddress=352256, FblFbEndAddress=360447, FblFbDescription=Flash Bank A Block16-3 (8KB), FblFbMemoryDeviceRef=Flash, FblFbLogicalBlockRef=DemoAppl
        FblFlashBlock_71: FblFbStartAddress=16777216, FblFbEndAddress=16809983, FblFbDescription=Extended User Area (32KB), FblFbMemoryDeviceRef=Flash
        FblFlashBlock_72: FblFbStartAddress=4280287232, FblFbEndAddress=4280303615, FblFbDescription=Data Flash Area Block0-255 (16KB)
        FblFlashBlock_73: FblFbStartAddress=4280303616, FblFbEndAddress=4280319999, FblFbDescription=Data Flash Area Block256-511 (16KB)
        FblFlashBlock_20: FblFbStartAddress=360448, FblFbEndAddress=368639, FblFbDescription=Flash Bank A Block17-0 (8KB), FblFbMemoryDeviceRef=Flash, FblFbLogicalBlockRef=DemoAppl
        FblFlashBlock_21: FblFbStartAddress=368640, FblFbEndAddress=376831, FblFbDescription=Flash Bank A Block17-1 (8KB), FblFbMemoryDeviceRef=Flash, FblFbLogicalBlockRef=DemoAppl
        FblFlashBlock_22: FblFbStartAddress=376832, FblFbEndAddress=385023, FblFbDescription=Flash Bank A Block17-2 (8KB), FblFbMemoryDeviceRef=Flash, FblFbLogicalBlockRef=DemoAppl
        FblFlashBlock_23: FblFbStartAddress=385024, FblFbEndAddress=393215, FblFbDescription=Flash Bank A Block17-3 (8KB), FblFbMemoryDeviceRef=Flash, FblFbLogicalBlockRef=DemoAppl
        FblFlashBlock_24: FblFbStartAddress=393216, FblFbEndAddress=401407, FblFbDescription=Flash Bank A Block18-0 (8KB), FblFbMemoryDeviceRef=Flash, FblFbLogicalBlockRef=DemoAppl
        FblFlashBlock_25: FblFbStartAddress=401408, FblFbEndAddress=409599, FblFbDescription=Flash Bank A Block18-1 (8KB), FblFbMemoryDeviceRef=Flash, FblFbLogicalBlockRef=DemoAppl
        FblFlashBlock_26: FblFbStartAddress=409600, FblFbEndAddress=417791, FblFbDescription=Flash Bank A Block18-2 (8KB), FblFbMemoryDeviceRef=Flash, FblFbLogicalBlockRef=DemoAppl
        FblFlashBlock_27: FblFbStartAddress=417792, FblFbEndAddress=425983, FblFbDescription=Flash Bank A Block18-3 (8KB), FblFbMemoryDeviceRef=Flash, FblFbLogicalBlockRef=DemoAppl
        FblFlashBlock_28: FblFbStartAddress=425984, FblFbEndAddress=434175, FblFbDescription=Flash Bank A Block19-0 (8KB), FblFbMemoryDeviceRef=Flash, FblFbLogicalBlockRef=DemoAppl
        FblFlashBlock_29: FblFbStartAddress=434176, FblFbEndAddress=442367, FblFbDescription=Flash Bank A Block19-1 (8KB), FblFbMemoryDeviceRef=Flash, FblFbLogicalBlockRef=DemoAppl
        FblFlashBlock_30: FblFbStartAddress=442368, FblFbEndAddress=450559, FblFbDescription=Flash Bank A Block19-2 (8KB), FblFbMemoryDeviceRef=Flash, FblFbLogicalBlockRef=DemoAppl
        FblFlashBlock_31: FblFbStartAddress=450560, FblFbEndAddress=458751, FblFbDescription=Flash Bank A Block19-3 (8KB), FblFbLogicalBlockRef=DemoAppl, FblFbMemoryDeviceRef=Flash
        FblFlashBlock_32: FblFbStartAddress=458752, FblFbEndAddress=466943, FblFbDescription=Flash Bank A Block18-0 (8KB), FblFbMemoryDeviceRef=Flash, FblFbLogicalBlockRef=DemoAppl
        FblFlashBlock_33: FblFbStartAddress=466944, FblFbEndAddress=475135, FblFbDescription=Flash Bank A Block18-1 (8KB), FblFbMemoryDeviceRef=Flash, FblFbLogicalBlockRef=DemoAppl
        FblFlashBlock_34: FblFbStartAddress=475136, FblFbEndAddress=483327, FblFbDescription=Flash Bank A Block18-2 (8KB), FblFbMemoryDeviceRef=Flash, FblFbLogicalBlockRef=DemoAppl
        FblFlashBlock_35: FblFbStartAddress=483328, FblFbEndAddress=491519, FblFbDescription=Flash Bank A Block18-3 (8KB), FblFbMemoryDeviceRef=Flash, FblFbLogicalBlockRef=DemoAppl
        FblFlashBlock_36: FblFbStartAddress=491520, FblFbEndAddress=499711, FblFbDescription=Flash Bank A Block19-0 (8KB), FblFbMemoryDeviceRef=Flash, FblFbLogicalBlockRef=DemoAppl
        FblFlashBlock_37: FblFbStartAddress=499712, FblFbEndAddress=507903, FblFbDescription=Flash Bank A Block19-1 (8KB), FblFbMemoryDeviceRef=Flash, FblFbLogicalBlockRef=DemoAppl
        FblFlashBlock_38: FblFbStartAddress=507904, FblFbEndAddress=516095, FblFbDescription=Flash Bank A Block19-2 (8KB), FblFbMemoryDeviceRef=Flash, FblFbLogicalBlockRef=DemoAppl
        FblFlashBlock_39: FblFbStartAddress=516096, FblFbEndAddress=524287, FblFbDescription=Flash Bank A Block19-3 (8KB), FblFbLogicalBlockRef=DemoAppl, FblFbMemoryDeviceRef=Flash
        FblFlashBlock_40: FblFbStartAddress=524288, FblFbEndAddress=532479, FblFbDescription=Flash Bank A Block20-0 (8KB), FblFbMemoryDeviceRef=Flash, FblFbLogicalBlockRef=DemoAppl
        FblFlashBlock_41: FblFbStartAddress=532480, FblFbEndAddress=540671, FblFbDescription=Flash Bank A Block20-1 (8KB), FblFbMemoryDeviceRef=Flash, FblFbLogicalBlockRef=DemoAppl
        FblFlashBlock_42: FblFbStartAddress=540672, FblFbEndAddress=548863, FblFbDescription=Flash Bank A Block20-2 (8KB), FblFbMemoryDeviceRef=Flash, FblFbLogicalBlockRef=DemoAppl
        FblFlashBlock_43: FblFbStartAddress=548864, FblFbEndAddress=557055, FblFbDescription=Flash Bank A Block20-3 (8KB), FblFbMemoryDeviceRef=Flash, FblFbLogicalBlockRef=DemoAppl
        FblFlashBlock_44: FblFbStartAddress=557056, FblFbEndAddress=565247, FblFbDescription=Flash Bank A Block21-0 (8KB), FblFbMemoryDeviceRef=Flash, FblFbLogicalBlockRef=DemoAppl
        FblFlashBlock_45: FblFbStartAddress=565248, FblFbEndAddress=573439, FblFbDescription=Flash Bank A Block21-1 (8KB), FblFbMemoryDeviceRef=Flash, FblFbLogicalBlockRef=DemoAppl
        FblFlashBlock_46: FblFbStartAddress=573440, FblFbEndAddress=581631, FblFbDescription=Flash Bank A Block21-2 (8KB), FblFbMemoryDeviceRef=Flash, FblFbLogicalBlockRef=DemoAppl
        FblFlashBlock_47: FblFbStartAddress=581632, FblFbEndAddress=589823, FblFbDescription=Flash Bank A Block21-3 (8KB), FblFbLogicalBlockRef=DemoAppl, FblFbMemoryDeviceRef=Flash
        FblFlashBlock_48: FblFbStartAddress=589824, FblFbEndAddress=598015, FblFbDescription=Flash Bank A Block22-0 (8KB), FblFbMemoryDeviceRef=Flash, FblFbLogicalBlockRef=DemoAppl
        FblFlashBlock_49: FblFbStartAddress=598016, FblFbEndAddress=606207, FblFbDescription=Flash Bank A Block22-1 (8KB), FblFbMemoryDeviceRef=Flash, FblFbLogicalBlockRef=DemoAppl
        FblFlashBlock_50: FblFbStartAddress=606208, FblFbEndAddress=614399, FblFbDescription=Flash Bank A Block22-2 (8KB), FblFbMemoryDeviceRef=Flash, FblFbLogicalBlockRef=DemoAppl
        FblFlashBlock_51: FblFbStartAddress=614400, FblFbEndAddress=622591, FblFbDescription=Flash Bank A Block22-3 (8KB), FblFbMemoryDeviceRef=Flash, FblFbLogicalBlockRef=DemoAppl
        FblFlashBlock_52: FblFbStartAddress=622592, FblFbEndAddress=630783, FblFbDescription=Flash Bank A Block23-0 (8KB), FblFbMemoryDeviceRef=Flash, FblFbLogicalBlockRef=DemoAppl
        FblFlashBlock_53: FblFbStartAddress=630784, FblFbEndAddress=638975, FblFbDescription=Flash Bank A Block23-1 (8KB), FblFbMemoryDeviceRef=Flash, FblFbLogicalBlockRef=DemoAppl
        FblFlashBlock_54: FblFbStartAddress=638976, FblFbEndAddress=647167, FblFbDescription=Flash Bank A Block23-2 (8KB), FblFbMemoryDeviceRef=Flash, FblFbLogicalBlockRef=DemoAppl
        FblFlashBlock_55: FblFbStartAddress=647168, FblFbEndAddress=655359, FblFbDescription=Flash Bank A Block23-3 (8KB), FblFbLogicalBlockRef=DemoAppl, FblFbMemoryDeviceRef=Flash
    FblMemoryDeviceTable
      Flash (FblMemoryDevice):
        FblMdErasedValue = 255
        FblMdSegmentSize = 256
        FblMdIndex = 0
        FblMdInitHook = false
        FblMdDeinitHook = false
        FblMdReadHook = false
        FblMdEraseHook = false
        FblMdWriteHook = false
        FblMdVerifyHook = false
    FblLogicalBlockTable
      DemoAppl (FblLogicalBlock):
        FblLbBlockNr = 0
        FblLbBlockIndex = 0
        FblLbDisposability = MANDATORY
        FblLbStartAddress = 327680
        FblLbEndAddress = 655359
        FblLbMaxReprogAttempts = 0
        FblLbInputVerification = SecM_VerifySignature
        FblLbProcessedVerification = SecM_VerifySignature
        FblLbPipelinedVerification = SecM_VerifySignature
        FblLbOutputVerification = SecM_Verification
        FblLbDescription = 
        FblLbBmHeaderAddress = 651232
