AUTOSAR XML (schema 00049)
package /ActiveEcuC
  module config CanTp: implementation-config-variant=VARIANT-PRE-COMPILE, module-description=CanTp_Impl
    CanTpGeneral:
      CanTpVersionInfoApi = false
      CanTpSupportExtendedAddressing = false
      CanTpSupportMixed11Addressing = false
      CanTpSupportStandardAddressing = true
      CanTpChangeParameterApi = false
      CanTpDevErrorDetect = true
      CanTpPaddingByte = 204
      CanTpReadParameterApi = false
      CanTpPaddingActive = true
      CanTpHavePaddingByte = false
      CanTpEnableSplitMainFunction = false
      CanTpSupportMixed29Addressing = true
      CanTpSupportNormalFixedAddressing = true
      CanTpSupportCustomAddressing = false
      CanTpOnlyNotifyInformedAppl = true
      CanTpRc = false
      CanTpTc = false
      CanTpSafeBswChecks = true
      CanTpRuntimeErrorReport = false
      CanTpEnableSynchronousTransmit = true
      CanTpSupportLongFirstFrames = true
      CanTpFlexibleDataRateSupport = true
    CanTpConfig: CanTpMainFunctionPeriod=0.005
      5 x CanTpChannel, all with CanTpChannelMode=CANTP_MODE_FULL_DUPLEX:
        CanTpChannel
        TPCH_1059bc7c
          CanTpTxNSdu_0468c0cb (CanTpTxNSdu):
            CanTpTxAddressingFormat = CANTP_STANDARD
            CanTpTxDl = 8
            CanTpTxTaType = CANTP_PHYSICAL
            CanTpNas = 0.1
            CanTpNcs = 0.2
            CanTpTc = false
            CanTpTxNSduId = 0
            CanTpTxPaddingActivation = CANTP_ON
            CanTpNbs = 0.5
            CanTpTxNSduRef = Demo_0_CAN_FD_Response_oDemoFBL_Vector_SLP3_20_50875972_Tx
            CanTpTxNPdu_fd979da3 (CanTpTxNPdu): CanTpTxNPduConfirmationPduId=0, CanTpTxNPduRef=Demo_0_CAN_FD_Response_Tp_oDemoFBL_Vector_SLP3_20_ee1db9f7_Tx
            CanTpRxFcNPdu_fd979da3 (CanTpRxFcNPdu): CanTpRxFcNPduId=1, CanTpRxFcNPduRef=Demo_0_CAN_FD_Request_Tp_oDemoFBL_Vector_SLP3_20_f2ebe614_Rx
          CanTpRxNSdu_0468c0cb (CanTpRxNSdu):
            CanTpRxAddressingFormat = CANTP_STANDARD
            CanTpRxDl = 8
            CanTpRxTaType = CANTP_PHYSICAL
            CanTpNbr = 0.1
            CanTpRxNSduId = 1
            CanTpRxPaddingActivation = CANTP_ON
            CanTpBs = 0
            CanTpNar = 0.1
            CanTpNcr = 0.5
            CanTpRxWftMax = 15
            CanTpSTmin = 0
            CanTpRxNSduRef = Demo_0_CAN_FD_Request_oDemoFBL_Vector_SLP3_20_dc7615a6_Rx
            CanTpTxFcNPdu_df6d4951 (CanTpTxFcNPdu): CanTpTxFcNPduConfirmationPduId=0, CanTpTxFcNPduRef=Demo_0_CAN_FD_Response_Tp_oDemoFBL_Vector_SLP3_20_ee1db9f7_Tx
            CanTpRxNPdu_df6d4951 (CanTpRxNPdu): CanTpRxNPduId=1, CanTpRxNPduRef=Demo_0_CAN_FD_Request_Tp_oDemoFBL_Vector_SLP3_20_f2ebe614_Rx
        TPCH_35dcba18
          CanTpRxNSdu_08631fbd (CanTpRxNSdu):
            CanTpRxAddressingFormat = CANTP_STANDARD
            CanTpRxDl = 8
            CanTpRxTaType = CANTP_FUNCTIONAL
            CanTpNbr = 0.1
            CanTpRxNSduId = 0
            CanTpRxPaddingActivation = CANTP_ON
            CanTpRxNSduRef = Functional_CAN_FD_oDemoFBL_Vector_SLP3_20_7403a32a_Rx
            CanTpRxNPdu_3cfeb570 (CanTpRxNPdu): CanTpRxNPduId=2, CanTpRxNPduRef=Functional_CAN_FD_Tp_oDemoFBL_Vector_SLP3_20_883488d5_Rx
        TPCH_b06d3498
          CanTpRxNSdu_e1aeb83a (CanTpRxNSdu):
            CanTpRxAddressingFormat = CANTP_STANDARD
            CanTpRxDl = 64
            CanTpRxTaType = CANTP_CANFD_FUNCTIONAL
            CanTpNbr = 0.1
            CanTpRxNSduId = 2
            CanTpRxPaddingActivation = CANTP_ON
            CanTpRxNSduRef = Functional_CAN_FD_oDemoFBL_Vector_SLP3_ed563a98_Rx
            CanTpRxNPdu_e4a40b7d (CanTpRxNPdu): CanTpRxNPduId=3, CanTpRxNPduRef=Functional_CAN_FD_Tp_oDemoFBL_Vector_SLP3_36e4c388_Rx
        TPCH_e51207dc
          CanTpTxNSdu_f05a2e85 (CanTpTxNSdu):
            CanTpTxAddressingFormat = CANTP_STANDARD
            CanTpTxDl = 64
            CanTpTxTaType = CANTP_CANFD_PHYSICAL
            CanTpNas = 0.1
            CanTpNcs = 0.2
            CanTpTc = false
            CanTpTxNSduId = 1
            CanTpTxPaddingActivation = CANTP_ON
            CanTpNbs = 0.5
            CanTpTxNSduRef = Demo_0_CAN_FD_Response_oDemoFBL_Vector_SLP3_8fbef359_Tx
            CanTpTxNPdu_cb7a0c86 (CanTpTxNPdu): CanTpTxNPduConfirmationPduId=1, CanTpTxNPduRef=Demo_0_CAN_FD_Response_Tp_oDemoFBL_Vector_SLP3_126039d0_Tx
            CanTpRxFcNPdu_cb7a0c86 (CanTpRxFcNPdu): CanTpRxFcNPduId=0, CanTpRxFcNPduRef=Demo_0_CAN_FD_Request_Tp_oDemoFBL_Vector_SLP3_9e917504_Rx
          CanTpRxNSdu_f05a2e85 (CanTpRxNSdu):
            CanTpRxAddressingFormat = CANTP_STANDARD
            CanTpRxDl = 64
            CanTpRxTaType = CANTP_CANFD_PHYSICAL
            CanTpNbr = 0.1
            CanTpRxNSduId = 3
            CanTpRxPaddingActivation = CANTP_ON
            CanTpBs = 0
            CanTpNar = 0.1
            CanTpNcr = 0.5
            CanTpRxWftMax = 15
            CanTpSTmin = 0
            CanTpRxNSduRef = Demo_0_CAN_FD_Request_oDemoFBL_Vector_SLP3_6635a675_Rx
            CanTpTxFcNPdu_e980d874 (CanTpTxFcNPdu): CanTpTxFcNPduConfirmationPduId=1, CanTpTxFcNPduRef=Demo_0_CAN_FD_Response_Tp_oDemoFBL_Vector_SLP3_126039d0_Tx
            CanTpRxNPdu_e980d874 (CanTpRxNPdu): CanTpRxNPduId=0, CanTpRxNPduRef=Demo_0_CAN_FD_Request_Tp_oDemoFBL_Vector_SLP3_9e917504_Rx
