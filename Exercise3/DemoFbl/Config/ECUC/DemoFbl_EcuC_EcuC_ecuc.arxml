AUTOSAR XML (schema 00049)
package /ActiveEcuC
  module config EcuC: implementation-config-variant=VARIANT-PRE-COMPILE, module-description=EcuC_Impl
    EcucGeneral:
      CPUType = CPU32Bit
      SizeOfInt = Size32Bit
      ByteOrder = LITTLE_ENDIAN
      BitOrder = LSB_to_MSB
      AtomicBitAccessInBitfield = false
      AtomicVariableAccess = Atomic8BitAccess
      SizeOfEnum = Size32Bit
      SizeOfROMPointer = Size32Bit
      SizeOfRAMPointer = Size32Bit
      BitFieldDataType = INT
      StructAlignment = Auto
      ArrayAlignment = Auto
      StructInArrayAlignment = Auto
      DummyFunction = false
      DummyStatement = true
      DummyStatementKind = SelfAssignment
      ConditionalGenerating = true
      EcucBswImplementationCodeType = EcuCSourceCode
      EcuCUseStdReturnTypeForRte = false
      BswInitialization
        28 x InitFunction:
          CanIf_Init: Header=CanIf.h, InitPhase=INIT_TWO_IF, ConfigType=CanIf_ConfigType, ConfigPtrClass=CANIF_INIT_DATA, ConfigPtrName=CanIf_Config_Ptr, ModuleRef=CanIf  # /ActiveEcuC/CanIf PLAIN_TEXT Init function description of CanIf in UnfilteredViewInInvariantProject (UnfilteredInvariantProjectModelView) .
          CanIf_InitMemory: Header=CanIf.h, InitPhase=INIT_MEMORY, ModuleRef=CanIf  # /ActiveEcuC/CanIf PLAIN_TEXT InitMemory function description of CanIf in UnfilteredViewInInvariantProject (UnfilteredInvariantProjectModelView) .
          CanTp_Init: Header=CanTp.h, InitPhase=INIT_TWO_TP, ConfigType=CanTp_PBConfigType, ConfigPtrClass=CANTP_INIT_DATA, ConfigPtrName=CanTp_Config_Ptr, ModuleRef=CanTp  # /ActiveEcuC/CanTp PLAIN_TEXT Init function description of CanTp in UnfilteredViewInInvariantProject (UnfilteredInvariantProjectModelView) .
          CanTp_PreInit: Header=CanTp.h, InitPhase=INIT_ONE, ConfigType=CanTp_PBConfigType, ConfigPtrClass=CANTP_INIT_DATA, ConfigPtrName=CanTp_Config_Ptr, ModuleRef=CanTp  # /ActiveEcuC/CanTp PLAIN_TEXT PreInit function description of CanTp in UnfilteredViewInInvariantProject (UnfilteredInvariantProjectModelView) .
          CanTp_InitMemory: Header=CanTp.h, InitPhase=INIT_MEMORY, ModuleRef=CanTp  # /ActiveEcuC/CanTp PLAIN_TEXT InitMemory function description of CanTp in UnfilteredViewInInvariantProject (UnfilteredInvariantProjectModelView) .
          Can_Init: Header=Can.h, InitPhase=INIT_TWO_DRV, ConfigType=Can_ConfigType, ConfigPtrClass=CAN_INIT_DATA, ConfigPtrName=Can_Config_Ptr, ModuleRef=Can  # /ActiveEcuC/Can PLAIN_TEXT Init function description of Can in UnfilteredViewInInvariantProject (UnfilteredInvariantProjectModelView) .
          Can_InitMemory: Header=Can.h, InitPhase=INIT_MEMORY, ModuleRef=Can  # /ActiveEcuC/Can PLAIN_TEXT InitMemory function description of Can in UnfilteredViewInInvariantProject (UnfilteredInvariantProjectModelView) .
          CryIf_InitMemory: Header=CryIf.h, InitPhase=INIT_MEMORY, ModuleRef=CryIf  # /ActiveEcuC/CryIf PLAIN_TEXT Initializes variables of the Crypto Interface
          CryIf_Init: Header=CryIf.h, InitPhase=INIT_TWO_IF, ModuleRef=CryIf  # /ActiveEcuC/CryIf PLAIN_TEXT Initializes the Crypto Interface
          Crypto_30_LibCv_InitMemory: Header=Crypto_30_LibCv.h, InitPhase=INIT_MEMORY, ModuleRef=Crypto  # /ActiveEcuC/Crypto PLAIN_TEXT Initializes variables of the Crypto Driver
          Crypto_30_LibCv_Init: Header=Crypto_30_LibCv.h, InitPhase=INIT_TWO_DRV, ModuleRef=Crypto  # /ActiveEcuC/Crypto PLAIN_TEXT Initializes the Crypto Driver
          Csm_InitMemory: Header=Csm.h, InitPhase=INIT_MEMORY, ModuleRef=Csm  # /ActiveEcuC/Csm PLAIN_TEXT Initializes variables of the Crypto Service Manager
          Csm_Init: Header=Csm.h, InitPhase=INIT_TWO_SYS, ModuleRef=Csm  # /ActiveEcuC/Csm PLAIN_TEXT Initializes the Crypto Service Manager
          FblCw_Init: Header=fbl_inc.h, InitPhase=INIT_THREE, ConfigType=FblCw_ConfigType, ConfigPtrClass=FBLCW_INIT_DATA, ConfigPtrName=FblCw_Config_Ptr, ModuleRef=Dcm  # /ActiveEcuC/Dcm PLAIN_TEXT Init function description of FblCw in UnfilteredViewInInvariantProject (UnfilteredInvariantProjectModelView) .
          FblCw_InitMemory: Header=fbl_inc.h, InitPhase=INIT_MEMORY, ModuleRef=Dcm  # /ActiveEcuC/Dcm PLAIN_TEXT InitMemory function description of FblCw in UnfilteredViewInInvariantProject (UnfilteredInvariantProjectModelView) .
          Det_Init: Header=Det.h, InitPhase=INIT_ZERO, ConfigType=Det_ConfigType, ConfigPtrClass=DET_INIT_DATA, ConfigPtrName=Det_Config_Ptr, ModuleRef=Det  # /ActiveEcuC/Det PLAIN_TEXT Init function description of Det in UnfilteredViewInInvariantProject (UnfilteredInvariantProjectModelView) .
          Det_Start: Header=Det.h, InitPhase=INIT_ONE, ModuleRef=Det  # /ActiveEcuC/Det PLAIN_TEXT PostInit function description of Det in UnfilteredViewInInvariantProject (UnfilteredInvariantProjectModelView) .
          Det_InitMemory: Header=Det.h, InitPhase=INIT_MEMORY, ModuleRef=Det  # /ActiveEcuC/Det PLAIN_TEXT InitMemory function description of Det in UnfilteredViewInInvariantProject (UnfilteredInvariantProjectModelView) .
          PduR_Init: Header=PduR.h, InitPhase=INIT_TWO_COM, ConfigType=PduR_PBConfigType, ConfigPtrClass=PDUR_INIT_DATA, ConfigPtrName=PduR_Config_Ptr, ModuleRef=PduR  # /ActiveEcuC/PduR PLAIN_TEXT Init function description of PduR in UnfilteredViewInInvariantProject (UnfilteredInvariantProjectModelView) .
          PduR_PreInit: Header=PduR.h, InitPhase=INIT_ONE, ConfigType=PduR_PBConfigType, ConfigPtrClass=PDUR_INIT_DATA, ConfigPtrName=PduR_Config_Ptr, ModuleRef=PduR  # /ActiveEcuC/PduR PLAIN_TEXT PreInit function description of PduR in UnfilteredViewInInvariantProject (UnfilteredInvariantProjectModelView) .
          PduR_InitMemory: Header=PduR.h, InitPhase=INIT_MEMORY, ModuleRef=PduR  # /ActiveEcuC/PduR PLAIN_TEXT InitMemory function description of PduR in UnfilteredViewInInvariantProject (UnfilteredInvariantProjectModelView) .
          SecM_Init: Header=Sec.h, InitPhase=INIT_TWO_SYS, ModuleRef=Smh  # /ActiveEcuC/Smh PLAIN_TEXT SecM_Init function description
          WrapNv_Init: Header=WrapNv.h, InitPhase=INIT_TWO_POST_NVMREADALL, ModuleRef=WrapNv  # /ActiveEcuC/WrapNv PLAIN_TEXT WrapNv_Init function description
          Brs_Init: Header=, InitPhase=NO_INIT, ModuleRef=vBRS  # /ActiveEcuC/vBRS PLAIN_TEXT Automatically generated by BswInitFctConfigurationService.
          vBaseEnv_Init: Header=, InitPhase=NO_INIT, ModuleRef=vBaseEnv  # /ActiveEcuC/vBaseEnv PLAIN_TEXT Created vBaseEnv_Init by Extended Init XML Service
          vLinkGen_Init: Header=vLinkGen_Lcfg.h, InitPhase=NO_INIT, ModuleRef=vLinkGen  # /ActiveEcuC/vLinkGen PLAIN_TEXT Dummy initialization of the vLinkGen
          Mcu_Init: Header=Mcu.h, InitPhase=INIT_ONE_EARLY, ConfigType=Mcu_ConfigType, ConfigPtrClass=MCU_APPL_CONST, ConfigPtrName=McuModuleConfiguration, AdditionalInitCode=Mcu_InitClock(McuConf_McuClockSettingConfig_McuClockSettingConfig);while (MCU_PLL_LOCKED != Mcu_GetPllStatus());Mcu_DistributePllClock();, ModuleRef=Mcu  # /ActiveEcuC/Mcu PLAIN_TEXT Created Mcu_Init by Extended Init XML Service
          Port_Init: Header=Port.h, InitPhase=INIT_ONE_EARLY, ConfigType=Port_ConfigType, ConfigPtrClass=PORT_APPL_CONST, ConfigPtrName=PortConfigSet, ModuleRef=Port  # /ActiveEcuC/Port PLAIN_TEXT Created Port_Init by Extended Init XML Service
    EcucPduCollection: PduIdTypeEnum=UINT8, PduLengthTypeEnum=UINT16
      18 x Pdu, all with J1939Requestable=false:
        Demo_0_CAN_FD_Request_oDemoFBL_Vector_SLP3_6635a675_Rx: DynamicLength=true, PduLength=64
        Functional_CAN_FD_oDemoFBL_Vector_SLP3_20_7403a32a_Rx: DynamicLength=true, PduLength=7
        Demo_0_CAN_FD_Request_oDemoFBL_Vector_SLP3_67f6c3c9_Rx: DynamicLength=true, PduLength=64
        Demo_0_CAN_FD_Response_oDemoFBL_Vector_SLP3_8fbef359_Tx: DynamicLength=true, PduLength=64
        Demo_0_CAN_FD_Request_Tp_oDemoFBL_Vector_SLP3_20_f2ebe614_Rx: DynamicLength=false, PduLength=8, SysTPduToFrameMappingRef=Demo_0_CAN_FD_Request_Tp
        Functional_CAN_FD_oDemoFBL_Vector_SLP3_20_57859879_Rx: DynamicLength=true, PduLength=7
        Demo_0_CAN_FD_Request_Tp_oDemoFBL_Vector_SLP3_9e917504_Rx: DynamicLength=false, PduLength=64, SysTPduToFrameMappingRef=Demo_0_CAN_FD_Request_Tp
        Demo_0_CAN_FD_Response_Tp_oDemoFBL_Vector_SLP3_126039d0_Tx: DynamicLength=false, PduLength=64, SysTPduToFrameMappingRef=Demo_0_CAN_FD_Response_Tp
        Demo_0_CAN_FD_Request_oDemoFBL_Vector_SLP3_20_dc7615a6_Rx: DynamicLength=true, PduLength=8
        Functional_CAN_FD_oDemoFBL_Vector_SLP3_ed563a98_Rx: DynamicLength=true, PduLength=62
        Demo_0_CAN_FD_Response_oDemoFBL_Vector_SLP3_20_50875972_Tx: DynamicLength=true, PduLength=8
        Functional_CAN_FD_Tp_oDemoFBL_Vector_SLP3_36e4c388_Rx: DynamicLength=false, PduLength=64, SysTPduToFrameMappingRef=Functional_CAN_FD_Tp
        Demo_0_CAN_FD_Response_oDemoFBL_Vector_SLP3_01a35bfe_Tx: DynamicLength=true, PduLength=64
        Functional_CAN_FD_oDemoFBL_Vector_SLP3_3cffe9e9_Rx: DynamicLength=true, PduLength=62
        Demo_0_CAN_FD_Response_Tp_oDemoFBL_Vector_SLP3_20_ee1db9f7_Tx: DynamicLength=false, PduLength=8, SysTPduToFrameMappingRef=Demo_0_CAN_FD_Response_Tp
        Functional_CAN_FD_Tp_oDemoFBL_Vector_SLP3_20_883488d5_Rx: DynamicLength=false, PduLength=8, SysTPduToFrameMappingRef=Functional_CAN_FD_Tp
        Demo_0_CAN_FD_Request_oDemoFBL_Vector_SLP3_20_797faa4e_Rx: DynamicLength=true, PduLength=8
        Demo_0_CAN_FD_Response_oDemoFBL_Vector_SLP3_20_fac2fc54_Tx: DynamicLength=true, PduLength=8
    EcucPartitionCollection
      EcucPartition: PartitionCanBeRestarted=false, EcucPartitionBswModuleExecution=false, ASIL=QM
