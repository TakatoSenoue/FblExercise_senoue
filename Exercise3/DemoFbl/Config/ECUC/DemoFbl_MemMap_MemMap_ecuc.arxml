AUTOSAR XML (schema 00049)
package /ActiveEcuC
  module config MemMap: implementation-config-variant=VARIANT-PRE-COMPILE, module-description=MemMap_Impl
    MemMap_Common (MemMapModule): MemMapGenerateAdditionalMemorySections=true
      124 x MemMapAdditionalMemorySection, all with MemMapMemorySectionFileName=MemMap_Common.h, MemMapMemorySectionPrefix=:
        CODE: MemMapMemorySectionSymbol=CODE, MemMapMemorySectionSwAddrMethodRef=CODE
        CODE_FAST: MemMapMemorySectionSymbol=CODE_FAST, MemMapMemorySectionSwAddrMethodRef=CODE_FAST
        CODE_ISR: MemMapMemorySectionSymbol=CODE_ISR, MemMapMemorySectionSwAddrMethodRef=CODE_ISR
        CONST: MemMapMemorySectionAlignment=UNSPECIFIED, MemMapMemorySectionSymbol=CONST, MemMapMemorySectionSwAddrMethodRef=CONST
        CONST_8BIT: MemMapMemorySectionAlignment=8, MemMapMemorySectionSymbol=CONST_8BIT, MemMapMemorySectionSwAddrMethodRef=CONST
        CONST_16BIT: MemMapMemorySectionAlignment=16, MemMapMemorySectionSymbol=CONST_16BIT, MemMapMemorySectionSwAddrMethodRef=CONST
        CONST_32BIT: MemMapMemorySectionAlignment=32, MemMapMemorySectionSymbol=CONST_32BIT, MemMapMemorySectionSwAddrMethodRef=CONST
        CONST_64BIT: MemMapMemorySectionAlignment=64, MemMapMemorySectionSymbol=CONST_64BIT, MemMapMemorySectionSwAddrMethodRef=CONST
        CONST_8: MemMapMemorySectionAlignment=8, MemMapMemorySectionSymbol=CONST_8, MemMapMemorySectionSwAddrMethodRef=CONST
        CONST_16: MemMapMemorySectionAlignment=16, MemMapMemorySectionSymbol=CONST_16, MemMapMemorySectionSwAddrMethodRef=CONST
        CONST_32: MemMapMemorySectionAlignment=32, MemMapMemorySectionSymbol=CONST_32, MemMapMemorySectionSwAddrMethodRef=CONST
        CONST_64: MemMapMemorySectionAlignment=64, MemMapMemorySectionSymbol=CONST_64, MemMapMemorySectionSwAddrMethodRef=CONST
        CONST_PTR: MemMapMemorySectionAlignment=PTR, MemMapMemorySectionSymbol=CONST_PTR, MemMapMemorySectionSwAddrMethodRef=CONST
        CONST_UNSPECIFIED: MemMapMemorySectionAlignment=UNSPECIFIED, MemMapMemorySectionSymbol=CONST_UNSPECIFIED, MemMapMemorySectionSwAddrMethodRef=CONST
        CONST_FAST_8BIT: MemMapMemorySectionAlignment=8, MemMapMemorySectionSymbol=CONST_FAST_8BIT, MemMapMemorySectionSwAddrMethodRef=CONST_FAST
        CONST_FAST_16BIT: MemMapMemorySectionAlignment=16, MemMapMemorySectionSymbol=CONST_FAST_16BIT, MemMapMemorySectionSwAddrMethodRef=CONST_FAST
        CONST_FAST_32BIT: MemMapMemorySectionAlignment=32, MemMapMemorySectionSymbol=CONST_FAST_32BIT, MemMapMemorySectionSwAddrMethodRef=CONST_FAST
        CONST_FAST_64BIT: MemMapMemorySectionAlignment=64, MemMapMemorySectionSymbol=CONST_FAST_64BIT, MemMapMemorySectionSwAddrMethodRef=CONST_FAST
        CONST_FAST_8: MemMapMemorySectionAlignment=8, MemMapMemorySectionSymbol=CONST_FAST_8, MemMapMemorySectionSwAddrMethodRef=CONST_FAST
        CONST_FAST_16: MemMapMemorySectionAlignment=16, MemMapMemorySectionSymbol=CONST_FAST_16, MemMapMemorySectionSwAddrMethodRef=CONST_FAST
        CONST_FAST_32: MemMapMemorySectionAlignment=32, MemMapMemorySectionSymbol=CONST_FAST_32, MemMapMemorySectionSwAddrMethodRef=CONST_FAST
        CONST_FAST_64: MemMapMemorySectionAlignment=64, MemMapMemorySectionSymbol=CONST_FAST_64, MemMapMemorySectionSwAddrMethodRef=CONST_FAST
        CONST_FAST_PTR: MemMapMemorySectionAlignment=PTR, MemMapMemorySectionSymbol=CONST_FAST_PTR, MemMapMemorySectionSwAddrMethodRef=CONST_FAST
        CONST_FAST_UNSPECIFIED: MemMapMemorySectionAlignment=UNSPECIFIED, MemMapMemorySectionSymbol=CONST_FAST_UNSPECIFIED, MemMapMemorySectionSwAddrMethodRef=CONST_FAST
        CONST_PBCFG: MemMapMemorySectionSymbol=CONST_PBCFG, MemMapMemorySectionSwAddrMethodRef=CONST_PBCFG
        PBCFG_GLOBALROOT: MemMapMemorySectionSymbol=PBCFG_GLOBALROOT, MemMapMemorySectionSwAddrMethodRef=PBCFG_GLOBALROOT
        VAR: MemMapMemorySectionAlignment=UNSPECIFIED, MemMapMemorySectionSymbol=VAR, MemMapMemorySectionSwAddrMethodRef=VAR_INIT
        VAR_INIT_8BIT: MemMapMemorySectionAlignment=8, MemMapMemorySectionSymbol=VAR_INIT_8BIT, MemMapMemorySectionSwAddrMethodRef=VAR_INIT
        VAR_INIT_16BIT: MemMapMemorySectionAlignment=16, MemMapMemorySectionSymbol=VAR_INIT_16BIT, MemMapMemorySectionSwAddrMethodRef=VAR_INIT
        VAR_INIT_32BIT: MemMapMemorySectionAlignment=32, MemMapMemorySectionSymbol=VAR_INIT_32BIT, MemMapMemorySectionSwAddrMethodRef=VAR_INIT
        VAR_INIT_64BIT: MemMapMemorySectionAlignment=64, MemMapMemorySectionSymbol=VAR_INIT_64BIT, MemMapMemorySectionSwAddrMethodRef=VAR_INIT
        VAR_INIT_8: MemMapMemorySectionAlignment=8, MemMapMemorySectionSymbol=VAR_INIT_8, MemMapMemorySectionSwAddrMethodRef=VAR_INIT
        VAR_INIT_16: MemMapMemorySectionAlignment=16, MemMapMemorySectionSymbol=VAR_INIT_16, MemMapMemorySectionSwAddrMethodRef=VAR_INIT
        VAR_INIT_32: MemMapMemorySectionAlignment=32, MemMapMemorySectionSymbol=VAR_INIT_32, MemMapMemorySectionSwAddrMethodRef=VAR_INIT
        VAR_INIT_64: MemMapMemorySectionAlignment=64, MemMapMemorySectionSymbol=VAR_INIT_64, MemMapMemorySectionSwAddrMethodRef=VAR_INIT
        VAR_INIT_PTR: MemMapMemorySectionAlignment=PTR, MemMapMemorySectionSymbol=VAR_INIT_PTR, MemMapMemorySectionSwAddrMethodRef=VAR_INIT
        VAR_INIT_UNSPECIFIED: MemMapMemorySectionAlignment=UNSPECIFIED, MemMapMemorySectionSymbol=VAR_INIT_UNSPECIFIED, MemMapMemorySectionSwAddrMethodRef=VAR_INIT
        VAR_NOINIT_8BIT: MemMapMemorySectionAlignment=8, MemMapMemorySectionSymbol=VAR_NOINIT_8BIT, MemMapMemorySectionSwAddrMethodRef=VAR_NO_INIT
        VAR_NOINIT_16BIT: MemMapMemorySectionAlignment=16, MemMapMemorySectionSymbol=VAR_NOINIT_16BIT, MemMapMemorySectionSwAddrMethodRef=VAR_NO_INIT
        VAR_NOINIT_32BIT: MemMapMemorySectionAlignment=32, MemMapMemorySectionSymbol=VAR_NOINIT_32BIT, MemMapMemorySectionSwAddrMethodRef=VAR_NO_INIT
        VAR_NOINIT_64BIT: MemMapMemorySectionAlignment=64, MemMapMemorySectionSymbol=VAR_NOINIT_64BIT, MemMapMemorySectionSwAddrMethodRef=VAR_NO_INIT
        VAR_NOINIT_UNSPECIFIED: MemMapMemorySectionAlignment=UNSPECIFIED, MemMapMemorySectionSymbol=VAR_NOINIT_UNSPECIFIED, MemMapMemorySectionSwAddrMethodRef=VAR_NO_INIT
        VAR_NO_INIT_8: MemMapMemorySectionAlignment=8, MemMapMemorySectionSymbol=VAR_NO_INIT_8, MemMapMemorySectionSwAddrMethodRef=VAR_NO_INIT
        VAR_NO_INIT_16: MemMapMemorySectionAlignment=16, MemMapMemorySectionSymbol=VAR_NO_INIT_16, MemMapMemorySectionSwAddrMethodRef=VAR_NO_INIT
        VAR_NO_INIT_32: MemMapMemorySectionAlignment=32, MemMapMemorySectionSymbol=VAR_NO_INIT_32, MemMapMemorySectionSwAddrMethodRef=VAR_NO_INIT
        VAR_NO_INIT_64: MemMapMemorySectionAlignment=64, MemMapMemorySectionSymbol=VAR_NO_INIT_64, MemMapMemorySectionSwAddrMethodRef=VAR_NO_INIT
        VAR_NO_INIT_PTR: MemMapMemorySectionAlignment=PTR, MemMapMemorySectionSymbol=VAR_NO_INIT_PTR, MemMapMemorySectionSwAddrMethodRef=VAR_NO_INIT
        VAR_NO_INIT_UNSPECIFIED: MemMapMemorySectionAlignment=UNSPECIFIED, MemMapMemorySectionSymbol=VAR_NO_INIT_UNSPECIFIED, MemMapMemorySectionSwAddrMethodRef=VAR_NO_INIT
        VAR_ZERO_INIT_8BIT: MemMapMemorySectionAlignment=8, MemMapMemorySectionSymbol=VAR_ZERO_INIT_8BIT, MemMapMemorySectionSwAddrMethodRef=VAR_CLEARED
        VAR_ZERO_INIT_16BIT: MemMapMemorySectionAlignment=16, MemMapMemorySectionSymbol=VAR_ZERO_INIT_16BIT, MemMapMemorySectionSwAddrMethodRef=VAR_CLEARED
        VAR_ZERO_INIT_32BIT: MemMapMemorySectionAlignment=32, MemMapMemorySectionSymbol=VAR_ZERO_INIT_32BIT, MemMapMemorySectionSwAddrMethodRef=VAR_CLEARED
        VAR_ZERO_INIT_64BIT: MemMapMemorySectionAlignment=64, MemMapMemorySectionSymbol=VAR_ZERO_INIT_64BIT, MemMapMemorySectionSwAddrMethodRef=VAR_CLEARED
        VAR_CLEARED_8: MemMapMemorySectionAlignment=8, MemMapMemorySectionSymbol=VAR_CLEARED_8, MemMapMemorySectionSwAddrMethodRef=VAR_CLEARED
        VAR_CLEARED_16: MemMapMemorySectionAlignment=16, MemMapMemorySectionSymbol=VAR_CLEARED_16, MemMapMemorySectionSwAddrMethodRef=VAR_CLEARED
        VAR_CLEARED_32: MemMapMemorySectionAlignment=32, MemMapMemorySectionSymbol=VAR_CLEARED_32, MemMapMemorySectionSwAddrMethodRef=VAR_CLEARED
        VAR_CLEARED_64: MemMapMemorySectionAlignment=64, MemMapMemorySectionSymbol=VAR_CLEARED_64, MemMapMemorySectionSwAddrMethodRef=VAR_CLEARED
        VAR_CLEARED_PTR: MemMapMemorySectionAlignment=PTR, MemMapMemorySectionSymbol=VAR_CLEARED_PTR, MemMapMemorySectionSwAddrMethodRef=VAR_CLEARED
        VAR_CLEARED_UNSPECIFIED: MemMapMemorySectionAlignment=UNSPECIFIED, MemMapMemorySectionSymbol=VAR_CLEARED_UNSPECIFIED, MemMapMemorySectionSwAddrMethodRef=VAR_CLEARED
        VAR_ZERO_INIT_UNSPECIFIED: MemMapMemorySectionAlignment=UNSPECIFIED, MemMapMemorySectionSymbol=VAR_ZERO_INIT_UNSPECIFIED, MemMapMemorySectionSwAddrMethodRef=VAR_CLEARED
        VAR_FAST_INIT_8BIT: MemMapMemorySectionAlignment=8, MemMapMemorySectionSymbol=VAR_FAST_INIT_8BIT, MemMapMemorySectionSwAddrMethodRef=VAR_FAST_INIT
        VAR_FAST_INIT_16BIT: MemMapMemorySectionAlignment=16, MemMapMemorySectionSymbol=VAR_FAST_INIT_16BIT, MemMapMemorySectionSwAddrMethodRef=VAR_FAST_INIT
        VAR_FAST_INIT_32BIT: MemMapMemorySectionAlignment=32, MemMapMemorySectionSymbol=VAR_FAST_INIT_32BIT, MemMapMemorySectionSwAddrMethodRef=VAR_FAST_INIT
        VAR_FAST_INIT_64BIT: MemMapMemorySectionAlignment=64, MemMapMemorySectionSymbol=VAR_FAST_INIT_64BIT, MemMapMemorySectionSwAddrMethodRef=VAR_FAST_INIT
        VAR_FAST_INIT_8: MemMapMemorySectionAlignment=8, MemMapMemorySectionSymbol=VAR_FAST_INIT_8, MemMapMemorySectionSwAddrMethodRef=VAR_FAST_INIT
        VAR_FAST_INIT_16: MemMapMemorySectionAlignment=16, MemMapMemorySectionSymbol=VAR_FAST_INIT_16, MemMapMemorySectionSwAddrMethodRef=VAR_FAST_INIT
        VAR_FAST_INIT_32: MemMapMemorySectionAlignment=32, MemMapMemorySectionSymbol=VAR_FAST_INIT_32, MemMapMemorySectionSwAddrMethodRef=VAR_FAST_INIT
        VAR_FAST_INIT_64: MemMapMemorySectionAlignment=64, MemMapMemorySectionSymbol=VAR_FAST_INIT_64, MemMapMemorySectionSwAddrMethodRef=VAR_FAST_INIT
        VAR_FAST_INIT_PTR: MemMapMemorySectionAlignment=PTR, MemMapMemorySectionSymbol=VAR_FAST_INIT_PTR, MemMapMemorySectionSwAddrMethodRef=VAR_FAST_INIT
        VAR_FAST_INIT_UNSPECIFIED: MemMapMemorySectionAlignment=UNSPECIFIED, MemMapMemorySectionSymbol=VAR_FAST_INIT_UNSPECIFIED, MemMapMemorySectionSwAddrMethodRef=VAR_FAST_INIT
        VAR_FAST_NOINIT_8BIT: MemMapMemorySectionAlignment=8, MemMapMemorySectionSymbol=VAR_FAST_NOINIT_8BIT, MemMapMemorySectionSwAddrMethodRef=VAR_FAST_NO_INIT
        VAR_FAST_NOINIT_16BIT: MemMapMemorySectionAlignment=16, MemMapMemorySectionSymbol=VAR_FAST_NOINIT_16BIT, MemMapMemorySectionSwAddrMethodRef=VAR_FAST_NO_INIT
        VAR_FAST_NOINIT_32BIT: MemMapMemorySectionAlignment=32, MemMapMemorySectionSymbol=VAR_FAST_NOINIT_32BIT, MemMapMemorySectionSwAddrMethodRef=VAR_FAST_NO_INIT
        VAR_FAST_NOINIT_64BIT: MemMapMemorySectionAlignment=64, MemMapMemorySectionSymbol=VAR_FAST_NOINIT_64BIT, MemMapMemorySectionSwAddrMethodRef=VAR_FAST_NO_INIT
        VAR_FAST_NOINIT_UNSPECIFIED: MemMapMemorySectionAlignment=UNSPECIFIED, MemMapMemorySectionSymbol=VAR_FAST_NOINIT_UNSPECIFIED, MemMapMemorySectionSwAddrMethodRef=VAR_FAST_NO_INIT
        VAR_FAST_NO_INIT_8: MemMapMemorySectionAlignment=8, MemMapMemorySectionSymbol=VAR_FAST_NO_INIT_8, MemMapMemorySectionSwAddrMethodRef=VAR_FAST_NO_INIT
        VAR_FAST_NO_INIT_16: MemMapMemorySectionAlignment=16, MemMapMemorySectionSymbol=VAR_FAST_NO_INIT_16, MemMapMemorySectionSwAddrMethodRef=VAR_FAST_NO_INIT
        VAR_FAST_NO_INIT_32: MemMapMemorySectionAlignment=32, MemMapMemorySectionSymbol=VAR_FAST_NO_INIT_32, MemMapMemorySectionSwAddrMethodRef=VAR_FAST_NO_INIT
        VAR_FAST_NO_INIT_64: MemMapMemorySectionAlignment=64, MemMapMemorySectionSymbol=VAR_FAST_NO_INIT_64, MemMapMemorySectionSwAddrMethodRef=VAR_FAST_NO_INIT
        VAR_FAST_NO_INIT_PTR: MemMapMemorySectionAlignment=PTR, MemMapMemorySectionSymbol=VAR_FAST_NO_INIT_PTR, MemMapMemorySectionSwAddrMethodRef=VAR_FAST_NO_INIT
        VAR_FAST_NO_INIT_UNSPECIFIED: MemMapMemorySectionAlignment=UNSPECIFIED, MemMapMemorySectionSymbol=VAR_FAST_NO_INIT_UNSPECIFIED, MemMapMemorySectionSwAddrMethodRef=VAR_FAST_NO_INIT
        VAR_FAST_ZERO_INIT_8BIT: MemMapMemorySectionAlignment=8, MemMapMemorySectionSymbol=VAR_FAST_ZERO_INIT_8BIT, MemMapMemorySectionSwAddrMethodRef=VAR_FAST_CLEARED
        VAR_FAST_ZERO_INIT_16BIT: MemMapMemorySectionAlignment=16, MemMapMemorySectionSymbol=VAR_FAST_ZERO_INIT_16BIT, MemMapMemorySectionSwAddrMethodRef=VAR_FAST_CLEARED
        VAR_FAST_ZERO_INIT_32BIT: MemMapMemorySectionAlignment=32, MemMapMemorySectionSymbol=VAR_FAST_ZERO_INIT_32BIT, MemMapMemorySectionSwAddrMethodRef=VAR_FAST_CLEARED
        VAR_FAST_ZERO_INIT_64BIT: MemMapMemorySectionAlignment=64, MemMapMemorySectionSymbol=VAR_FAST_ZERO_INIT_64BIT, MemMapMemorySectionSwAddrMethodRef=VAR_FAST_CLEARED
        VAR_FAST_ZERO_INIT_UNSPECIFIED: MemMapMemorySectionAlignment=UNSPECIFIED, MemMapMemorySectionSymbol=VAR_FAST_ZERO_INIT_UNSPECIFIED, MemMapMemorySectionSwAddrMethodRef=VAR_FAST_CLEARED
        VAR_FAST_CLEARED_8: MemMapMemorySectionAlignment=8, MemMapMemorySectionSymbol=VAR_FAST_CLEARED_8, MemMapMemorySectionSwAddrMethodRef=VAR_FAST_CLEARED
        VAR_FAST_CLEARED_16: MemMapMemorySectionAlignment=16, MemMapMemorySectionSymbol=VAR_FAST_CLEARED_16, MemMapMemorySectionSwAddrMethodRef=VAR_FAST_CLEARED
        VAR_FAST_CLEARED_32: MemMapMemorySectionAlignment=32, MemMapMemorySectionSymbol=VAR_FAST_CLEARED_32, MemMapMemorySectionSwAddrMethodRef=VAR_FAST_CLEARED
        VAR_FAST_CLEARED_64: MemMapMemorySectionAlignment=64, MemMapMemorySectionSymbol=VAR_FAST_CLEARED_64, MemMapMemorySectionSwAddrMethodRef=VAR_FAST_CLEARED
        VAR_FAST_CLEARED_PTR: MemMapMemorySectionAlignment=PTR, MemMapMemorySectionSymbol=VAR_FAST_CLEARED_PTR, MemMapMemorySectionSwAddrMethodRef=VAR_FAST_CLEARED
        VAR_FAST_CLEARED_UNSPECIFIED: MemMapMemorySectionAlignment=UNSPECIFIED, MemMapMemorySectionSymbol=VAR_FAST_CLEARED_UNSPECIFIED, MemMapMemorySectionSwAddrMethodRef=VAR_FAST_CLEARED
        VAR_NOCACHE_INIT_8BIT: MemMapMemorySectionAlignment=8, MemMapMemorySectionSymbol=VAR_NOCACHE_INIT_8BIT, MemMapMemorySectionSwAddrMethodRef=VAR_NOCACHE_INIT
        VAR_NOCACHE_INIT_16BIT: MemMapMemorySectionAlignment=16, MemMapMemorySectionSymbol=VAR_NOCACHE_INIT_16BIT, MemMapMemorySectionSwAddrMethodRef=VAR_NOCACHE_INIT
        VAR_NOCACHE_INIT_32BIT: MemMapMemorySectionAlignment=32, MemMapMemorySectionSymbol=VAR_NOCACHE_INIT_32BIT, MemMapMemorySectionSwAddrMethodRef=VAR_NOCACHE_INIT
        VAR_NOCACHE_INIT_64BIT: MemMapMemorySectionAlignment=64, MemMapMemorySectionSymbol=VAR_NOCACHE_INIT_64BIT, MemMapMemorySectionSwAddrMethodRef=VAR_NOCACHE_INIT
        VAR_NOCACHE_INIT_8: MemMapMemorySectionAlignment=8, MemMapMemorySectionSymbol=VAR_NOCACHE_INIT_8, MemMapMemorySectionSwAddrMethodRef=VAR_NOCACHE_INIT
        VAR_NOCACHE_INIT_16: MemMapMemorySectionAlignment=16, MemMapMemorySectionSymbol=VAR_NOCACHE_INIT_16, MemMapMemorySectionSwAddrMethodRef=VAR_NOCACHE_INIT
        VAR_NOCACHE_INIT_32: MemMapMemorySectionAlignment=32, MemMapMemorySectionSymbol=VAR_NOCACHE_INIT_32, MemMapMemorySectionSwAddrMethodRef=VAR_NOCACHE_INIT
        VAR_NOCACHE_INIT_64: MemMapMemorySectionAlignment=64, MemMapMemorySectionSymbol=VAR_NOCACHE_INIT_64, MemMapMemorySectionSwAddrMethodRef=VAR_NOCACHE_INIT
        VAR_NOCACHE_INIT_PTR: MemMapMemorySectionAlignment=PTR, MemMapMemorySectionSymbol=VAR_NOCACHE_INIT_PTR, MemMapMemorySectionSwAddrMethodRef=VAR_NOCACHE_INIT
        VAR_NOCACHE_INIT_UNSPECIFIED: MemMapMemorySectionAlignment=UNSPECIFIED, MemMapMemorySectionSymbol=VAR_NOCACHE_INIT_UNSPECIFIED, MemMapMemorySectionSwAddrMethodRef=VAR_NOCACHE_INIT
        VAR_NOCACHE_NOINIT_8BIT: MemMapMemorySectionAlignment=8, MemMapMemorySectionSymbol=VAR_NOCACHE_NOINIT_8BIT, MemMapMemorySectionSwAddrMethodRef=VAR_NOCACHE_NO_INIT
        VAR_NOCACHE_NOINIT_16BIT: MemMapMemorySectionAlignment=16, MemMapMemorySectionSymbol=VAR_NOCACHE_NOINIT_16BIT, MemMapMemorySectionSwAddrMethodRef=VAR_NOCACHE_NO_INIT
        VAR_NOCACHE_NOINIT_32BIT: MemMapMemorySectionAlignment=32, MemMapMemorySectionSymbol=VAR_NOCACHE_NOINIT_32BIT, MemMapMemorySectionSwAddrMethodRef=VAR_NOCACHE_NO_INIT
        VAR_NOCACHE_NOINIT_64BIT: MemMapMemorySectionAlignment=64, MemMapMemorySectionSymbol=VAR_NOCACHE_NOINIT_64BIT, MemMapMemorySectionSwAddrMethodRef=VAR_NOCACHE_NO_INIT
        VAR_NOCACHE_NOINIT_UNSPECIFIED: MemMapMemorySectionAlignment=UNSPECIFIED, MemMapMemorySectionSymbol=VAR_NOCACHE_NOINIT_UNSPECIFIED, MemMapMemorySectionSwAddrMethodRef=VAR_NOCACHE_NO_INIT
        VAR_NOCACHE_NO_INIT_8: MemMapMemorySectionAlignment=8, MemMapMemorySectionSymbol=VAR_NOCACHE_NO_INIT_8, MemMapMemorySectionSwAddrMethodRef=VAR_NOCACHE_NO_INIT
        VAR_NOCACHE_NO_INIT_16: MemMapMemorySectionAlignment=16, MemMapMemorySectionSymbol=VAR_NOCACHE_NO_INIT_16, MemMapMemorySectionSwAddrMethodRef=VAR_NOCACHE_NO_INIT
        VAR_NOCACHE_NO_INIT_32: MemMapMemorySectionAlignment=32, MemMapMemorySectionSymbol=VAR_NOCACHE_NO_INIT_32, MemMapMemorySectionSwAddrMethodRef=VAR_NOCACHE_NO_INIT
        VAR_NOCACHE_NO_INIT_64: MemMapMemorySectionAlignment=64, MemMapMemorySectionSymbol=VAR_NOCACHE_NO_INIT_64, MemMapMemorySectionSwAddrMethodRef=VAR_NOCACHE_NO_INIT
        VAR_NOCACHE_NO_INIT_PTR: MemMapMemorySectionAlignment=PTR, MemMapMemorySectionSymbol=VAR_NOCACHE_NO_INIT_PTR, MemMapMemorySectionSwAddrMethodRef=VAR_NOCACHE_NO_INIT
        VAR_NOCACHE_NO_INIT_UNSPECIFIED: MemMapMemorySectionAlignment=UNSPECIFIED, MemMapMemorySectionSymbol=VAR_NOCACHE_NO_INIT_UNSPECIFIED, MemMapMemorySectionSwAddrMethodRef=VAR_NOCACHE_NO_INIT
        VAR_NOCACHE_ZERO_INIT_8BIT: MemMapMemorySectionAlignment=8, MemMapMemorySectionSymbol=VAR_NOCACHE_ZERO_INIT_8BIT, MemMapMemorySectionSwAddrMethodRef=VAR_NOCACHE_CLEARED
        VAR_NOCACHE_ZERO_INIT_16BIT: MemMapMemorySectionAlignment=16, MemMapMemorySectionSymbol=VAR_NOCACHE_ZERO_INIT_16BIT, MemMapMemorySectionSwAddrMethodRef=VAR_NOCACHE_CLEARED
        VAR_NOCACHE_ZERO_INIT_32BIT: MemMapMemorySectionAlignment=32, MemMapMemorySectionSymbol=VAR_NOCACHE_ZERO_INIT_32BIT, MemMapMemorySectionSwAddrMethodRef=VAR_NOCACHE_CLEARED
        VAR_NOCACHE_ZERO_INIT_64BIT: MemMapMemorySectionAlignment=64, MemMapMemorySectionSymbol=VAR_NOCACHE_ZERO_INIT_64BIT, MemMapMemorySectionSwAddrMethodRef=VAR_NOCACHE_CLEARED
        VAR_NOCACHE_ZERO_INIT_UNSPECIFIED: MemMapMemorySectionAlignment=UNSPECIFIED, MemMapMemorySectionSymbol=VAR_NOCACHE_ZERO_INIT_UNSPECIFIED, MemMapMemorySectionSwAddrMethodRef=VAR_NOCACHE_CLEARED
        VAR_NOCACHE_CLEARED_8: MemMapMemorySectionAlignment=8, MemMapMemorySectionSymbol=VAR_NOCACHE_CLEARED_8, MemMapMemorySectionSwAddrMethodRef=VAR_NOCACHE_CLEARED
        VAR_NOCACHE_CLEARED_16: MemMapMemorySectionAlignment=16, MemMapMemorySectionSymbol=VAR_NOCACHE_CLEARED_16, MemMapMemorySectionSwAddrMethodRef=VAR_NOCACHE_CLEARED
        VAR_NOCACHE_CLEARED_32: MemMapMemorySectionAlignment=32, MemMapMemorySectionSymbol=VAR_NOCACHE_CLEARED_32, MemMapMemorySectionSwAddrMethodRef=VAR_NOCACHE_CLEARED
        VAR_NOCACHE_CLEARED_64: MemMapMemorySectionAlignment=64, MemMapMemorySectionSymbol=VAR_NOCACHE_CLEARED_64, MemMapMemorySectionSwAddrMethodRef=VAR_NOCACHE_CLEARED
        VAR_NOCACHE_CLEARED_PTR: MemMapMemorySectionAlignment=PTR, MemMapMemorySectionSymbol=VAR_NOCACHE_CLEARED_PTR, MemMapMemorySectionSwAddrMethodRef=VAR_NOCACHE_CLEARED
        VAR_NOCACHE_CLEARED_UNSPECIFIED: MemMapMemorySectionAlignment=UNSPECIFIED, MemMapMemorySectionSymbol=VAR_NOCACHE_CLEARED_UNSPECIFIED, MemMapMemorySectionSwAddrMethodRef=VAR_NOCACHE_CLEARED
        VAR_PBCFG: MemMapMemorySectionAlignment=UNSPECIFIED, MemMapMemorySectionSymbol=VAR_PBCFG, MemMapMemorySectionSwAddrMethodRef=VAR_PBCFG
    MemMapGeneral:
      MemMapGeneration = FULL
      MemMapCompatibilityGeneration = FULL
      MemMapTypedPragmas = true
      MemMapGeneratePragmas = true
      MemMapErrorChecks = ALL
      MemMapGeneratePragmasForNearAddressing = false
    MSR_Generic (MemMapAllocation)
      10 x MemMapGenericMapping:
        MSR_CODE: MemMapSwAddressMethodRef=CODE, MemMapSwAddressMethodRef=CODE_QM, MemMapSwAddressMethodRef=CODE_ASIL_A, MemMapSwAddressMethodRef=CODE_ASIL_B, MemMapSwAddressMethodRef=CODE_ASIL_C, MemMapSwAddressMethodRef=CODE_ASIL_D, MemMapSwAddressMethodRef=CALLOUT_CODE, MemMapSwAddressMethodRef=CALLOUT_CODE_QM, MemMapSwAddressMethodRef=CALLOUT_CODE_ASIL_A, MemMapSwAddressMethodRef=CALLOUT_CODE_ASIL_B, MemMapSwAddressMethodRef=CALLOUT_CODE_ASIL_C, MemMapSwAddressMethodRef=CALLOUT_CODE_ASIL_D, MemMapSwAddressMethodRef=CODE_FAST, MemMapSwAddressMethodRef=CODE_FAST_QM, MemMapSwAddressMethodRef=CODE_FAST_ASIL_A, MemMapSwAddressMethodRef=CODE_FAST_ASIL_B, MemMapSwAddressMethodRef=CODE_FAST_ASIL_C, MemMapSwAddressMethodRef=CODE_FAST_ASIL_D, MemMapSwAddressMethodRef=CODE_ISR, MemMapSwAddressMethodRef=CODE_ISR_QM, MemMapSwAddressMethodRef=CODE_ISR_ASIL_A, MemMapSwAddressMethodRef=CODE_ISR_ASIL_B, MemMapSwAddressMethodRef=CODE_ISR_ASIL_C, MemMapSwAddressMethodRef=CODE_ISR_ASIL_D, MemMapSwAddressMethodRef=CODE_SLOW, MemMapSwAddressMethodRef=CODE_SLOW_QM, MemMapSwAddressMethodRef=CODE_SLOW_ASIL_A, MemMapSwAddressMethodRef=CODE_SLOW_ASIL_B, MemMapSwAddressMethodRef=CODE_SLOW_ASIL_C, MemMapSwAddressMethodRef=CODE_SLOW_ASIL_D, MemMapAddressingModeSetRef=MemMap/MSR_CODE
        MSR_CONST: MemMapSwAddressMethodRef=CONST_8, MemMapSwAddressMethodRef=CONST_16, MemMapSwAddressMethodRef=CONST_32, MemMapSwAddressMethodRef=CONST_64, MemMapSwAddressMethodRef=CONST_BOOLEAN, MemMapSwAddressMethodRef=CONST_FAST_8, MemMapSwAddressMethodRef=CONST_FAST_16, MemMapSwAddressMethodRef=CONST_FAST_32, MemMapSwAddressMethodRef=CONST_FAST_64, MemMapSwAddressMethodRef=CONST_FAST_BOOLEAN, MemMapSwAddressMethodRef=CONST_FAST_UNSPECIFIED, MemMapSwAddressMethodRef=CONST_UNSPECIFIED, MemMapAddressingModeSetRef=MemMap/MSR_CONST, MemMapSwAddressMethodRef=CONFIG_DATA, MemMapSwAddressMethodRef=CONFIG_DATA_PREBUILD, MemMapSwAddressMethodRef=CONFIG_DATA_PREBUILD_QM, MemMapSwAddressMethodRef=CONFIG_DATA_PREBUILD_ASIL_A, MemMapSwAddressMethodRef=CONFIG_DATA_PREBUILD_ASIL_B, MemMapSwAddressMethodRef=CONFIG_DATA_PREBUILD_ASIL_C, MemMapSwAddressMethodRef=CONFIG_DATA_PREBUILD_ASIL_D, MemMapSwAddressMethodRef=CONFIG_DATA_POSTBUILD, MemMapSwAddressMethodRef=CONFIG_DATA_POSTBUILD_QM, MemMapSwAddressMethodRef=CONFIG_DATA_POSTBUILD_ASIL_A, MemMapSwAddressMethodRef=CONFIG_DATA_POSTBUILD_ASIL_B, MemMapSwAddressMethodRef=CONFIG_DATA_POSTBUILD_ASIL_C, MemMapSwAddressMethodRef=CONFIG_DATA_POSTBUILD_ASIL_D, MemMapSwAddressMethodRef=CONST, MemMapSwAddressMethodRef=CONST_QM, MemMapSwAddressMethodRef=CONST_ASIL_A, MemMapSwAddressMethodRef=CONST_ASIL_B, MemMapSwAddressMethodRef=CONST_ASIL_C, MemMapSwAddressMethodRef=CONST_ASIL_D, MemMapSwAddressMethodRef=CONST_FAST, MemMapSwAddressMethodRef=CONST_FAST_QM, MemMapSwAddressMethodRef=CONST_FAST_ASIL_A, MemMapSwAddressMethodRef=CONST_FAST_ASIL_B, MemMapSwAddressMethodRef=CONST_FAST_ASIL_C, MemMapSwAddressMethodRef=CONST_FAST_ASIL_D, MemMapSwAddressMethodRef=CALIB, MemMapSwAddressMethodRef=CALIB_QM, MemMapSwAddressMethodRef=CALIB_ASIL_A, MemMapSwAddressMethodRef=CALIB_ASIL_B, MemMapSwAddressMethodRef=CALIB_ASIL_C, MemMapSwAddressMethodRef=CALIB_ASIL_D, MemMapSwAddressMethodRef=CONST_SAVED_RECOVERY_ZONE, MemMapSwAddressMethodRef=CONST_SAVED_RECOVERY_ZONE_QM, MemMapSwAddressMethodRef=CONST_SAVED_RECOVERY_ZONE_ASIL_A, MemMapSwAddressMethodRef=CONST_SAVED_RECOVERY_ZONE_ASIL_B, MemMapSwAddressMethodRef=CONST_SAVED_RECOVERY_ZONE_ASIL_C, MemMapSwAddressMethodRef=CONST_SAVED_RECOVERY_ZONE_ASIL_D
        MSR_PBCFG_CONST: MemMapSwAddressMethodRef=CONST_PBCFG, MemMapAddressingModeSetRef=MemMap/MSR_PBCFG_CONST, MemMapSwAddressMethodRef=PBCFG_GLOBALROOT
        MSR_PBCFG_VAR: MemMapSwAddressMethodRef=VAR_PBCFG, MemMapAddressingModeSetRef=MemMap/MSR_PBCFG_VAR
        MSR_VAR_CLEARED: MemMapSwAddressMethodRef=VAR_ZERO_INIT_8, MemMapSwAddressMethodRef=VAR_ZERO_INIT_16, MemMapSwAddressMethodRef=VAR_ZERO_INIT_32, MemMapSwAddressMethodRef=VAR_ZERO_INIT_64, MemMapSwAddressMethodRef=VAR_ZERO_INIT_UNSPECIFIED, MemMapAddressingModeSetRef=MemMap/MSR_VAR_CLEARED, MemMapSwAddressMethodRef=VAR_ZERO_INIT_BOOLEAN, MemMapSwAddressMethodRef=VAR_FAST_ZERO_INIT_8, MemMapSwAddressMethodRef=VAR_FAST_ZERO_INIT_16, MemMapSwAddressMethodRef=VAR_FAST_ZERO_INIT_32, MemMapSwAddressMethodRef=VAR_FAST_ZERO_INIT_64, MemMapSwAddressMethodRef=VAR_FAST_ZERO_INIT_BOOLEAN, MemMapSwAddressMethodRef=VAR_FAST_ZERO_INIT_UNSPECIFIED, MemMapSwAddressMethodRef=VAR_NOCACHE_ZERO_INIT_8, MemMapSwAddressMethodRef=VAR_NOCACHE_ZERO_INIT_16, MemMapSwAddressMethodRef=VAR_NOCACHE_ZERO_INIT_32, MemMapSwAddressMethodRef=VAR_NOCACHE_ZERO_INIT_64, MemMapSwAddressMethodRef=VAR_NOCACHE_ZERO_INIT_BOOLEAN, MemMapSwAddressMethodRef=VAR_NOCACHE_ZERO_INIT_UNSPECIFIED, MemMapSwAddressMethodRef=VAR_CLEARED_BOOLEAN, MemMapSwAddressMethodRef=VAR_CLEARED_8, MemMapSwAddressMethodRef=VAR_CLEARED_16, MemMapSwAddressMethodRef=VAR_CLEARED_32, MemMapSwAddressMethodRef=VAR_CLEARED_64, MemMapSwAddressMethodRef=VAR_CLEARED_UNSPECIFIED, MemMapSwAddressMethodRef=VAR_FAST_CLEARED_BOOLEAN, MemMapSwAddressMethodRef=VAR_FAST_CLEARED_8, MemMapSwAddressMethodRef=VAR_FAST_CLEARED_16, MemMapSwAddressMethodRef=VAR_FAST_CLEARED_32, MemMapSwAddressMethodRef=VAR_FAST_CLEARED_64, MemMapSwAddressMethodRef=VAR_FAST_CLEARED_UNSPECIFIED, MemMapSwAddressMethodRef=VAR_NOCACHE_CLEARED_BOOLEAN, MemMapSwAddressMethodRef=VAR_NOCACHE_CLEARED_8, MemMapSwAddressMethodRef=VAR_NOCACHE_CLEARED_16, MemMapSwAddressMethodRef=VAR_NOCACHE_CLEARED_32, MemMapSwAddressMethodRef=VAR_NOCACHE_CLEARED_64, MemMapSwAddressMethodRef=VAR_NOCACHE_CLEARED_UNSPECIFIED, MemMapSwAddressMethodRef=VAR_CLEARED, MemMapSwAddressMethodRef=VAR_CLEARED_QM, MemMapSwAddressMethodRef=VAR_CLEARED_ASIL_A, MemMapSwAddressMethodRef=VAR_CLEARED_ASIL_B, MemMapSwAddressMethodRef=VAR_CLEARED_ASIL_C, MemMapSwAddressMethodRef=VAR_CLEARED_ASIL_D, MemMapSwAddressMethodRef=VAR_FAST_CLEARED, MemMapSwAddressMethodRef=VAR_FAST_CLEARED_QM, MemMapSwAddressMethodRef=VAR_FAST_CLEARED_ASIL_A, MemMapSwAddressMethodRef=VAR_FAST_CLEARED_ASIL_B, MemMapSwAddressMethodRef=VAR_FAST_CLEARED_ASIL_C, MemMapSwAddressMethodRef=VAR_FAST_CLEARED_ASIL_D, MemMapSwAddressMethodRef=VAR_NOCACHE_CLEARED, MemMapSwAddressMethodRef=VAR_ZERO_INIT, MemMapSwAddressMethodRef=VAR_SLOW_CLEARED, MemMapSwAddressMethodRef=VAR_SLOW_CLEARED_QM, MemMapSwAddressMethodRef=VAR_SLOW_CLEARED_ASIL_A, MemMapSwAddressMethodRef=VAR_SLOW_CLEARED_ASIL_B, MemMapSwAddressMethodRef=VAR_SLOW_CLEARED_ASIL_C, MemMapSwAddressMethodRef=VAR_SLOW_CLEARED_ASIL_D, MemMapSwAddressMethodRef=INTERNAL_VAR_CLEARED, MemMapSwAddressMethodRef=INTERNAL_VAR_CLEARED_QM, MemMapSwAddressMethodRef=INTERNAL_VAR_CLEARED_ASIL_A, MemMapSwAddressMethodRef=INTERNAL_VAR_CLEARED_ASIL_B, MemMapSwAddressMethodRef=INTERNAL_VAR_CLEARED_ASIL_C, MemMapSwAddressMethodRef=INTERNAL_VAR_CLEARED_ASIL_D
        MSR_VAR_INIT: MemMapSwAddressMethodRef=VAR_FAST_INIT_8, MemMapSwAddressMethodRef=VAR_FAST_INIT_16, MemMapSwAddressMethodRef=VAR_FAST_INIT_32, MemMapSwAddressMethodRef=VAR_FAST_INIT_64, MemMapSwAddressMethodRef=VAR_FAST_INIT_UNSPECIFIED, MemMapSwAddressMethodRef=VAR_INIT_8, MemMapSwAddressMethodRef=VAR_INIT_16, MemMapSwAddressMethodRef=VAR_INIT_32, MemMapSwAddressMethodRef=VAR_INIT_64, MemMapSwAddressMethodRef=VAR_INIT_BOOLEAN, MemMapSwAddressMethodRef=VAR_INIT_UNSPECIFIED, MemMapAddressingModeSetRef=MemMap/MSR_VAR_INIT, MemMapSwAddressMethodRef=VAR_FAST_INIT_BOOLEAN, MemMapSwAddressMethodRef=VAR_NOCACHE_INIT_8, MemMapSwAddressMethodRef=VAR_NOCACHE_INIT_16, MemMapSwAddressMethodRef=VAR_NOCACHE_INIT_32, MemMapSwAddressMethodRef=VAR_NOCACHE_INIT_64, MemMapSwAddressMethodRef=VAR_NOCACHE_INIT_BOOLEAN, MemMapSwAddressMethodRef=VAR_NOCACHE_INIT_UNSPECIFIED, MemMapSwAddressMethodRef=VAR_INIT, MemMapSwAddressMethodRef=VAR_INIT_QM, MemMapSwAddressMethodRef=VAR_INIT_ASIL_A, MemMapSwAddressMethodRef=VAR_INIT_ASIL_B, MemMapSwAddressMethodRef=VAR_INIT_ASIL_C, MemMapSwAddressMethodRef=VAR_INIT_ASIL_D, MemMapSwAddressMethodRef=VAR_FAST_INIT, MemMapSwAddressMethodRef=VAR_FAST_INIT_QM, MemMapSwAddressMethodRef=VAR_FAST_INIT_ASIL_A, MemMapSwAddressMethodRef=VAR_FAST_INIT_ASIL_B, MemMapSwAddressMethodRef=VAR_FAST_INIT_ASIL_C, MemMapSwAddressMethodRef=VAR_FAST_INIT_ASIL_D, MemMapSwAddressMethodRef=VAR_NOCACHE_INIT, MemMapSwAddressMethodRef=VAR_SLOW, MemMapSwAddressMethodRef=INTERNAL_VAR, MemMapSwAddressMethodRef=VAR_SLOW_INIT, MemMapSwAddressMethodRef=VAR_SLOW_INIT_QM, MemMapSwAddressMethodRef=VAR_SLOW_INIT_ASIL_A, MemMapSwAddressMethodRef=VAR_SLOW_INIT_ASIL_B, MemMapSwAddressMethodRef=VAR_SLOW_INIT_ASIL_C, MemMapSwAddressMethodRef=VAR_SLOW_INIT_ASIL_D, MemMapSwAddressMethodRef=INTERNAL_VAR_INIT, MemMapSwAddressMethodRef=INTERNAL_VAR_INIT_QM, MemMapSwAddressMethodRef=INTERNAL_VAR_INIT_ASIL_A, MemMapSwAddressMethodRef=INTERNAL_VAR_INIT_ASIL_B, MemMapSwAddressMethodRef=INTERNAL_VAR_INIT_ASIL_C, MemMapSwAddressMethodRef=INTERNAL_VAR_INIT_ASIL_D
        MSR_VAR_NO_INIT: MemMapAddressingModeSetRef=MemMap/MSR_VAR_NO_INIT, MemMapSwAddressMethodRef=VAR_FAST_NO_INIT_8, MemMapSwAddressMethodRef=VAR_FAST_NO_INIT_16, MemMapSwAddressMethodRef=VAR_FAST_NO_INIT_32, MemMapSwAddressMethodRef=VAR_FAST_NO_INIT_64, MemMapSwAddressMethodRef=VAR_FAST_NO_INIT_UNSPECIFIED, MemMapSwAddressMethodRef=VAR_NO_INIT_8, MemMapSwAddressMethodRef=VAR_NO_INIT_16, MemMapSwAddressMethodRef=VAR_NO_INIT_32, MemMapSwAddressMethodRef=VAR_NO_INIT_64, MemMapSwAddressMethodRef=VAR_NO_INIT_UNSPECIFIED, MemMapSwAddressMethodRef=VAR_NO_INIT_BOOLEAN, MemMapSwAddressMethodRef=VAR_FAST_NO_INIT_BOOLEAN, MemMapSwAddressMethodRef=VAR_NOCACHE_NO_INIT_8, MemMapSwAddressMethodRef=VAR_NOCACHE_NO_INIT_16, MemMapSwAddressMethodRef=VAR_NOCACHE_NO_INIT_32, MemMapSwAddressMethodRef=VAR_NOCACHE_NO_INIT_64, MemMapSwAddressMethodRef=VAR_NOCACHE_NO_INIT_BOOLEAN, MemMapSwAddressMethodRef=VAR_NOCACHE_NO_INIT_UNSPECIFIED, MemMapSwAddressMethodRef=VAR_FAST_NOINIT_8, MemMapSwAddressMethodRef=VAR_FAST_NOINIT_16, MemMapSwAddressMethodRef=VAR_FAST_NOINIT_32, MemMapSwAddressMethodRef=VAR_FAST_NOINIT_64, MemMapSwAddressMethodRef=VAR_FAST_NOINIT_UNSPECIFIED, MemMapSwAddressMethodRef=VAR_NOINIT_8, MemMapSwAddressMethodRef=VAR_NOINIT_16, MemMapSwAddressMethodRef=VAR_NOINIT_32, MemMapSwAddressMethodRef=VAR_NOINIT_64, MemMapSwAddressMethodRef=VAR_NOINIT_UNSPECIFIED, MemMapSwAddressMethodRef=VAR_NOINIT_BOOLEAN, MemMapSwAddressMethodRef=VAR_FAST_NOINIT_BOOLEAN, MemMapSwAddressMethodRef=VAR_NOCACHE_NOINIT_8, MemMapSwAddressMethodRef=VAR_NOCACHE_NOINIT_16, MemMapSwAddressMethodRef=VAR_NOCACHE_NOINIT_32, MemMapSwAddressMethodRef=VAR_NOCACHE_NOINIT_64, MemMapSwAddressMethodRef=VAR_NOCACHE_NOINIT_BOOLEAN, MemMapSwAddressMethodRef=VAR_NOCACHE_NOINIT_UNSPECIFIED, MemMapSwAddressMethodRef=VAR_NO_INIT, MemMapSwAddressMethodRef=VAR_NO_INIT_QM, MemMapSwAddressMethodRef=VAR_NO_INIT_ASIL_A, MemMapSwAddressMethodRef=VAR_NO_INIT_ASIL_B, MemMapSwAddressMethodRef=VAR_NO_INIT_ASIL_C, MemMapSwAddressMethodRef=VAR_NO_INIT_ASIL_D, MemMapSwAddressMethodRef=VAR_FAST_NO_INIT, MemMapSwAddressMethodRef=VAR_FAST_NO_INIT_QM, MemMapSwAddressMethodRef=VAR_FAST_NO_INIT_ASIL_A, MemMapSwAddressMethodRef=VAR_FAST_NO_INIT_ASIL_B, MemMapSwAddressMethodRef=VAR_FAST_NO_INIT_ASIL_C, MemMapSwAddressMethodRef=VAR_FAST_NO_INIT_ASIL_D, MemMapSwAddressMethodRef=VAR_NOCACHE_NO_INIT, MemMapSwAddressMethodRef=VAR_SLOW_NO_INIT, MemMapSwAddressMethodRef=VAR_SLOW_NO_INIT_QM, MemMapSwAddressMethodRef=VAR_SLOW_NO_INIT_ASIL_A, MemMapSwAddressMethodRef=VAR_SLOW_NO_INIT_ASIL_B, MemMapSwAddressMethodRef=VAR_SLOW_NO_INIT_ASIL_C, MemMapSwAddressMethodRef=VAR_SLOW_NO_INIT_ASIL_D, MemMapSwAddressMethodRef=INTERNAL_VAR_NO_INIT, MemMapSwAddressMethodRef=INTERNAL_VAR_NO_INIT_QM, MemMapSwAddressMethodRef=INTERNAL_VAR_NO_INIT_ASIL_A, MemMapSwAddressMethodRef=INTERNAL_VAR_NO_INIT_ASIL_B, MemMapSwAddressMethodRef=INTERNAL_VAR_NO_INIT_ASIL_C, MemMapSwAddressMethodRef=INTERNAL_VAR_NO_INIT_ASIL_D
        MSR_VAR_POWER_ON_CLEARED: MemMapAddressingModeSetRef=MemMap/MSR_VAR_POWER_ON_CLEARED, MemMapSwAddressMethodRef=VAR_POWER_ON_CLEARED, MemMapSwAddressMethodRef=VAR_POWER_ON_CLEARED_QM, MemMapSwAddressMethodRef=VAR_POWER_ON_CLEARED_ASIL_A, MemMapSwAddressMethodRef=VAR_POWER_ON_CLEARED_ASIL_B, MemMapSwAddressMethodRef=VAR_POWER_ON_CLEARED_ASIL_C, MemMapSwAddressMethodRef=VAR_POWER_ON_CLEARED_ASIL_D, MemMapSwAddressMethodRef=VAR_FAST_POWER_ON_CLEARED, MemMapSwAddressMethodRef=VAR_FAST_POWER_ON_CLEARED_QM, MemMapSwAddressMethodRef=VAR_FAST_POWER_ON_CLEARED_ASIL_A, MemMapSwAddressMethodRef=VAR_FAST_POWER_ON_CLEARED_ASIL_B, MemMapSwAddressMethodRef=VAR_FAST_POWER_ON_CLEARED_ASIL_C, MemMapSwAddressMethodRef=VAR_FAST_POWER_ON_CLEARED_ASIL_D, MemMapSwAddressMethodRef=VAR_SLOW_POWER_ON_CLEARED, MemMapSwAddressMethodRef=VAR_SLOW_POWER_ON_CLEARED_QM, MemMapSwAddressMethodRef=VAR_SLOW_POWER_ON_CLEARED_ASIL_A, MemMapSwAddressMethodRef=VAR_SLOW_POWER_ON_CLEARED_ASIL_B, MemMapSwAddressMethodRef=VAR_SLOW_POWER_ON_CLEARED_ASIL_C, MemMapSwAddressMethodRef=VAR_SLOW_POWER_ON_CLEARED_ASIL_D, MemMapSwAddressMethodRef=INTERNAL_VAR_POWER_ON_CLEARED, MemMapSwAddressMethodRef=INTERNAL_VAR_POWER_ON_CLEARED_QM, MemMapSwAddressMethodRef=INTERNAL_VAR_POWER_ON_CLEARED_ASIL_A, MemMapSwAddressMethodRef=INTERNAL_VAR_POWER_ON_CLEARED_ASIL_B, MemMapSwAddressMethodRef=INTERNAL_VAR_POWER_ON_CLEARED_ASIL_C, MemMapSwAddressMethodRef=INTERNAL_VAR_POWER_ON_CLEARED_ASIL_D
        MSR_VAR_POWER_ON_INIT: MemMapAddressingModeSetRef=MemMap/MSR_VAR_POWER_ON_INIT, MemMapSwAddressMethodRef=VAR_POWER_ON_INIT, MemMapSwAddressMethodRef=VAR_POWER_ON_INIT_QM, MemMapSwAddressMethodRef=VAR_POWER_ON_INIT_ASIL_A, MemMapSwAddressMethodRef=VAR_POWER_ON_INIT_ASIL_B, MemMapSwAddressMethodRef=VAR_POWER_ON_INIT_ASIL_C, MemMapSwAddressMethodRef=VAR_POWER_ON_INIT_ASIL_D, MemMapSwAddressMethodRef=VAR_FAST_POWER_ON_INIT, MemMapSwAddressMethodRef=VAR_FAST_POWER_ON_INIT_QM, MemMapSwAddressMethodRef=VAR_FAST_POWER_ON_INIT_ASIL_A, MemMapSwAddressMethodRef=VAR_FAST_POWER_ON_INIT_ASIL_B, MemMapSwAddressMethodRef=VAR_FAST_POWER_ON_INIT_ASIL_C, MemMapSwAddressMethodRef=VAR_FAST_POWER_ON_INIT_ASIL_D, MemMapSwAddressMethodRef=VAR_SLOW_POWER_ON_INIT, MemMapSwAddressMethodRef=VAR_SLOW_POWER_ON_INIT_QM, MemMapSwAddressMethodRef=VAR_SLOW_POWER_ON_INIT_ASIL_A, MemMapSwAddressMethodRef=VAR_SLOW_POWER_ON_INIT_ASIL_B, MemMapSwAddressMethodRef=VAR_SLOW_POWER_ON_INIT_ASIL_C, MemMapSwAddressMethodRef=VAR_SLOW_POWER_ON_INIT_ASIL_D, MemMapSwAddressMethodRef=INTERNAL_VAR_POWER_ON_INIT, MemMapSwAddressMethodRef=INTERNAL_VAR_POWER_ON_INIT_QM, MemMapSwAddressMethodRef=INTERNAL_VAR_POWER_ON_INIT_ASIL_A, MemMapSwAddressMethodRef=INTERNAL_VAR_POWER_ON_INIT_ASIL_B, MemMapSwAddressMethodRef=INTERNAL_VAR_POWER_ON_INIT_ASIL_C, MemMapSwAddressMethodRef=INTERNAL_VAR_POWER_ON_INIT_ASIL_D
        MSR_VAR_SAVED_ZONE: MemMapAddressingModeSetRef=MemMap/MSR_VAR_SAVED_ZONE, MemMapSwAddressMethodRef=VAR_SAVED_ZONE_BOOLEAN, MemMapSwAddressMethodRef=VAR_SAVED_ZONE_8, MemMapSwAddressMethodRef=VAR_SAVED_ZONE_16, MemMapSwAddressMethodRef=VAR_SAVED_ZONE_32, MemMapSwAddressMethodRef=VAR_SAVED_ZONE_64, MemMapSwAddressMethodRef=VAR_SAVED_ZONE_UNSPECIFIED, MemMapSwAddressMethodRef=VAR_SAVED_ZONE, MemMapSwAddressMethodRef=VAR_SAVED_ZONE_QM, MemMapSwAddressMethodRef=VAR_SAVED_ZONE_ASIL_A, MemMapSwAddressMethodRef=VAR_SAVED_ZONE_ASIL_B, MemMapSwAddressMethodRef=VAR_SAVED_ZONE_ASIL_C, MemMapSwAddressMethodRef=VAR_SAVED_ZONE_ASIL_D
      8 x MemMapSectionSpecificMapping:
        CanIf_RAMCODE: MemMapAddressingModeSetRef=MemMap/FBL_RAMCODE, MemMapMemorySectionRef=CANIF_CODE, MemMapMemorySectionRef=CANIF_APPL_CODE
        CanIf_RAMCONST: MemMapAddressingModeSetRef=MemMap/FBL_RAMCONST, MemMapMemorySectionRef=CANIF_PBCFG, MemMapMemorySectionRef=CANIF_CONST_UNSPECIFIED, MemMapMemorySectionRef=CANIF_CONST_FAST_UNSPECIFIED, MemMapMemorySectionRef=CANIF_CONST_FAST_32BIT, MemMapMemorySectionRef=CANIF_CONST_FAST_16BIT, MemMapMemorySectionRef=CANIF_CONST_FAST_8BIT, MemMapMemorySectionRef=CANIF_CONST_32BIT, MemMapMemorySectionRef=CANIF_CONST_16BIT, MemMapMemorySectionRef=CANIF_CONST_8BIT
        CanTp_RAMCODE: MemMapAddressingModeSetRef=MemMap/FBL_RAMCODE, MemMapMemorySectionRef=CODE
        CanTp_RAMCONST: MemMapAddressingModeSetRef=MemMap/FBL_RAMCONST, MemMapMemorySectionRef=CONST_UNSPECIFIED, MemMapMemorySectionRef=CONST_BOOLEAN, MemMapMemorySectionRef=CONST_64, MemMapMemorySectionRef=CONST_32, MemMapMemorySectionRef=CONST_16, MemMapMemorySectionRef=CONST_8
        Det_RAMCODE: MemMapAddressingModeSetRef=MemMap/FBL_RAMCODE, MemMapMemorySectionRef=Det_SWC_CODE, MemMapMemorySectionRef=DET_CODE
        Det_RAMCONST: MemMapAddressingModeSetRef=MemMap/FBL_RAMCONST, MemMapMemorySectionRef=DET_CONST_UNSPECIFIED
        PduR_RAMCODE: MemMapAddressingModeSetRef=MemMap/FBL_RAMCODE, MemMapMemorySectionRef=CODE
        PduR_RAMCONST: MemMapAddressingModeSetRef=MemMap/FBL_RAMCONST, MemMapMemorySectionRef=BUFFER_CONST_UNSPECIFIED, MemMapMemorySectionRef=BUFFER_CONST_BOOLEAN, MemMapMemorySectionRef=BUFFER_CONST_64, MemMapMemorySectionRef=BUFFER_CONST_32, MemMapMemorySectionRef=BUFFER_CONST_16, MemMapMemorySectionRef=BUFFER_CONST_8, MemMapMemorySectionRef=CONST_UNSPECIFIED, MemMapMemorySectionRef=CONST_BOOLEAN, MemMapMemorySectionRef=CONST_64, MemMapMemorySectionRef=CONST_32, MemMapMemorySectionRef=CONST_16, MemMapMemorySectionRef=CONST_8
    12 x MemMapAddressingModeSet:
      MSR_CODE
        MSR_CODE (MemMapAddressingMode):
          MemMapAlignmentSelector = UNSPECIFIED
          MemMapAlignmentSelector = 8
          MemMapAlignmentSelector = 16
          MemMapAlignmentSelector = 32
          MemMapAlignmentSelector = 64
          MemMapAlignmentSelector = BOOLEAN
          MemMapAlignmentSelector = PTR
          MemMapLinkerLogicalGroupRef = MSR_CODE
      MSR_CONST
        MSR_CONST (MemMapAddressingMode):
          MemMapAlignmentSelector = UNSPECIFIED
          MemMapAlignmentSelector = 8
          MemMapAlignmentSelector = 16
          MemMapAlignmentSelector = 32
          MemMapAlignmentSelector = 64
          MemMapAlignmentSelector = BOOLEAN
          MemMapAlignmentSelector = PTR
          MemMapLinkerLogicalGroupRef = MSR_CONST
      MSR_PBCFG_CONST
        MSR_PBCFG_CONST (MemMapAddressingMode):
          MemMapAlignmentSelector = UNSPECIFIED
          MemMapAlignmentSelector = 8
          MemMapAlignmentSelector = 16
          MemMapAlignmentSelector = 32
          MemMapAlignmentSelector = 64
          MemMapAlignmentSelector = BOOLEAN
          MemMapAlignmentSelector = PTR
          MemMapLinkerLogicalGroupRef = MSR_PBCFG_CONST
      MSR_PBCFG_VAR
        MSR_PBCFG_VAR (MemMapAddressingMode):
          MemMapAlignmentSelector = UNSPECIFIED
          MemMapAlignmentSelector = 8
          MemMapAlignmentSelector = 16
          MemMapAlignmentSelector = 32
          MemMapAlignmentSelector = 64
          MemMapAlignmentSelector = BOOLEAN
          MemMapAlignmentSelector = PTR
          MemMapLinkerLogicalGroupRef = MSR_PBCFG_VAR
      MSR_VAR_CLEARED
        MSR_VAR_CLEARED (MemMapAddressingMode):
          MemMapAlignmentSelector = UNSPECIFIED
          MemMapAlignmentSelector = 8
          MemMapAlignmentSelector = 16
          MemMapAlignmentSelector = 32
          MemMapAlignmentSelector = 64
          MemMapAlignmentSelector = BOOLEAN
          MemMapAlignmentSelector = PTR
          MemMapLinkerLogicalGroupRef = MSR_VAR
      MSR_VAR_INIT
        MSR_VAR_INIT (MemMapAddressingMode):
          MemMapAlignmentSelector = UNSPECIFIED
          MemMapAlignmentSelector = 8
          MemMapAlignmentSelector = 16
          MemMapAlignmentSelector = 32
          MemMapAlignmentSelector = 64
          MemMapAlignmentSelector = BOOLEAN
          MemMapAlignmentSelector = PTR
          MemMapLinkerLogicalGroupRef = MSR_VAR
      MSR_VAR_NO_INIT
        MSR_VAR_NO_INIT (MemMapAddressingMode):
          MemMapAlignmentSelector = UNSPECIFIED
          MemMapAlignmentSelector = 8
          MemMapAlignmentSelector = 16
          MemMapAlignmentSelector = 32
          MemMapAlignmentSelector = 64
          MemMapAlignmentSelector = BOOLEAN
          MemMapAlignmentSelector = PTR
          MemMapLinkerLogicalGroupRef = MSR_VAR
      MSR_VAR_POWER_ON_CLEARED
        MSR_VAR_POWER_ON_CLEARED (MemMapAddressingMode):
          MemMapAlignmentSelector = UNSPECIFIED
          MemMapAlignmentSelector = 8
          MemMapAlignmentSelector = 16
          MemMapAlignmentSelector = 32
          MemMapAlignmentSelector = 64
          MemMapAlignmentSelector = BOOLEAN
          MemMapAlignmentSelector = PTR
          MemMapLinkerLogicalGroupRef = MSR_VAR
      MSR_VAR_POWER_ON_INIT
        MSR_VAR_POWER_ON_INIT (MemMapAddressingMode):
          MemMapAlignmentSelector = UNSPECIFIED
          MemMapAlignmentSelector = 8
          MemMapAlignmentSelector = 16
          MemMapAlignmentSelector = 32
          MemMapAlignmentSelector = 64
          MemMapAlignmentSelector = BOOLEAN
          MemMapAlignmentSelector = PTR
          MemMapLinkerLogicalGroupRef = MSR_VAR
      MSR_VAR_SAVED_ZONE
        MSR_VAR_SAVED_ZONE (MemMapAddressingMode):
          MemMapAlignmentSelector = UNSPECIFIED
          MemMapAlignmentSelector = 8
          MemMapAlignmentSelector = 16
          MemMapAlignmentSelector = 32
          MemMapAlignmentSelector = 64
          MemMapAlignmentSelector = BOOLEAN
          MemMapAlignmentSelector = PTR
          MemMapLinkerLogicalGroupRef = MSR_VAR_SAVED_ZONE
      FBL_RAMCODE
        FBL_RAMCODE (MemMapAddressingMode):
          MemMapAlignmentSelector = UNSPECIFIED
          MemMapAlignmentSelector = 8
          MemMapAlignmentSelector = 16
          MemMapAlignmentSelector = 32
          MemMapAlignmentSelector = 64
          MemMapAlignmentSelector = BOOLEAN
          MemMapLinkerLogicalGroupRef = FblUpd_RamCode
      FBL_RAMCONST
        FBL_RAMCONST (MemMapAddressingMode):
          MemMapAlignmentSelector = UNSPECIFIED
          MemMapAlignmentSelector = 8
          MemMapAlignmentSelector = 16
          MemMapAlignmentSelector = 32
          MemMapAlignmentSelector = 64
          MemMapAlignmentSelector = BOOLEAN
          MemMapLinkerLogicalGroupRef = FblUpd_RamConst
