AUTOSAR XML (schema 00049)
package /ActiveEcuC
  module config FblHal: implementation-config-variant=VARIANT-LINK-TIME, module-description=FblHal_Impl
    FblHalGeneral:
      FblHalFlashCodeBufferSize = 12288
      FblHalECCSafeRead = true
      FblHalDerivativeSpecificDefines = #define V_COMP_GHS
      FblHalDerivativeSpecificDefines = #define V_COMP_GHS_RH850
      FblHalDerivativeSpecificDefines = #define C_COMP_GHS_RH850_RSCAN
      FblHalDerivativeSpecificDefines = #define C_PROCESSOR_F1KM
      FblHalDerivativeSpecificDefines = #define V_CPU_RH850
      FblHalDerivativeSpecificDefines = #define C_CPUTYPE_32BIT
      FblHalDerivativeSpecificDefines = #define V_SUPPRESS_EXTENDED_VERSION_CHECK
      FblHalDerivativeSpecificDefines = #define VGEN_ENABLE_CANFBL
      FblHalDerivativeSpecificDefines = #define V_ENABLE_CAN_ASR_ABSTRACTION
      FblHalDerivativeSpecificDefines = #define V_PROCESSOR_F1KM
      FblHalTimerClockFreq = 80000000
    FblHalRh850: FblHalTimerHasPrescaler=true, FblHalInternalSystemClockFreq=240000000, FblHalInternalSystemClockRef=McuClockReferencePoint
