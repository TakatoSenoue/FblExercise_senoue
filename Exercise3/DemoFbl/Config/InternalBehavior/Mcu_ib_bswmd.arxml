AUTOSAR XML (schema 00049)
package /Renesas/Mcu_ib_bswmd/BswModuleDescriptions
  bsw module description Mcu: provided-entrys=Mcu_Virtual
    bsw internal behavior McuBehavior
      exclusive area MCU_PWR_MODE_PSC_PROTECTION
      exclusive area MCU_REGISTER_PROTECTION
      exclusive area MCU_VARIABLE_PROTECTION
      bsw called entity Mcu_Virtual: can-enter-exclusive-area=[MCU_PWR_MODE_PSC_PROTECTION, MCU_REGISTER_PROTECTION, MCU_VARIABLE_PROTECTION], implemented-entry=Mcu_Virtual
  bsw module entry Mcu_Virtual: call-type=REGULAR, execution-context=TASK
