AUTOSAR XML (schema 00049)
package /Renesas/Port_ib_bswmd/BswModuleDescriptions
  bsw module description Port: provided-entrys=Port_Virtual
    bsw internal behavior PortBehavior
      11 x exclusive area:
        PORT_INIT_PROTECTION
        PORT_SET_PIN_DIR_PROTECTION
        PORT_SET_PIN_MODE_PROTECTION
        PORT_SET_TO_DIO_ALT_PROTECTION
        PORT_INIT_CONFIG_PROTECTION
        PORT_REFRESH_PORT_INTERNAL_PROTECTION
        PORT_FILTER_CONFIG_PROTECTION
        PORT_SET_PIN_DEFAULT_MODE_PROTECTION
        PORT_SET_PIN_DEFAULT_DIR_PROTECTION
        PORT_CHECK_HW_CONSISTENCY_PROTECTION
        PORT_REGISTER_PROTECTION
      bsw called entity Port_Virtual: can-enter-exclusive-area=[PORT_INIT_PROTECTION, PORT_SET_PIN_DIR_PROTECTION, PORT_SET_PIN_MODE_PROTECTION, PORT_SET_TO_DIO_ALT_PROTECTION, PORT_INIT_CONFIG_PROTECTION, PORT_REFRESH_PORT_INTERNAL_PROTECTION, PORT_FILTER_CONFIG_PROTECTION, PORT_SET_PIN_DEFAULT_MODE_PROTECTION, PORT_SET_PIN_DEFAULT_DIR_PROTECTION, PORT_CHECK_HW_CONSISTENCY_PROTECTION, PORT_REGISTER_PROTECTION], implemented-entry=Port_Virtual
  bsw module entry Port_Virtual: call-type=REGULAR, execution-context=TASK
