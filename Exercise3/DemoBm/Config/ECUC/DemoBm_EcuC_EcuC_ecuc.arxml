AUTOSAR XML (schema 00053)
package /ActiveEcuC
  module config EcuC: implementation-config-variant=VARIANT-PRE-COMPILE, module-description=EcuC_Impl
    EcucGeneral:
      DummyFunction = false
      DummyStatement = true
      StructAlignment = Auto
      ArrayAlignment = Auto
      StructInArrayAlignment = Auto
      SizeOfEnum = Size32Bit
      SizeOfROMPointer = Size32Bit
      SizeOfRAMPointer = Size32Bit
      DummyStatementKind = SelfAssignment
      AtomicBitAccessInBitfield = false
      AtomicVariableAccess = Atomic8BitAccess
      CPUType = CPU32Bit
      SizeOfInt = Size32Bit
      ByteOrder = LITTLE_ENDIAN
      BitOrder = LSB_to_MSB
      BitFieldDataType = INT
      ConditionalGenerating = true
      EcucBswImplementationCodeType = EcuCSourceCode
      EcuCUseStdReturnTypeForRte = false
      BswInitialization
        8 x InitFunction:
          Det_Init: Header=Det.h, InitPhase=INIT_ZERO, ConfigType=Det_ConfigType, ConfigPtrClass=DET_INIT_DATA, ConfigPtrName=Det_Config_Ptr, ModuleRef=Det  # /ActiveEcuC/Det PLAIN_TEXT Init function description of Det in UnfilteredViewInInvariantProject (UnfilteredInvariantProjectModelView) .
          Det_Start: Header=Det.h, InitPhase=INIT_ONE, ModuleRef=Det  # /ActiveEcuC/Det PLAIN_TEXT PostInit function description of Det in UnfilteredViewInInvariantProject (UnfilteredInvariantProjectModelView) .
          Det_InitMemory: Header=Det.h, InitPhase=INIT_MEMORY, ModuleRef=Det  # /ActiveEcuC/Det PLAIN_TEXT InitMemory function description of Det in UnfilteredViewInInvariantProject (UnfilteredInvariantProjectModelView) .
          Brs_Init: Header=, InitPhase=NO_INIT, ModuleRef=vBRS  # /ActiveEcuC/vBRS PLAIN_TEXT Automatically generated by BswInitFctConfigurationService.
          vBaseEnv_Init: Header=, InitPhase=NO_INIT, ModuleRef=vBaseEnv  # /ActiveEcuC/vBaseEnv PLAIN_TEXT Created vBaseEnv_Init by Extended Init XML Service
          vLinkGen_Init: Header=vLinkGen_Lcfg.h, InitPhase=NO_INIT, ModuleRef=vLinkGen  # /ActiveEcuC/vLinkGen PLAIN_TEXT Dummy initialization of the vLinkGen
          Mcu_Init: Header=Mcu.h, InitPhase=INIT_ONE_EARLY, ConfigType=Mcu_ConfigType, ConfigPtrClass=MCU_APPL_CONST, ConfigPtrName=McuModuleConfiguration, AdditionalInitCode=Mcu_InitClock(McuConf_McuClockSettingConfig_McuClockSettingConfig);while (MCU_PLL_LOCKED != Mcu_GetPllStatus());Mcu_DistributePllClock();, ModuleRef=Mcu  # /ActiveEcuC/Mcu PLAIN_TEXT Created Mcu_Init by Extended Init XML Service
          Port_Init: Header=Port.h, InitPhase=INIT_ONE_EARLY, ConfigType=Port_ConfigType, ConfigPtrClass=PORT_APPL_CONST, ConfigPtrName=PortConfigSet, ModuleRef=Port  # /ActiveEcuC/Port PLAIN_TEXT Created Port_Init by Extended Init XML Service
