[part 1 of 2: package /ActiveEcuC]
AUTOSAR XML (schema 00053)
package /ActiveEcuC
  module config vBaseEnv: implementation-config-variant=VARIANT-PRE-COMPILE, module-description=vBaseEnv_Impl
    vBaseEnvGeneral: vBaseEnvTestedDerivativeRef=RH850_1649
      12 x vBaseEnvMemLayoutHwRegion:
        CodeFlash_A
        CodeFlash_B
        CodeFlash_Ext
        DataFlash
        GlobalRAM_A
        GlobalRAM_B
        LocalRAM_Self
        LocalRAM_CPU0
        LocalRAM_CPU1
        RetentionRAM
        RetentionRAM_Self
        FCU_RAM
      181 x vBaseEnvDerivativeInformation, all with vBaseEnvAvailableChannels_Hyperbus=0, vBaseEnvAvailableChannels_I2c=0, vBaseEnvAvailableChannels_Spi=0, vBaseEnvAvailableChannels_EthernetSwitch=0:
        RH850_1260: vBaseEnvCpuMaxFrequency=240000000, vBaseEnvAvailableChannels_Flexray=0, vBaseEnvAvailableChannels_Can=4, vBaseEnvAvailableChannels_Lin=3, vBaseEnvAvailableChannels_Ethernet=0, vBaseEnvCpuCoreAmount=2, vBaseEnvTestedDerivative=RH850_1260, vBaseEnvTestedDerivativeDescription=Renesas RH850 C1H Family R7F701260, vBaseEnvCpuCore=G3M
          vBaseEnvAdditionalParameters: vBaseEnvClockGroup=C, vBaseEnvDerivativeGroup=C1H, vBaseEnvPllGroup=C, vBaseEnvProtectionGroup=B, vBaseEnvPortGroup=B1, vBaseEnvResetGroup=B
          9 x vBaseEnvMemLayoutHwRegion:
            CodeFlash_A: vBaseEnvHwRegionSize=2097152, vBaseEnvHwRegionStartAddress=0
            CodeFlash_B: vBaseEnvHwRegionSize=2097152, vBaseEnvHwRegionStartAddress=8388608
            LocalRAM_CPU0: vBaseEnvHwRegionSize=65536, vBaseEnvHwRegionStartAddress=4273930240, vBaseEnvHwRegionEccAlignment=4
            LocalRAM_CPU1: vBaseEnvHwRegionSize=65536, vBaseEnvHwRegionStartAddress=4271833088, vBaseEnvHwRegionEccAlignment=4
            GlobalRAM_A: vBaseEnvHwRegionSize=65536, vBaseEnvHwRegionStartAddress=4277075968, vBaseEnvHwRegionEccAlignment=4
            GlobalRAM_B: vBaseEnvHwRegionSize=49152, vBaseEnvHwRegionStartAddress=4277141504, vBaseEnvHwRegionEccAlignment=4
            DataFlash: vBaseEnvHwRegionSize=32768, vBaseEnvHwRegionStartAddress=4280287232
            FCU_RAM: vBaseEnvHwRegionSize=4096, vBaseEnvHwRegionStartAddress=4288749568, vBaseEnvHwRegionEccAlignment=4
            LocalRAM_Self: vBaseEnvHwRegionSize=65536, vBaseEnvHwRegionStartAddress=4276027392, vBaseEnvHwRegionEccAlignment=4
          vBaseEnvClockSettings: vBaseEnvOscClock=20000000, vBaseEnvPeriphClock=120000000, vBaseEnvTimebaseClock=240000000
        RH850_1270: vBaseEnvCpuMaxFrequency=240000000, vBaseEnvAvailableChannels_Flexray=0, vBaseEnvAvailableChannels_Can=4, vBaseEnvAvailableChannels_Lin=3, vBaseEnvAvailableChannels_Ethernet=0, vBaseEnvCpuCoreAmount=2, vBaseEnvTestedDerivative=RH850_1270, vBaseEnvTestedDerivativeDescription=Renesas RH850 C1H Family R7F701270, vBaseEnvCpuCore=G3M
          vBaseEnvAdditionalParameters: vBaseEnvClockGroup=C, vBaseEnvDerivativeGroup=C1H, vBaseEnvPllGroup=C, vBaseEnvProtectionGroup=B, vBaseEnvPortGroup=B1, vBaseEnvResetGroup=B
          9 x vBaseEnvMemLayoutHwRegion:
            CodeFlash_A: vBaseEnvHwRegionSize=2097152, vBaseEnvHwRegionStartAddress=0
            CodeFlash_B: vBaseEnvHwRegionSize=2097152, vBaseEnvHwRegionStartAddress=8388608
            LocalRAM_CPU0: vBaseEnvHwRegionSize=65536, vBaseEnvHwRegionStartAddress=4273930240, vBaseEnvHwRegionEccAlignment=4
            LocalRAM_CPU1: vBaseEnvHwRegionSize=65536, vBaseEnvHwRegionStartAddress=4271833088, vBaseEnvHwRegionEccAlignment=4
            GlobalRAM_A: vBaseEnvHwRegionSize=65536, vBaseEnvHwRegionStartAddress=4277075968, vBaseEnvHwRegionEccAlignment=4
            GlobalRAM_B: vBaseEnvHwRegionSize=49152, vBaseEnvHwRegionStartAddress=4277141504, vBaseEnvHwRegionEccAlignment=4
            DataFlash: vBaseEnvHwRegionSize=32768, vBaseEnvHwRegionStartAddress=4280287232
            FCU_RAM: vBaseEnvHwRegionSize=4096, vBaseEnvHwRegionStartAddress=4288749568, vBaseEnvHwRegionEccAlignment=4
            LocalRAM_Self: vBaseEnvHwRegionSize=65536, vBaseEnvHwRegionStartAddress=4276027392, vBaseEnvHwRegionEccAlignment=4
          vBaseEnvClockSettings: vBaseEnvOscClock=20000000, vBaseEnvPeriphClock=120000000, vBaseEnvTimebaseClock=240000000
        RH850_1275: vBaseEnvCpuMaxFrequency=320000000, vBaseEnvAvailableChannels_Flexray=0, vBaseEnvAvailableChannels_Can=4, vBaseEnvAvailableChannels_Lin=3, vBaseEnvAvailableChannels_Ethernet=0, vBaseEnvCpuCoreAmount=2, vBaseEnvTestedDerivative=RH850_1275, vBaseEnvTestedDerivativeDescription=Renesas RH850 C1M_AZ Family R7F701275, vBaseEnvCpuCore=G3M
          vBaseEnvAdditionalParameters: vBaseEnvClockGroup=C, vBaseEnvDerivativeGroup=C1M_A2, vBaseEnvPllGroup=C, vBaseEnvProtectionGroup=B, vBaseEnvPortGroup=E, vBaseEnvResetGroup=B
          9 x vBaseEnvMemLayoutHwRegion:
            CodeFlash_A: vBaseEnvHwRegionSize=2097152, vBaseEnvHwRegionStartAddress=0
            CodeFlash_B: vBaseEnvHwRegionSize=2097152, vBaseEnvHwRegionStartAddress=2097152
            LocalRAM_CPU0: vBaseEnvHwRegionSize=65536, vBaseEnvHwRegionStartAddress=4273930240, vBaseEnvHwRegionEccAlignment=4
            LocalRAM_CPU1: vBaseEnvHwRegionSize=65536, vBaseEnvHwRegionStartAddress=4271833088, vBaseEnvHwRegionEccAlignment=4
            GlobalRAM_A: vBaseEnvHwRegionSize=65536, vBaseEnvHwRegionStartAddress=4277075968, vBaseEnvHwRegionEccAlignment=4
            GlobalRAM_B: vBaseEnvHwRegionSize=65536, vBaseEnvHwRegionStartAddress=4277141504, vBaseEnvHwRegionEccAlignment=4
            DataFlash: vBaseEnvHwRegionSize=65536, vBaseEnvHwRegionStartAddress=4280287232
            FCU_RAM: vBaseEnvHwRegionSize=4096, vBaseEnvHwRegionStartAddress=4288749568, vBaseEnvHwRegionEccAlignment=4
            LocalRAM_Self: vBaseEnvHwRegionSize=65536, vBaseEnvHwRegionStartAddress=4276027392, vBaseEnvHwRegionEccAlignment=4
          vBaseEnvClockSettings: vBaseEnvPeriphClock=40000000, vBaseEnvOscClock=20000000, vBaseEnvTimebaseClock=320000000
        RH850_1401: vBaseEnvCpuMaxFrequency=120000000, vBaseEnvAvailableChannels_Flexray=0, vBaseEnvAvailableChannels_Can=3, vBaseEnvAvailableChannels_Lin=4, vBaseEnvAvailableChannels_Ethernet=0, vBaseEnvCpuCoreAmount=1, vBaseEnvTestedDerivative=RH850_1401, vBaseEnvTestedDerivativeDescription=Renesas RH850 D1L Family R7F701401, vBaseEnvCpuCore=G3M
          vBaseEnvAdditionalParameters: vBaseEnvClockGroup=A1, vBaseEnvDerivativeGroup=D1L, vBaseEnvPllGroup=A2, vBaseEnvProtectionGroup=A, vBaseEnvPortGroup=C, vBaseEnvResetGroup=A
          5 x vBaseEnvMemLayoutHwRegion:
            CodeFlash_A: vBaseEnvHwRegionSize=2097152, vBaseEnvHwRegionStartAddress=0
            LocalRAM_CPU0: vBaseEnvHwRegionSize=262144, vBaseEnvHwRegionStartAddress=4273733632, vBaseEnvHwRegionEccAlignment=4
            DataFlash: vBaseEnvHwRegionSize=65536, vBaseEnvHwRegionStartAddress=4280287232
            CodeFlash_Ext: vBaseEnvHwRegionSize=32768, vBaseEnvHwRegionStartAddress=16777216
            RetentionRAM: vBaseEnvHwRegionSize=16384, vBaseEnvHwRegionStartAddress=1070481408, vBaseEnvHwRegionEccAlignment=4
          vBaseEnvClockSettings: vBaseEnvOscClock=16000000, vBaseEnvPeriphClock=60000000, vBaseEnvTimebaseClock=120000000
        RH850_1402: vBaseEnvCpuMaxFrequency=120000000, vBaseEnvAvailableChannels_Flexray=0, vBaseEnvAvailableChannels_Can=3, vBaseEnvAvailableChannels_Lin=4, vBaseEnvAvailableChannels_Ethernet=0, vBaseEnvCpuCoreAmount=1, vBaseEnvTestedDerivative=RH850_1402, vBaseEnvTestedDerivativeDescription=Renesas RH850 D1L Family R7F701402, vBaseEnvCpuCore=G3M
          vBaseEnvAdditionalParameters: vBaseEnvClockGroup=A1, vBaseEnvDerivativeGroup=D1L, vBaseEnvPllGroup=A2, vBaseEnvProtectionGroup=A, vBaseEnvPortGroup=C, vBaseEnvResetGroup=A
          5 x vBaseEnvMemLayoutHwRegion:
            CodeFlash_A: vBaseEnvHwRegionSize=4194304, vBaseEnvHwRegionStartAddress=0
            LocalRAM_CPU0: vBaseEnvHwRegionSize=524288, vBaseEnvHwRegionStartAddress=4273471488, vBaseEnvHwRegionEccAlignment=4
            DataFlash: vBaseEnvHwRegionSize=65536, vBaseEnvHwRegionStartAddress=4280287232
            CodeFlash_Ext: vBaseEnvHwRegionSize=32768, vBaseEnvHwRegionStartAddress=16777216
            RetentionRAM: vBaseEnvHwRegionSize=16384, vBaseEnvHwRegionStartAddress=1070481408, vBaseEnvHwRegionEccAlignment=4
          vBaseEnvClockSettings: vBaseEnvOscClock=16000000, vBaseEnvPeriphClock=60000000, vBaseEnvTimebaseClock=120000000
        RH850_1403: vBaseEnvCpuMaxFrequency=120000000, vBaseEnvAvailableChannels_Flexray=0, vBaseEnvAvailableChannels_Can=3, vBaseEnvAvailableChannels_Lin=4, vBaseEnvAvailableChannels_Ethernet=0, vBaseEnvCpuCoreAmount=1, vBaseEnvTestedDerivative=RH850_1403, vBaseEnvTestedDerivativeDescription=Renesas RH850 D1L Family R7F701403, vBaseEnvCpuCore=G3M
          vBaseEnvAdditionalParameters: vBaseEnvClockGroup=A1, vBaseEnvDerivativeGroup=D1L, vBaseEnvPllGroup=A2, vBaseEnvProtectionGroup=A, vBaseEnvPortGroup=C, vBaseEnvResetGroup=A
          5 x vBaseEnvMemLayoutHwRegion:
            CodeFlash_A: vBaseEnvHwRegionSize=4194304, vBaseEnvHwRegionStartAddress=0
            LocalRAM_CPU0: vBaseEnvHwRegionSize=524288, vBaseEnvHwRegionStartAddress=4273471488, vBaseEnvHwRegionEccAlignment=4
            DataFlash: vBaseEnvHwRegionSize=65536, vBaseEnvHwRegionStartAddress=4280287232
            CodeFlash_Ext: vBaseEnvHwRegionSize=32768, vBaseEnvHwRegionStartAddress=16777216
            RetentionRAM: vBaseEnvHwRegionSize=16384, vBaseEnvHwRegionStartAddress=1070481408, vBaseEnvHwRegionEccAlignment=4
          vBaseEnvClockSettings: vBaseEnvOscClock=16000000, vBaseEnvPeriphClock=60000000, vBaseEnvTimebaseClock=120000000
        RH850_1404: vBaseEnvCpuMaxFrequency=160000000, vBaseEnvAvailableChannels_Flexray=0, vBaseEnvAvailableChannels_Can=3, vBaseEnvAvailableChannels_Lin=4, vBaseEnvAvailableChannels_Ethernet=1, vBaseEnvCpuCoreAmount=1, vBaseEnvTestedDerivative=RH850_1404, vBaseEnvTestedDerivativeDescription=Renesas RH850 D1M Family R7F701404, vBaseEnvCpuCore=G3M
          vBaseEnvAdditionalParameters: vBaseEnvClockGroup=A1, vBaseEnvDerivativeGroup=D1M, vBaseEnvPllGroup=A2, vBaseEnvProtectionGroup=A, vBaseEnvPortGroup=C, vBaseEnvResetGroup=A
          5 x vBaseEnvMemLayoutHwRegion:
            CodeFlash_A: vBaseEnvHwRegionSize=3932160, vBaseEnvHwRegionStartAddress=0
            LocalRAM_CPU0: vBaseEnvHwRegionSize=524288, vBaseEnvHwRegionStartAddress=4273471488, vBaseEnvHwRegionEccAlignment=4
            DataFlash: vBaseEnvHwRegionSize=65536, vBaseEnvHwRegionStartAddress=4280287232
            CodeFlash_Ext: vBaseEnvHwRegionSize=32768, vBaseEnvHwRegionStartAddress=16777216
            RetentionRAM: vBaseEnvHwRegionSize=16384, vBaseEnvHwRegionStartAddress=1070481408, vBaseEnvHwRegionEccAlignment=4
          vBaseEnvClockSettings: vBaseEnvOscClock=16000000, vBaseEnvPeriphClock=60000000, vBaseEnvTimebaseClock=120000000
        RH850_1405: vBaseEnvCpuMaxFrequency=160000000, vBaseEnvAvailableChannels_Flexray=0, vBaseEnvAvailableChannels_Can=3, vBaseEnvAvailableChannels_Lin=4, vBaseEnvAvailableChannels_Ethernet=1, vBaseEnvCpuCoreAmount=1, vBaseEnvTestedDerivative=RH850_1405, vBaseEnvTestedDerivativeDescription=Renesas RH850 D1M Family R7F701405, vBaseEnvCpuCore=G3M
          vBaseEnvAdditionalParameters: vBaseEnvClockGroup=A1, vBaseEnvDerivativeGroup=D1M, vBaseEnvPllGroup=A2, vBaseEnvProtectionGroup=A, vBaseEnvPortGroup=C, vBaseEnvResetGroup=A
          5 x vBaseEnvMemLayoutHwRegion:
            CodeFlash_A: vBaseEnvHwRegionSize=5242880, vBaseEnvHwRegionStartAddress=0
            LocalRAM_CPU0: vBaseEnvHwRegionSize=524288, vBaseEnvHwRegionStartAddress=4273471488, vBaseEnvHwRegionEccAlignment=4
            DataFlash: vBaseEnvHwRegionSize=65536, vBaseEnvHwRegionStartAddress=4280287232
            CodeFlash_Ext: vBaseEnvHwRegionSize=32768, vBaseEnvHwRegionStartAddress=16777216
            RetentionRAM: vBaseEnvHwRegionSize=16384, vBaseEnvHwRegionStartAddress=1070481408, vBaseEnvHwRegionEccAlignment=4
          vBaseEnvClockSettings: vBaseEnvOscClock=16000000, vBaseEnvPeriphClock=60000000, vBaseEnvTimebaseClock=120000000
        RH850_1406: vBaseEnvCpuMaxFrequency=200000000, vBaseEnvAvailableChannels_Flexray=0, vBaseEnvAvailableChannels_Can=3, vBaseEnvAvailableChannels_Lin=4, vBaseEnvAvailableChannels_Ethernet=1, vBaseEnvCpuCoreAmount=1, vBaseEnvTestedDerivative=RH850_1406, vBaseEnvTestedDerivativeDescription=Renesas RH850 D1M Family R7F701406, vBaseEnvCpuCore=G3M
          vBaseEnvAdditionalParameters: vBaseEnvClockGroup=A1, vBaseEnvDerivativeGroup=D1M, vBaseEnvPllGroup=A2, vBaseEnvProtectionGroup=A, vBaseEnvPortGroup=C, vBaseEnvResetGroup=A
          5 x vBaseEnvMemLayoutHwRegion:
            CodeFlash_A: vBaseEnvHwRegionSize=3932160, vBaseEnvHwRegionStartAddress=0
            LocalRAM_CPU0: vBaseEnvHwRegionSize=524288, vBaseEnvHwRegionStartAddress=4273471488, vBaseEnvHwRegionEccAlignment=4
            DataFlash: vBaseEnvHwRegionSize=65536, vBaseEnvHwRegionStartAddress=4280287232
            CodeFlash_Ext: vBaseEnvHwRegionSize=32768, vBaseEnvHwRegionStartAddress=16777216
            RetentionRAM: vBaseEnvHwRegionSize=16384, vBaseEnvHwRegionStartAddress=1070481408, vBaseEnvHwRegionEccAlignment=4
          vBaseEnvClockSettings: vBaseEnvOscClock=16000000, vBaseEnvPeriphClock=60000000, vBaseEnvTimebaseClock=120000000
        RH850_1407: vBaseEnvCpuMaxFrequency=200000000, vBaseEnvAvailableChannels_Flexray=0, vBaseEnvAvailableChannels_Can=3, vBaseEnvAvailableChannels_Lin=4, vBaseEnvAvailableChannels_Ethernet=1, vBaseEnvCpuCoreAmount=1, vBaseEnvTestedDerivative=RH850_1407, vBaseEnvTestedDerivativeDescription=Renesas RH850 D1M Family R7F701407, vBaseEnvCpuCore=G3M
          vBaseEnvAdditionalParameters: vBaseEnvClockGroup=A1, vBaseEnvDerivativeGroup=D1M, vBaseEnvPllGroup=A2, vBaseEnvProtectionGroup=A, vBaseEnvPortGroup=C, vBaseEnvResetGroup=A
          5 x vBaseEnvMemLayoutHwRegion:
            CodeFlash_A: vBaseEnvHwRegionSize=5242880, vBaseEnvHwRegionStartAddress=0
            LocalRAM_CPU0: vBaseEnvHwRegionSize=524288, vBaseEnvHwRegionStartAddress=4273471488, vBaseEnvHwRegionEccAlignment=4
            DataFlash: vBaseEnvHwRegionSize=65536, vBaseEnvHwRegionStartAddress=4280287232
            CodeFlash_Ext: vBaseEnvHwRegionSize=32768, vBaseEnvHwRegionStartAddress=16777216
            RetentionRAM: vBaseEnvHwRegionSize=16384, vBaseEnvHwRegionStartAddress=1070481408, vBaseEnvHwRegionEccAlignment=4
          vBaseEnvClockSettings: vBaseEnvOscClock=16000000, vBaseEnvPeriphClock=60000000, vBaseEnvTimebaseClock=120000000
        RH850_1408: vBaseEnvCpuMaxFrequency=240000000, vBaseEnvAvailableChannels_Flexray=0, vBaseEnvAvailableChannels_Can=3, vBaseEnvAvailableChannels_Lin=4, vBaseEnvAvailableChannels_Ethernet=1, vBaseEnvCpuCoreAmount=1, vBaseEnvTestedDerivative=RH850_1408, vBaseEnvTestedDerivativeDescription=Renesas RH850 D1M Family R7F701408, vBaseEnvCpuCore=G3M
          vBaseEnvAdditionalParameters: vBaseEnvClockGroup=A1, vBaseEnvDerivativeGroup=D1M, vBaseEnvPllGroup=A2, vBaseEnvProtectionGroup=A, vBaseEnvPortGroup=C, vBaseEnvResetGroup=A
          5 x vBaseEnvMemLayoutHwRegion:
            CodeFlash_A: vBaseEnvHwRegionSize=3932160, vBaseEnvHwRegionStartAddress=0
            LocalRAM_CPU0: vBaseEnvHwRegionSize=524288, vBaseEnvHwRegionStartAddress=4273471488, vBaseEnvHwRegionEccAlignment=4
            DataFlash: vBaseEnvHwRegionSize=65536, vBaseEnvHwRegionStartAddress=4280287232
            CodeFlash_Ext: vBaseEnvHwRegionSize=32768, vBaseEnvHwRegionStartAddress=16777216
            RetentionRAM: vBaseEnvHwRegionSize=16384, vBaseEnvHwRegionStartAddress=1070481408, vBaseEnvHwRegionEccAlignment=4
          vBaseEnvClockSettings: vBaseEnvOscClock=16000000, vBaseEnvPeriphClock=60000000, vBaseEnvTimebaseClock=120000000
        RH850_1411: vBaseEnvCpuMaxFrequency=240000000, vBaseEnvAvailableChannels_Flexray=0, vBaseEnvAvailableChannels_Can=3, vBaseEnvAvailableChannels_Lin=4, vBaseEnvAvailableChannels_Ethernet=1, vBaseEnvCpuCoreAmount=1, vBaseEnvTestedDerivative=RH850_1411, vBaseEnvTestedDerivativeDescription=Renesas RH850 D1M Family R7F701411, vBaseEnvCpuCore=G3M
          vBaseEnvAdditionalParameters: vBaseEnvClockGroup=A1, vBaseEnvDerivativeGroup=D1M, vBaseEnvPllGroup=A2, vBaseEnvProtectionGroup=A, vBaseEnvPortGroup=C, vBaseEnvResetGroup=A
          5 x vBaseEnvMemLayoutHwRegion:
            CodeFlash_A: vBaseEnvHwRegionSize=3932160, vBaseEnvHwRegionStartAddress=0
            LocalRAM_CPU0: vBaseEnvHwRegionSize=524288, vBaseEnvHwRegionStartAddress=4273471488, vBaseEnvHwRegionEccAlignment=4
            DataFlash: vBaseEnvHwRegionSize=65536, vBaseEnvHwRegionStartAddress=4280287232
            CodeFlash_Ext: vBaseEnvHwRegionSize=32768, vBaseEnvHwRegionStartAddress=16777216
            RetentionRAM: vBaseEnvHwRegionSize=16384, vBaseEnvHwRegionStartAddress=1070481408, vBaseEnvHwRegionEccAlignment=4
          vBaseEnvClockSettings: vBaseEnvOscClock=16000000, vBaseEnvPeriphClock=60000000, vBaseEnvTimebaseClock=120000000
        RH850_1412: vBaseEnvCpuMaxFrequency=240000000, vBaseEnvAvailableChannels_Flexray=0, vBaseEnvAvailableChannels_Can=3, vBaseEnvAvailableChannels_Lin=4, vBaseEnvAvailableChannels_Ethernet=1, vBaseEnvCpuCoreAmount=1, vBaseEnvTestedDerivative=RH850_1412, vBaseEnvTestedDerivativeDescription=Renesas RH850 D1M Family R7F701412, vBaseEnvCpuCore=G3M
          vBaseEnvAdditionalParameters: vBaseEnvClockGroup=A1, vBaseEnvDerivativeGroup=D1M, vBaseEnvPllGroup=A2, vBaseEnvProtectionGroup=A, vBaseEnvPortGroup=C, vBaseEnvResetGroup=A
          5 x vBaseEnvMemLayoutHwRegion:
            CodeFlash_A: vBaseEnvHwRegionSize=5242880, vBaseEnvHwRegionStartAddress=0
            LocalRAM_CPU0: vBaseEnvHwRegionSize=524288, vBaseEnvHwRegionStartAddress=4273471488, vBaseEnvHwRegionEccAlignment=4
            DataFlash: vBaseEnvHwRegionSize=65536, vBaseEnvHwRegionStartAddress=4280287232
            CodeFlash_Ext: vBaseEnvHwRegionSize=32768, vBaseEnvHwRegionStartAddress=16777216
            RetentionRAM: vBaseEnvHwRegionSize=16384, vBaseEnvHwRegionStartAddress=1070481408, vBaseEnvHwRegionEccAlignment=4
          vBaseEnvClockSettings: vBaseEnvOscClock=16000000, vBaseEnvPeriphClock=60000000, vBaseEnvTimebaseClock=120000000
        RH850_1417: vBaseEnvCpuMaxFrequency=120000000, vBaseEnvAvailableChannels_Flexray=0, vBaseEnvAvailableChannels_Can=3, vBaseEnvAvailableChannels_Lin=4, vBaseEnvAvailableChannels_Ethernet=1, vBaseEnvCpuCoreAmount=1, vBaseEnvTestedDerivative=RH850_1417, vBaseEnvTestedDerivativeDescription=Renesas RH850 D1M Family R7F701417, vBaseEnvCpuCore=G3M
          vBaseEnvAdditionalParameters: vBaseEnvClockGroup=A1, vBaseEnvDerivativeGroup=D1M, vBaseEnvPllGroup=A2, vBaseEnvProtectionGroup=A, vBaseEnvPortGroup=C, vBaseEnvResetGroup=A
          5 x vBaseEnvMemLayoutHwRegion:
            CodeFlash_A: vBaseEnvHwRegionSize=1048576, vBaseEnvHwRegionStartAddress=0
            LocalRAM_CPU0: vBaseEnvHwRegionSize=131072, vBaseEnvHwRegionStartAddress=4273471488, vBaseEnvHwRegionEccAlignment=4
            DataFlash: vBaseEnvHwRegionSize=32768, vBaseEnvHwRegionStartAddress=4280287232
            CodeFlash_Ext: vBaseEnvHwRegionSize=32768, vBaseEnvHwRegionStartAddress=16777216
            RetentionRAM: vBaseEnvHwRegionSize=16384, vBaseEnvHwRegionStartAddress=1070481408, vBaseEnvHwRegionEccAlignment=4
          vBaseEnvClockSettings: vBaseEnvOscClock=16000000, vBaseEnvPeriphClock=60000000, vBaseEnvTimebaseClock=120000000
        RH850_1421: vBaseEnvCpuMaxFrequency=120000000, vBaseEnvAvailableChannels_Flexray=0, vBaseEnvAvailableChannels_Can=3, vBaseEnvAvailableChannels_Lin=4, vBaseEnvAvailableChannels_Ethernet=0, vBaseEnvCpuCoreAmount=1, vBaseEnvTestedDerivative=RH850_1401, vBaseEnvTestedDerivativeDescription=Renesas RH850 D1L Family R7F701401, vBaseEnvCpuCore=G3M
          vBaseEnvAdditionalParameters: vBaseEnvClockGroup=A1, vBaseEnvDerivativeGroup=D1L, vBaseEnvPllGroup=A2, vBaseEnvProtectionGroup=A, vBaseEnvPortGroup=C, vBaseEnvResetGroup=A
          5 x vBaseEnvMemLayoutHwRegion:
            CodeFlash_A: vBaseEnvHwRegionSize=2097152, vBaseEnvHwRegionStartAddress=0
            LocalRAM_CPU0: vBaseEnvHwRegionSize=262144, vBaseEnvHwRegionStartAddress=4273733632, vBaseEnvHwRegionEccAlignment=4
            DataFlash: vBaseEnvHwRegionSize=65536, vBaseEnvHwRegionStartAddress=4280287232
            CodeFlash_Ext: vBaseEnvHwRegionSize=32768, vBaseEnvHwRegionStartAddress=16777216
            RetentionRAM: vBaseEnvHwRegionSize=16384, vBaseEnvHwRegionStartAddress=1070481408, vBaseEnvHwRegionEccAlignment=4
          vBaseEnvClockSettings: vBaseEnvOscClock=16000000, vBaseEnvPeriphClock=60000000, vBaseEnvTimebaseClock=120000000
        RH850_1428: vBaseEnvCpuMaxFrequency=240000000, vBaseEnvAvailableChannels_Flexray=0, vBaseEnvAvailableChannels_Can=3, vBaseEnvAvailableChannels_Lin=4, vBaseEnvAvailableChannels_Ethernet=1, vBaseEnvCpuCoreAmount=1, vBaseEnvTestedDerivative=RH850_1428, vBaseEnvTestedDerivativeDescription=Renesas RH850 D1M Family R7F701428, vBaseEnvCpuCore=G3M
          vBaseEnvAdditionalParameters: vBaseEnvClockGroup=A1, vBaseEnvDerivativeGroup=D1M, vBaseEnvPllGroup=A2, vBaseEnvProtectionGroup=A, vBaseEnvPortGroup=C, vBaseEnvResetGroup=A
          5 x vBaseEnvMemLayoutHwRegion:
            CodeFlash_A: vBaseEnvHwRegionSize=3932160, vBaseEnvHwRegionStartAddress=0
            LocalRAM_CPU0: vBaseEnvHwRegionSize=524288, vBaseEnvHwRegionStartAddress=4273471488, vBaseEnvHwRegionEccAlignment=4
            DataFlash: vBaseEnvHwRegionSize=65536, vBaseEnvHwRegionStartAddress=4280287232
            CodeFlash_Ext: vBaseEnvHwRegionSize=32768, vBaseEnvHwRegionStartAddress=16777216
            RetentionRAM: vBaseEnvHwRegionSize=16384, vBaseEnvHwRegionStartAddress=1070481408, vBaseEnvHwRegionEccAlignment=4
          vBaseEnvClockSettings: vBaseEnvOscClock=16000000, vBaseEnvPeriphClock=60000000, vBaseEnvTimebaseClock=120000000
        RH850_1432: vBaseEnvCpuMaxFrequency=240000000, vBaseEnvAvailableChannels_Flexray=0, vBaseEnvAvailableChannels_Can=3, vBaseEnvAvailableChannels_Lin=4, vBaseEnvAvailableChannels_Ethernet=1, vBaseEnvCpuCoreAmount=1, vBaseEnvTestedDerivative=RH850_1432, vBaseEnvTestedDerivativeDescription=Renesas RH850 D1M Family R7F701432, vBaseEnvCpuCore=G3M
          vBaseEnvAdditionalParameters: vBaseEnvClockGroup=A1, vBaseEnvDerivativeGroup=D1M, vBaseEnvPllGroup=A2, vBaseEnvProtectionGroup=A, vBaseEnvPortGroup=C, vBaseEnvResetGroup=A
          5 x vBaseEnvMemLayoutHwRegion:
            CodeFlash_A: vBaseEnvHwRegionSize=5242880, vBaseEnvHwRegionStartAddress=0
            LocalRAM_CPU0: vBaseEnvHwRegionSize=524288, vBaseEnvHwRegionStartAddress=4273471488, vBaseEnvHwRegionEccAlignment=4
            DataFlash: vBaseEnvHwRegionSize=65536, vBaseEnvHwRegionStartAddress=4280287232
            CodeFlash_Ext: vBaseEnvHwRegionSize=32768, vBaseEnvHwRegionStartAddress=16777216
            RetentionRAM: vBaseEnvHwRegionSize=16384, vBaseEnvHwRegionStartAddress=1070481408, vBaseEnvHwRegionEccAlignment=4
          vBaseEnvClockSettings: vBaseEnvOscClock=16000000, vBaseEnvPeriphClock=60000000, vBaseEnvTimebaseClock=120000000
        RH850_1437: vBaseEnvCpuMaxFrequency=120000000, vBaseEnvAvailableChannels_Flexray=0, vBaseEnvAvailableChannels_Can=3, vBaseEnvAvailableChannels_Lin=4, vBaseEnvAvailableChannels_Ethernet=1, vBaseEnvCpuCoreAmount=1, vBaseEnvTestedDerivative=RH850_1437, vBaseEnvTestedDerivativeDescription=Renesas RH850 D1M Family R7F701437, vBaseEnvCpuCore=G3M
          vBaseEnvAdditionalParameters: vBaseEnvClockGroup=A1, vBaseEnvDerivativeGroup=D1M, vBaseEnvPllGroup=A2, vBaseEnvProtectionGroup=A, vBaseEnvPortGroup=C, vBaseEnvResetGroup=A
          5 x vBaseEnvMemLayoutHwRegion:
            CodeFlash_A: vBaseEnvHwRegionSize=1048576, vBaseEnvHwRegionStartAddress=0
            LocalRAM_CPU0: vBaseEnvHwRegionSize=131072, vBaseEnvHwRegionStartAddress=4273471488, vBaseEnvHwRegionEccAlignment=4
            DataFlash: vBaseEnvHwRegionSize=32768, vBaseEnvHwRegionStartAddress=4280287232
            CodeFlash_Ext: vBaseEnvHwRegionSize=32768, vBaseEnvHwRegionStartAddress=16777216
            RetentionRAM: vBaseEnvHwRegionSize=16384, vBaseEnvHwRegionStartAddress=1070481408, vBaseEnvHwRegionEccAlignment=4
          vBaseEnvClockSettings: vBaseEnvOscClock=16000000, vBaseEnvPeriphClock=60000000, vBaseEnvTimebaseClock=120000000
        RH850_1441: vBaseEnvCpuMaxFrequency=240000000, vBaseEnvAvailableChannels_Flexray=0, vBaseEnvAvailableChannels_Can=3, vBaseEnvAvailableChannels_Lin=4, vBaseEnvAvailableChannels_Ethernet=1, vBaseEnvCpuCoreAmount=1, vBaseEnvTestedDerivative=RH850_1441, vBaseEnvTestedDerivativeDescription=Renesas RH850 D1M Family R7F701441, vBaseEnvCpuCore=G3M
          vBaseEnvAdditionalParameters: vBaseEnvClockGroup=A1, vBaseEnvDerivativeGroup=D1M, vBaseEnvPllGroup=A5, vBaseEnvProtectionGroup=A, vBaseEnvPortGroup=C, vBaseEnvResetGroup=A
          5 x vBaseEnvMemLayoutHwRegion:
            CodeFlash_A: vBaseEnvHwRegionSize=4194304, vBaseEnvHwRegionStartAddress=0
            LocalRAM_CPU0: vBaseEnvHwRegionSize=524288, vBaseEnvHwRegionStartAddress=4273471488, vBaseEnvHwRegionEccAlignment=4
            DataFlash: vBaseEnvHwRegionSize=65536, vBaseEnvHwRegionStartAddress=4280287232
            CodeFlash_Ext: vBaseEnvHwRegionSize=32768, vBaseEnvHwRegionStartAddress=16777216
            RetentionRAM: vBaseEnvHwRegionSize=16384, vBaseEnvHwRegionStartAddress=1070481408, vBaseEnvHwRegionEccAlignment=4
          vBaseEnvClockSettings: vBaseEnvOscClock=16000000, vBaseEnvPeriphClock=60000000, vBaseEnvTimebaseClock=120000000
        RH850_1442: vBaseEnvCpuMaxFrequency=160000000, vBaseEnvAvailableChannels_Flexray=0, vBaseEnvAvailableChannels_Can=3, vBaseEnvAvailableChannels_Lin=4, vBaseEnvAvailableChannels_Ethernet=1, vBaseEnvCpuCoreAmount=1, vBaseEnvTestedDerivative=RH850_1442, vBaseEnvTestedDerivativeDescription=Renesas RH850 D1M1-V2 Family R7F701442, vBaseEnvCpuCore=G3M
          vBaseEnvAdditionalParameters: vBaseEnvClockGroup=A1, vBaseEnvDerivativeGroup=D1M, vBaseEnvPllGroup=A5, vBaseEnvProtectionGroup=A, vBaseEnvPortGroup=C, vBaseEnvResetGroup=A
          5 x vBaseEnvMemLayoutHwRegion:
            CodeFlash_A: vBaseEnvHwRegionSize=4194304, vBaseEnvHwRegionStartAddress=0
            LocalRAM_CPU0: vBaseEnvHwRegionSize=524288, vBaseEnvHwRegionStartAddress=4273471488, vBaseEnvHwRegionEccAlignment=4
            DataFlash: vBaseEnvHwRegionSize=65536, vBaseEnvHwRegionStartAddress=4280287232
            CodeFlash_Ext: vBaseEnvHwRegionSize=32768, vBaseEnvHwRegionStartAddress=16777216
            RetentionRAM: vBaseEnvHwRegionSize=16384, vBaseEnvHwRegionStartAddress=1070481408, vBaseEnvHwRegionEccAlignment=4
          vBaseEnvClockSettings: vBaseEnvOscClock=16000000, vBaseEnvPeriphClock=60000000, vBaseEnvTimebaseClock=120000000
        RH850_1461: vBaseEnvCpuMaxFrequency=200000000, vBaseEnvAvailableChannels_Flexray=0, vBaseEnvAvailableChannels_Can=3, vBaseEnvAvailableChannels_Lin=4, vBaseEnvAvailableChannels_Ethernet=1, vBaseEnvCpuCoreAmount=1, vBaseEnvTestedDerivative=RH850_1461, vBaseEnvTestedDerivativeDescription=Renesas RH850 D1M Family R7F701461, vBaseEnvCpuCore=G3M
          vBaseEnvAdditionalParameters: vBaseEnvClockGroup=A1, vBaseEnvDerivativeGroup=D1M, vBaseEnvPllGroup=A5, vBaseEnvProtectionGroup=A, vBaseEnvPortGroup=C, vBaseEnvResetGroup=A
          5 x vBaseEnvMemLayoutHwRegion:
            CodeFlash_A: vBaseEnvHwRegionSize=4194304, vBaseEnvHwRegionStartAddress=0
            LocalRAM_CPU0: vBaseEnvHwRegionSize=524288, vBaseEnvHwRegionStartAddress=4273471488, vBaseEnvHwRegionEccAlignment=4
            DataFlash: vBaseEnvHwRegionSize=65536, vBaseEnvHwRegionStartAddress=4280287232
            CodeFlash_Ext: vBaseEnvHwRegionSize=32768, vBaseEnvHwRegionStartAddress=16777216
            RetentionRAM: vBaseEnvHwRegionSize=16384, vBaseEnvHwRegionStartAddress=1070481408, vBaseEnvHwRegionEccAlignment=4
          vBaseEnvClockSettings: vBaseEnvOscClock=16000000, vBaseEnvPeriphClock=60000000, vBaseEnvTimebaseClock=120000000
        RH850_1462: vBaseEnvCpuMaxFrequency=160000000, vBaseEnvAvailableChannels_Flexray=0, vBaseEnvAvailableChannels_Can=3, vBaseEnvAvailableChannels_Lin=4, vBaseEnvAvailableChannels_Ethernet=1, vBaseEnvCpuCoreAmount=1, vBaseEnvTestedDerivative=RH850_1462, vBaseEnvTestedDerivativeDescription=Renesas RH850 D1M Family R7F701462, vBaseEnvCpuCore=G3M
          vBaseEnvAdditionalParameters: vBaseEnvClockGroup=A1, vBaseEnvDerivativeGroup=D1M, vBaseEnvPllGroup=A5, vBaseEnvProtectionGroup=A, vBaseEnvPortGroup=C, vBaseEnvResetGroup=A
          5 x vBaseEnvMemLayoutHwRegion:
            CodeFlash_A: vBaseEnvHwRegionSize=4194304, vBaseEnvHwRegionStartAddress=0
            LocalRAM_CPU0: vBaseEnvHwRegionSize=524288, vBaseEnvHwRegionStartAddress=4273471488, vBaseEnvHwRegionEccAlignment=4
            DataFlash: vBaseEnvHwRegionSize=65536, vBaseEnvHwRegionStartAddress=4280287232
            CodeFlash_Ext: vBaseEnvHwRegionSize=32768, vBaseEnvHwRegionStartAddress=16777216
            RetentionRAM: vBaseEnvHwRegionSize=16384, vBaseEnvHwRegionStartAddress=1070481408, vBaseEnvHwRegionEccAlignment=4
          vBaseEnvClockSettings: vBaseEnvOscClock=16000000, vBaseEnvPeriphClock=60000000, vBaseEnvTimebaseClock=120000000
        RH850_1201: vBaseEnvCpuMaxFrequency=240000000, vBaseEnvAvailableChannels_Flexray=0, vBaseEnvAvailableChannels_Can=4, vBaseEnvAvailableChannels_Lin=1, vBaseEnvAvailableChannels_Ethernet=0, vBaseEnvCpuCoreAmount=1, vBaseEnvTestedDerivative=RH850_1201, vBaseEnvTestedDerivativeDescription=Renesas RH850 E1L Family R7F701201, vBaseEnvCpuCore=G3M
          vBaseEnvAdditionalParameters: vBaseEnvClockGroup=C, vBaseEnvDerivativeGroup=E1L, vBaseEnvPllGroup=C, vBaseEnvProtectionGroup=B, vBaseEnvPortGroup=D, vBaseEnvResetGroup=B
          8 x vBaseEnvMemLayoutHwRegion:
            CodeFlash_A: vBaseEnvHwRegionSize=2097152, vBaseEnvHwRegionStartAddress=0
            LocalRAM_CPU0: vBaseEnvHwRegionSize=49152, vBaseEnvHwRegionStartAddress=4273946624, vBaseEnvHwRegionEccAlignment=4
            DataFlash: vBaseEnvHwRegionSize=65536, vBaseEnvHwRegionStartAddress=4280287232
            RetentionRAM: vBaseEnvHwRegionSize=32768, vBaseEnvHwRegionStartAddress=4277108736, vBaseEnvHwRegionEccAlignment=4
            FCU_RAM: vBaseEnvHwRegionSize=4096, vBaseEnvHwRegionStartAddress=4288749568, vBaseEnvHwRegionEccAlignment=4
            LocalRAM_Self: vBaseEnvHwRegionSize=49152, vBaseEnvHwRegionStartAddress=4273946624, vBaseEnvHwRegionEccAlignment=4
            GlobalRAM_A: vBaseEnvHwRegionSize=65536, vBaseEnvHwRegionStartAddress=4277075968, vBaseEnvHwRegionEccAlignment=4
            GlobalRAM_B: vBaseEnvHwRegionSize=49152, vBaseEnvHwRegionStartAddress=4277141504, vBaseEnvHwRegionEccAlignment=4
          vBaseEnvClockSettings: vBaseEnvOscClock=20000000, vBaseEnvPeriphClock=80000000, vBaseEnvTimebaseClock=120000000
        RH850_1202: vBaseEnvCpuMaxFrequency=320000000, vBaseEnvAvailableChannels_Flexray=2, vBaseEnvAvailableChannels_Can=4, vBaseEnvAvailableChannels_Lin=1, vBaseEnvAvailableChannels_Ethernet=0, vBaseEnvCpuCoreAmount=1, vBaseEnvTestedDerivative=RH850_1202, vBaseEnvTestedDerivativeDescription=Renesas RH850 E1M Family R7F701202, vBaseEnvCpuCore=G3M
          vBaseEnvAdditionalParameters: vBaseEnvClockGroup=C, vBaseEnvDerivativeGroup=E1M, vBaseEnvPllGroup=C, vBaseEnvProtectionGroup=B, vBaseEnvPortGroup=D, vBaseEnvResetGroup=B
          8 x vBaseEnvMemLayoutHwRegion:
            CodeFlash_A: vBaseEnvHwRegionSize=4194304, vBaseEnvHwRegionStartAddress=0
            LocalRAM_CPU0: vBaseEnvHwRegionSize=65536, vBaseEnvHwRegionStartAddress=4273930240, vBaseEnvHwRegionEccAlignment=4
            DataFlash: vBaseEnvHwRegionSize=65536, vBaseEnvHwRegionStartAddress=4280287232
            RetentionRAM: vBaseEnvHwRegionSize=32768, vBaseEnvHwRegionStartAddress=4277108736, vBaseEnvHwRegionEccAlignment=4
            FCU_RAM: vBaseEnvHwRegionSize=4096, vBaseEnvHwRegionStartAddress=4288749568, vBaseEnvHwRegionEccAlignment=4
            LocalRAM_Self: vBaseEnvHwRegionSize=65536, vBaseEnvHwRegionStartAddress=4276027392, vBaseEnvHwRegionEccAlignment=4
            GlobalRAM_A: vBaseEnvHwRegionSize=131072, vBaseEnvHwRegionStartAddress=4277010432, vBaseEnvHwRegionEccAlignment=4
            GlobalRAM_B: vBaseEnvHwRegionSize=131072, vBaseEnvHwRegionStartAddress=4277141504, vBaseEnvHwRegionEccAlignment=4
          vBaseEnvClockSettings: vBaseEnvOscClock=20000000, vBaseEnvPeriphClock=80000000, vBaseEnvTimebaseClock=120000000
        RH850_1204: vBaseEnvCpuMaxFrequency=240000000, vBaseEnvAvailableChannels_Flexray=2, vBaseEnvAvailableChannels_Can=4, vBaseEnvAvailableChannels_Lin=1, vBaseEnvAvailableChannels_Ethernet=0, vBaseEnvCpuCoreAmount=1, vBaseEnvTestedDerivative=RH850_1204, vBaseEnvTestedDerivativeDescription=Renesas RH850 E1M Family R7F701204, vBaseEnvCpuCore=G3M
          vBaseEnvAdditionalParameters: vBaseEnvClockGroup=C, vBaseEnvDerivativeGroup=E1M, vBaseEnvPllGroup=C, vBaseEnvProtectionGroup=B, vBaseEnvPortGroup=D, vBaseEnvResetGroup=B
          8 x vBaseEnvMemLayoutHwRegion:
            CodeFlash_A: vBaseEnvHwRegionSize=4194304, vBaseEnvHwRegionStartAddress=0
            LocalRAM_CPU0: vBaseEnvHwRegionSize=262144, vBaseEnvHwRegionStartAddress=4273930240, vBaseEnvHwRegionEccAlignment=4
            DataFlash: vBaseEnvHwRegionSize=65536, vBaseEnvHwRegionStartAddress=4280287232
            RetentionRAM: vBaseEnvHwRegionSize=32768, vBaseEnvHwRegionStartAddress=4277108736, vBaseEnvHwRegionEccAlignment=4
            FCU_RAM: vBaseEnvHwRegionSize=4096, vBaseEnvHwRegionStartAddress=4288749568, vBaseEnvHwRegionEccAlignment=4
            GlobalRAM_A: vBaseEnvHwRegionSize=131072, vBaseEnvHwRegionStartAddress=4277010432, vBaseEnvHwRegionEccAlignment=4
            GlobalRAM_B: vBaseEnvHwRegionSize=131072, vBaseEnvHwRegionStartAddress=4277141504, vBaseEnvHwRegionEccAlignment=4
            LocalRAM_Self: vBaseEnvHwRegionSize=65536, vBaseEnvHwRegionStartAddress=4276027392, vBaseEnvHwRegionEccAlignment=4
          vBaseEnvClockSettings: vBaseEnvOscClock=20000000, vBaseEnvPeriphClock=80000000, vBaseEnvTimebaseClock=120000000
        RH850_1205: vBaseEnvCpuMaxFrequency=160000000, vBaseEnvAvailableChannels_Flexray=0, vBaseEnvAvailableChannels_Can=4, vBaseEnvAvailableChannels_Lin=1, vBaseEnvAvailableChannels_Ethernet=0, vBaseEnvCpuCoreAmount=1, vBaseEnvTestedDerivative=RH850_1205, vBaseEnvTestedDerivativeDescription=Renesas RH850 E1L Family R7F701205, vBaseEnvCpuCore=G3M
          vBaseEnvAdditionalParameters: vBaseEnvClockGroup=C, vBaseEnvDerivativeGroup=E1L, vBaseEnvPllGroup=C, vBaseEnvProtectionGroup=B, vBaseEnvPortGroup=D, vBaseEnvResetGroup=B
          8 x vBaseEnvMemLayoutHwRegion:
            CodeFlash_A: vBaseEnvHwRegionSize=2097152, vBaseEnvHwRegionStartAddress=0
            LocalRAM_CPU0: vBaseEnvHwRegionSize=49152, vBaseEnvHwRegionStartAddress=4273946624, vBaseEnvHwRegionEccAlignment=4
            DataFlash: vBaseEnvHwRegionSize=65536, vBaseEnvHwRegionStartAddress=4280287232
            RetentionRAM: vBaseEnvHwRegionSize=32768, vBaseEnvHwRegionStartAddress=4277108736, vBaseEnvHwRegionEccAlignment=4
            FCU_RAM: vBaseEnvHwRegionSize=4096, vBaseEnvHwRegionStartAddress=4288749568, vBaseEnvHwRegionEccAlignment=4
            GlobalRAM_A: vBaseEnvHwRegionSize=65536, vBaseEnvHwRegionStartAddress=4277075968, vBaseEnvHwRegionEccAlignment=4
            GlobalRAM_B: vBaseEnvHwRegionSize=49152, vBaseEnvHwRegionStartAddress=4277141504, vBaseEnvHwRegionEccAlignment=4
            LocalRAM_Self: vBaseEnvHwRegionSize=49152, vBaseEnvHwRegionStartAddress=4273946624, vBaseEnvHwRegionEccAlignment=4
          vBaseEnvClockSettings: vBaseEnvOscClock=20000000, vBaseEnvPeriphClock=80000000, vBaseEnvTimebaseClock=120000000
        RH850_1216: vBaseEnvCpuMaxFrequency=320000000, vBaseEnvAvailableChannels_Flexray=2, vBaseEnvAvailableChannels_Can=4, vBaseEnvAvailableChannels_Lin=1, vBaseEnvAvailableChannels_Ethernet=0, vBaseEnvCpuCoreAmount=1, vBaseEnvTestedDerivative=RH850_1216, vBaseEnvTestedDerivativeDescription=Renesas RH850 E1M Family R7F701216, vBaseEnvCpuCore=G3M
          vBaseEnvAdditionalParameters: vBaseEnvClockGroup=C, vBaseEnvDerivativeGroup=E1M, vBaseEnvPllGroup=C, vBaseEnvProtectionGroup=B, vBaseEnvPortGroup=D, vBaseEnvResetGroup=B
          8 x vBaseEnvMemLayoutHwRegion:
            CodeFlash_A: vBaseEnvHwRegionSize=4194304, vBaseEnvHwRegionStartAddress=0
            LocalRAM_CPU0: vBaseEnvHwRegionSize=65536, vBaseEnvHwRegionStartAddress=4273930240, vBaseEnvHwRegionEccAlignment=4
            DataFlash: vBaseEnvHwRegionSize=65536, vBaseEnvHwRegionStartAddress=4280287232
            RetentionRAM: vBaseEnvHwRegionSize=32768, vBaseEnvHwRegionStartAddress=4277108736, vBaseEnvHwRegionEccAlignment=4
            FCU_RAM: vBaseEnvHwRegionSize=4096, vBaseEnvHwRegionStartAddress=4288749568, vBaseEnvHwRegionEccAlignment=4
            GlobalRAM_A: vBaseEnvHwRegionSize=131072, vBaseEnvHwRegionStartAddress=4277010432, vBaseEnvHwRegionEccAlignment=4
            GlobalRAM_B: vBaseEnvHwRegionSize=131072, vBaseEnvHwRegionStartAddress=4277141504, vBaseEnvHwRegionEccAlignment=4
            LocalRAM_Self: vBaseEnvHwRegionSize=65536, vBaseEnvHwRegionStartAddress=4276027392, vBaseEnvHwRegionEccAlignment=4
          vBaseEnvClockSettings: vBaseEnvOscClock=20000000, vBaseEnvPeriphClock=80000000, vBaseEnvTimebaseClock=120000000
        RH850_1Z11: vBaseEnvCpuMaxFrequency=240000000, vBaseEnvAvailableChannels_Flexray=2, vBaseEnvAvailableChannels_Can=4, vBaseEnvAvailableChannels_Lin=1, vBaseEnvAvailableChannels_Ethernet=0, vBaseEnvCpuCoreAmount=2, vBaseEnvTestedDerivative=RH850_1Z11, vBaseEnvTestedDerivativeDescription=Renesas RH850 E1FCC Family R7F701Z11, vBaseEnvCpuCore=G3M
          vBaseEnvAdditionalParameters: vBaseEnvClockGroup=C, vBaseEnvDerivativeGroup=E1FCC, vBaseEnvPllGroup=C, vBaseEnvProtectionGroup=B, vBaseEnvPortGroup=D, vBaseEnvResetGroup=B
          8 x vBaseEnvMemLayoutHwRegion:
            CodeFlash_A: vBaseEnvHwRegionSize=4194304, vBaseEnvHwRegionStartAddress=0
            LocalRAM_CPU0: vBaseEnvHwRegionSize=65536, vBaseEnvHwRegionStartAddress=4273930240, vBaseEnvHwRegionEccAlignment=4
            DataFlash: vBaseEnvHwRegionSize=65536, vBaseEnvHwRegionStartAddress=4280287232
            RetentionRAM: vBaseEnvHwRegionSize=32768, vBaseEnvHwRegionStartAddress=4277108736, vBaseEnvHwRegionEccAlignment=4
            FCU_RAM: vBaseEnvHwRegionSize=4096, vBaseEnvHwRegionStartAddress=4288749568, vBaseEnvHwRegionEccAlignment=4
            LocalRAM_Self: vBaseEnvHwRegionSize=65536, vBaseEnvHwRegionStartAddress=4276027392, vBaseEnvHwRegionEccAlignment=4
            GlobalRAM_A: vBaseEnvHwRegionSize=131072, vBaseEnvHwRegionStartAddress=4277010432, vBaseEnvHwRegionEccAlignment=4
            GlobalRAM_B: vBaseEnvHwRegionSize=131072, vBaseEnvHwRegionStartAddress=4277141504, vBaseEnvHwRegionEccAlignment=4
          vBaseEnvClockSettings: vBaseEnvOscClock=20000000, vBaseEnvPeriphClock=80000000, vBaseEnvTimebaseClock=120000000
        RH850_1Z12: vBaseEnvCpuMaxFrequency=320000000, vBaseEnvAvailableChannels_Flexray=2, vBaseEnvAvailableChannels_Can=4, vBaseEnvAvailableChannels_Lin=1, vBaseEnvAvailableChannels_Ethernet=0, vBaseEnvCpuCoreAmount=2, vBaseEnvTestedDerivative=RH850_1Z12, vBaseEnvTestedDerivativeDescription=Renesas RH850 E1FCC Family R7F701Z12, vBaseEnvCpuCore=G3M
          vBaseEnvAdditionalParameters: vBaseEnvClockGroup=C, vBaseEnvDerivativeGroup=E1FCC, vBaseEnvPllGroup=C, vBaseEnvProtectionGroup=B, vBaseEnvPortGroup=D, vBaseEnvResetGroup=B
          8 x vBaseEnvMemLayoutHwRegion:
            CodeFlash_A: vBaseEnvHwRegionSize=4194304, vBaseEnvHwRegionStartAddress=0
            LocalRAM_CPU0: vBaseEnvHwRegionSize=65536, vBaseEnvHwRegionStartAddress=4273930240, vBaseEnvHwRegionEccAlignment=4
            DataFlash: vBaseEnvHwRegionSize=65536, vBaseEnvHwRegionStartAddress=4280287232
            RetentionRAM: vBaseEnvHwRegionSize=32768, vBaseEnvHwRegionStartAddress=4277108736, vBaseEnvHwRegionEccAlignment=4
            FCU_RAM: vBaseEnvHwRegionSize=4096, vBaseEnvHwRegionStartAddress=4288749568, vBaseEnvHwRegionEccAlignment=4
            LocalRAM_Self: vBaseEnvHwRegionSize=65536, vBaseEnvHwRegionStartAddress=4276027392, vBaseEnvHwRegionEccAlignment=4
            GlobalRAM_A: vBaseEnvHwRegionSize=131072, vBaseEnvHwRegionStartAddress=4277010432, vBaseEnvHwRegionEccAlignment=4
            GlobalRAM_B: vBaseEnvHwRegionSize=131072, vBaseEnvHwRegionStartAddress=4277141504, vBaseEnvHwRegionEccAlignment=4
          vBaseEnvClockSettings: vBaseEnvOscClock=20000000, vBaseEnvPeriphClock=80000000, vBaseEnvTimebaseClock=120000000
        RH850_1501: vBaseEnvCpuMaxFrequency=120000000, vBaseEnvAvailableChannels_Flexray=2, vBaseEnvAvailableChannels_Can=7, vBaseEnvAvailableChannels_Lin=16, vBaseEnvAvailableChannels_Ethernet=1, vBaseEnvCpuCoreAmount=2, vBaseEnvTestedDerivative=RH850_1501, vBaseEnvTestedDerivativeDescription=Renesas RH850 F1H Family R7F701501, vBaseEnvCpuCore=G3M
          vBaseEnvAdditionalParameters: vBaseEnvClockGroup=A, vBaseEnvDerivativeGroup=F1H, vBaseEnvPllGroup=A1, vBaseEnvProtectionGroup=A, vBaseEnvPortGroup=A, vBaseEnvResetGroup=A
          11 x vBaseEnvMemLayoutHwRegion:
            CodeFlash_A: vBaseEnvHwRegionSize=1572864, vBaseEnvHwRegionStartAddress=0
            CodeFlash_B: vBaseEnvHwRegionSize=1572864, vBaseEnvHwRegionStartAddress=8388608
            LocalRAM_CPU0: vBaseEnvHwRegionSize=114688, vBaseEnvHwRegionStartAddress=4273881088, vBaseEnvHwRegionEccAlignment=4
            LocalRAM_CPU1: vBaseEnvHwRegionSize=114688, vBaseEnvHwRegionStartAddress=4271783936, vBaseEnvHwRegionEccAlignment=4
            GlobalRAM_A: vBaseEnvHwRegionSize=16384, vBaseEnvHwRegionStartAddress=4277125120, vBaseEnvHwRegionEccAlignment=4
            GlobalRAM_B: vBaseEnvHwRegionSize=16384, vBaseEnvHwRegionStartAddress=4278173696, vBaseEnvHwRegionEccAlignment=4
            DataFlash: vBaseEnvHwRegionSize=65536, vBaseEnvHwRegionStartAddress=4280287232
            CodeFlash_Ext: vBaseEnvHwRegionSize=32768, vBaseEnvHwRegionStartAddress=16777216
            RetentionRAM: vBaseEnvHwRegionSize=65536, vBaseEnvHwRegionStartAddress=4277141504, vBaseEnvHwRegionEccAlignment=4
            FCU_RAM: vBaseEnvHwRegionSize=4096, vBaseEnvHwRegionStartAddress=4288749568, vBaseEnvHwRegionEccAlignment=4
            LocalRAM_Self: vBaseEnvHwRegionSize=114688, vBaseEnvHwRegionStartAddress=4275978240, vBaseEnvHwRegionEccAlignment=4
          vBaseEnvClockSettings: vBaseEnvOscClock=16000000, vBaseEnvPeriphClock=50000000, vBaseEnvTimebaseClock=100000000
        RH850_1502: vBaseEnvCpuMaxFrequency=120000000, vBaseEnvAvailableChannels_Flexray=1, vBaseEnvAvailableChannels_Can=7, vBaseEnvAvailableChannels_Lin=16, vBaseEnvAvailableChannels_Ethernet=1, vBaseEnvCpuCoreAmount=2, vBaseEnvTestedDerivative=RH850_1502, vBaseEnvTestedDerivativeDescription=Renesas RH850 F1H Family R7F701502, vBaseEnvCpuCore=G3M
          vBaseEnvAdditionalParameters: vBaseEnvClockGroup=A, vBaseEnvDerivativeGroup=F1H, vBaseEnvPllGroup=A1, vBaseEnvProtectionGroup=A, vBaseEnvPortGroup=A, vBaseEnvResetGroup=A
          11 x vBaseEnvMemLayoutHwRegion:
            CodeFlash_A: vBaseEnvHwRegionSize=2097152, vBaseEnvHwRegionStartAddress=0
            CodeFlash_B: vBaseEnvHwRegionSize=2097152, vBaseEnvHwRegionStartAddress=8388608
            LocalRAM_CPU0: vBaseEnvHwRegionSize=131072, vBaseEnvHwRegionStartAddress=4273864704, vBaseEnvHwRegionEccAlignment=4
            LocalRAM_CPU1: vBaseEnvHwRegionSize=131072, vBaseEnvHwRegionStartAddress=4271767552, vBaseEnvHwRegionEccAlignment=4
            GlobalRAM_A: vBaseEnvHwRegionSize=32768, vBaseEnvHwRegionStartAddress=4277108736, vBaseEnvHwRegionEccAlignment=4
            GlobalRAM_B: vBaseEnvHwRegionSize=32768, vBaseEnvHwRegionStartAddress=4278157312, vBaseEnvHwRegionEccAlignment=4
            DataFlash: vBaseEnvHwRegionSize=65536, vBaseEnvHwRegionStartAddress=4280287232
            CodeFlash_Ext: vBaseEnvHwRegionSize=32768, vBaseEnvHwRegionStartAddress=16777216
            RetentionRAM: vBaseEnvHwRegionSize=65536, vBaseEnvHwRegionStartAddress=4277141504, vBaseEnvHwRegionEccAlignment=4
            FCU_RAM: vBaseEnvHwRegionSize=4096, vBaseEnvHwRegionStartAddress=4288749568, vBaseEnvHwRegionEccAlignment=4
            LocalRAM_Self: vBaseEnvHwRegionSize=131072, vBaseEnvHwRegionStartAddress=4275961856, vBaseEnvHwRegionEccAlignment=4
          vBaseEnvClockSettings: vBaseEnvOscClock=16000000, vBaseEnvPeriphClock=50000000, vBaseEnvTimebaseClock=100000000
        RH850_1503: vBaseEnvCpuMaxFrequency=120000000, vBaseEnvAvailableChannels_Flexray=2, vBaseEnvAvailableChannels_Can=7, vBaseEnvAvailableChannels_Lin=16, vBaseEnvAvailableChannels_Ethernet=1, vBaseEnvCpuCoreAmount=2, vBaseEnvTestedDerivative=RH850_1503, vBaseEnvTestedDerivativeDescription=Renesas RH850 F1H Family R7F701503, vBaseEnvCpuCore=G3M
          vBaseEnvAdditionalParameters: vBaseEnvClockGroup=A, vBaseEnvDerivativeGroup=F1H, vBaseEnvPllGroup=A1, vBaseEnvProtectionGroup=A, vBaseEnvPortGroup=A, vBaseEnvResetGroup=A
          11 x vBaseEnvMemLayoutHwRegion:
            CodeFlash_A: vBaseEnvHwRegionSize=4194304, vBaseEnvHwRegionStartAddress=0
            CodeFlash_B: vBaseEnvHwRegionSize=2097152, vBaseEnvHwRegionStartAddress=8388608
            LocalRAM_CPU0: vBaseEnvHwRegionSize=196608, vBaseEnvHwRegionStartAddress=4273799168, vBaseEnvHwRegionEccAlignment=4
            LocalRAM_CPU1: vBaseEnvHwRegionSize=196608, vBaseEnvHwRegionStartAddress=4271702016, vBaseEnvHwRegionEccAlignment=4
            GlobalRAM_A: vBaseEnvHwRegionSize=32768, vBaseEnvHwRegionStartAddress=4277108736, vBaseEnvHwRegionEccAlignment=4
            GlobalRAM_B: vBaseEnvHwRegionSize=32768, vBaseEnvHwRegionStartAddress=4278157312, vBaseEnvHwRegionEccAlignment=4
            DataFlash: vBaseEnvHwRegionSize=65536, vBaseEnvHwRegionStartAddress=4280287232
            CodeFlash_Ext: vBaseEnvHwRegionSize=32768, vBaseEnvHwRegionStartAddress=16777216
            RetentionRAM: vBaseEnvHwRegionSize=131072, vBaseEnvHwRegionStartAddress=4277141504, vBaseEnvHwRegionEccAlignment=4
            FCU_RAM: vBaseEnvHwRegionSize=4096, vBaseEnvHwRegionStartAddress=4288749568, vBaseEnvHwRegionEccAlignment=4
            LocalRAM_Self: vBaseEnvHwRegionSize=196608, vBaseEnvHwRegionStartAddress=4275896320, vBaseEnvHwRegionEccAlignment=4
          vBaseEnvClockSettings: vBaseEnvOscClock=16000000, vBaseEnvPeriphClock=50000000, vBaseEnvTimebaseClock=100000000
        RH850_1506: vBaseEnvCpuMaxFrequency=120000000, vBaseEnvAvailableChannels_Flexray=2, vBaseEnvAvailableChannels_Can=7, vBaseEnvAvailableChannels_Lin=18, vBaseEnvAvailableChannels_Ethernet=1, vBaseEnvCpuCoreAmount=2, vBaseEnvTestedDerivative=RH850_1506, vBaseEnvTestedDerivativeDescription=Renesas RH850 F1H Family R7F701506, vBaseEnvCpuCore=G3M
          vBaseEnvAdditionalParameters: vBaseEnvClockGroup=A, vBaseEnvDerivativeGroup=F1H, vBaseEnvPllGroup=A1, vBaseEnvProtectionGroup=A, vBaseEnvPortGroup=A, vBaseEnvResetGroup=A
          11 x vBaseEnvMemLayoutHwRegion:
            CodeFlash_A: vBaseEnvHwRegionSize=1572864, vBaseEnvHwRegionStartAddress=0
            CodeFlash_B: vBaseEnvHwRegionSize=1572864, vBaseEnvHwRegionStartAddress=8388608
            LocalRAM_CPU0: vBaseEnvHwRegionSize=114688, vBaseEnvHwRegionStartAddress=4273881088, vBaseEnvHwRegionEccAlignment=4
            LocalRAM_CPU1: vBaseEnvHwRegionSize=114688, vBaseEnvHwRegionStartAddress=4271783936, vBaseEnvHwRegionEccAlignment=4
            GlobalRAM_A: vBaseEnvHwRegionSize=16384, vBaseEnvHwRegionStartAddress=4277125120, vBaseEnvHwRegionEccAlignment=4
            GlobalRAM_B: vBaseEnvHwRegionSize=16384, vBaseEnvHwRegionStartAddress=4278173696, vBaseEnvHwRegionEccAlignment=4
            DataFlash: vBaseEnvHwRegionSize=65536, vBaseEnvHwRegionStartAddress=4280287232
            CodeFlash_Ext: vBaseEnvHwRegionSize=32768, vBaseEnvHwRegionStartAddress=16777216
            RetentionRAM: vBaseEnvHwRegionSize=65536, vBaseEnvHwRegionStartAddress=4277141504, vBaseEnvHwRegionEccAlignment=4
            FCU_RAM: vBaseEnvHwRegionSize=4096, vBaseEnvHwRegionStartAddress=4288749568, vBaseEnvHwRegionEccAlignment=4
            LocalRAM_Self: vBaseEnvHwRegionSize=114688, vBaseEnvHwRegionStartAddress=4275978240, vBaseEnvHwRegionEccAlignment=4
          vBaseEnvClockSettings: vBaseEnvOscClock=16000000, vBaseEnvPeriphClock=50000000, vBaseEnvTimebaseClock=100000000
        RH850_1507: vBaseEnvCpuMaxFrequency=120000000, vBaseEnvAvailableChannels_Flexray=2, vBaseEnvAvailableChannels_Can=7, vBaseEnvAvailableChannels_Lin=18, vBaseEnvAvailableChannels_Ethernet=1, vBaseEnvCpuCoreAmount=2, vBaseEnvTestedDerivative=RH850_1507, vBaseEnvTestedDerivativeDescription=Renesas RH850 F1H Family R7F701507, vBaseEnvCpuCore=G3M
          vBaseEnvAdditionalParameters: vBaseEnvClockGroup=A, vBaseEnvDerivativeGroup=F1H, vBaseEnvPllGroup=A1, vBaseEnvProtectionGroup=A, vBaseEnvPortGroup=A, vBaseEnvResetGroup=A
          11 x vBaseEnvMemLayoutHwRegion:
            CodeFlash_A: vBaseEnvHwRegionSize=2097152, vBaseEnvHwRegionStartAddress=0
            CodeFlash_B: vBaseEnvHwRegionSize=2097152, vBaseEnvHwRegionStartAddress=8388608
            LocalRAM_CPU0: vBaseEnvHwRegionSize=131072, vBaseEnvHwRegionStartAddress=4273864704, vBaseEnvHwRegionEccAlignment=4
            LocalRAM_CPU1: vBaseEnvHwRegionSize=131072, vBaseEnvHwRegionStartAddress=4271767552, vBaseEnvHwRegionEccAlignment=4
            GlobalRAM_A: vBaseEnvHwRegionSize=32768, vBaseEnvHwRegionStartAddress=4277108736, vBaseEnvHwRegionEccAlignment=4
            GlobalRAM_B: vBaseEnvHwRegionSize=32768, vBaseEnvHwRegionStartAddress=4278157312, vBaseEnvHwRegionEccAlignment=4
            DataFlash: vBaseEnvHwRegionSize=65536, vBaseEnvHwRegionStartAddress=4280287232
            CodeFlash_Ext: vBaseEnvHwRegionSize=32768, vBaseEnvHwRegionStartAddress=16777216
            RetentionRAM: vBaseEnvHwRegionSize=65536, vBaseEnvHwRegionStartAddress=4277141504, vBaseEnvHwRegionEccAlignment=4
            FCU_RAM: vBaseEnvHwRegionSize=4096, vBaseEnvHwRegionStartAddress=4288749568, vBaseEnvHwRegionEccAlignment=4
            LocalRAM_Self: vBaseEnvHwRegionSize=131072, vBaseEnvHwRegionStartAddress=4275961856, vBaseEnvHwRegionEccAlignment=4
          vBaseEnvClockSettings: vBaseEnvOscClock=16000000, vBaseEnvPeriphClock=50000000, vBaseEnvTimebaseClock=100000000
        RH850_1522: vBaseEnvCpuMaxFrequency=120000000, vBaseEnvAvailableChannels_Flexray=2, vBaseEnvAvailableChannels_Can=8, vBaseEnvAvailableChannels_Lin=12, vBaseEnvAvailableChannels_Ethernet=1, vBaseEnvCpuCoreAmount=2, vBaseEnvTestedDerivative=RH850_1522, vBaseEnvTestedDerivativeDescription=Renesas RH850 F1H Family R7F701522, vBaseEnvCpuCore=G3M
          vBaseEnvAdditionalParameters: vBaseEnvClockGroup=A, vBaseEnvDerivativeGroup=F1H, vBaseEnvPllGroup=A1, vBaseEnvProtectionGroup=A, vBaseEnvPortGroup=A, vBaseEnvResetGroup=A
          11 x vBaseEnvMemLayoutHwRegion:
            CodeFlash_A: vBaseEnvHwRegionSize=2097152, vBaseEnvHwRegionStartAddress=0
            CodeFlash_B: vBaseEnvHwRegionSize=2097152, vBaseEnvHwRegionStartAddress=8388608
            LocalRAM_CPU0: vBaseEnvHwRegionSize=262144, vBaseEnvHwRegionStartAddress=4273733632, vBaseEnvHwRegionEccAlignment=4
            LocalRAM_CPU1: vBaseEnvHwRegionSize=262144, vBaseEnvHwRegionStartAddress=4271636480, vBaseEnvHwRegionEccAlignment=4
            GlobalRAM_A: vBaseEnvHwRegionSize=49152, vBaseEnvHwRegionStartAddress=4277092352, vBaseEnvHwRegionEccAlignment=4
            GlobalRAM_B: vBaseEnvHwRegionSize=49152, vBaseEnvHwRegionStartAddress=4278140928, vBaseEnvHwRegionEccAlignment=4
            DataFlash: vBaseEnvHwRegionSize=65536, vBaseEnvHwRegionStartAddress=4280287232
            CodeFlash_Ext: vBaseEnvHwRegionSize=32768, vBaseEnvHwRegionStartAddress=16777216
            RetentionRAM: vBaseEnvHwRegionSize=131072, vBaseEnvHwRegionStartAddress=4277141504, vBaseEnvHwRegionEccAlignment=4
            FCU_RAM: vBaseEnvHwRegionSize=4096, vBaseEnvHwRegionStartAddress=4288749568, vBaseEnvHwRegionEccAlignment=4
            LocalRAM_Self: vBaseEnvHwRegionSize=262144, vBaseEnvHwRegionStartAddress=4275830784, vBaseEnvHwRegionEccAlignment=4
          vBaseEnvClockSettings: vBaseEnvOscClock=8000000, vBaseEnvPeriphClock=50000000, vBaseEnvTimebaseClock=100000000
        RH850_1527: vBaseEnvCpuMaxFrequency=120000000, vBaseEnvAvailableChannels_Flexray=2, vBaseEnvAvailableChannels_Can=8, vBaseEnvAvailableChannels_Lin=16, vBaseEnvAvailableChannels_Ethernet=1, vBaseEnvCpuCoreAmount=2, vBaseEnvTestedDerivative=RH850_1527, vBaseEnvTestedDerivativeDescription=Renesas RH850 F1H Family R7F701527, vBaseEnvCpuCore=G3M
          vBaseEnvAdditionalParameters: vBaseEnvClockGroup=A, vBaseEnvDerivativeGroup=F1H, vBaseEnvPllGroup=A1, vBaseEnvProtectionGroup=A, vBaseEnvPortGroup=A, vBaseEnvResetGroup=A
          11 x vBaseEnvMemLayoutHwRegion:
            CodeFlash_A: vBaseEnvHwRegionSize=2097152, vBaseEnvHwRegionStartAddress=0
            CodeFlash_B: vBaseEnvHwRegionSize=2097152, vBaseEnvHwRegionStartAddress=8388608
            LocalRAM_CPU0: vBaseEnvHwRegionSize=262144, vBaseEnvHwRegionStartAddress=4273733632, vBaseEnvHwRegionEccAlignment=4
            LocalRAM_CPU1: vBaseEnvHwRegionSize=131072, vBaseEnvHwRegionStartAddress=4271767552, vBaseEnvHwRegionEccAlignment=4
            GlobalRAM_A: vBaseEnvHwRegionSize=32768, vBaseEnvHwRegionStartAddress=4277108736, vBaseEnvHwRegionEccAlignment=4
            GlobalRAM_B: vBaseEnvHwRegionSize=32768, vBaseEnvHwRegionStartAddress=4278157312, vBaseEnvHwRegionEccAlignment=4
            DataFlash: vBaseEnvHwRegionSize=65536, vBaseEnvHwRegionStartAddress=4280287232
            CodeFlash_Ext: vBaseEnvHwRegionSize=32768, vBaseEnvHwRegionStartAddress=16777216
            RetentionRAM: vBaseEnvHwRegionSize=65536, vBaseEnvHwRegionStartAddress=4277141504, vBaseEnvHwRegionEccAlignment=4
            FCU_RAM: vBaseEnvHwRegionSize=4096, vBaseEnvHwRegionStartAddress=4288749568, vBaseEnvHwRegionEccAlignment=4
            LocalRAM_Self: vBaseEnvHwRegionSize=131072, vBaseEnvHwRegionStartAddress=4275830784, vBaseEnvHwRegionEccAlignment=4
          vBaseEnvClockSettings: vBaseEnvOscClock=16000000, vBaseEnvPeriphClock=50000000, vBaseEnvTimebaseClock=100000000
        RH850_1529: vBaseEnvCpuMaxFrequency=120000000, vBaseEnvAvailableChannels_Flexray=2, vBaseEnvAvailableChannels_Can=8, vBaseEnvAvailableChannels_Lin=18, vBaseEnvAvailableChannels_Ethernet=1, vBaseEnvCpuCoreAmount=2, vBaseEnvTestedDerivative=RH850_1529, vBaseEnvTestedDerivativeDescription=Renesas RH850 F1H Family R7F701529, vBaseEnvCpuCore=G3M
          vBaseEnvAdditionalParameters: vBaseEnvClockGroup=A, vBaseEnvDerivativeGroup=F1H, vBaseEnvPllGroup=A1, vBaseEnvProtectionGroup=A, vBaseEnvPortGroup=A, vBaseEnvResetGroup=A
          11 x vBaseEnvMemLayoutHwRegion:
            CodeFlash_A: vBaseEnvHwRegionSize=2097152, vBaseEnvHwRegionStartAddress=0
            CodeFlash_B: vBaseEnvHwRegionSize=2097152, vBaseEnvHwRegionStartAddress=8388608
            LocalRAM_CPU0: vBaseEnvHwRegionSize=262144, vBaseEnvHwRegionStartAddress=4273733632, vBaseEnvHwRegionEccAlignment=4
            LocalRAM_CPU1: vBaseEnvHwRegionSize=131072, vBaseEnvHwRegionStartAddress=4271767552, vBaseEnvHwRegionEccAlignment=4
            GlobalRAM_A: vBaseEnvHwRegionSize=32768, vBaseEnvHwRegionStartAddress=4277108736, vBaseEnvHwRegionEccAlignment=4
            GlobalRAM_B: vBaseEnvHwRegionSize=32768, vBaseEnvHwRegionStartAddress=4278157312, vBaseEnvHwRegionEccAlignment=4
            DataFlash: vBaseEnvHwRegionSize=65536, vBaseEnvHwRegionStartAddress=4280287232
            CodeFlash_Ext: vBaseEnvHwRegionSize=32768, vBaseEnvHwRegionStartAddress=16777216
            RetentionRAM: vBaseEnvHwRegionSize=65536, vBaseEnvHwRegionStartAddress=4277141504, vBaseEnvHwRegionEccAlignment=4
            FCU_RAM: vBaseEnvHwRegionSize=4096, vBaseEnvHwRegionStartAddress=4288749568, vBaseEnvHwRegionEccAlignment=4
            LocalRAM_Self: vBaseEnvHwRegionSize=131072, vBaseEnvHwRegionStartAddress=4275830784, vBaseEnvHwRegionEccAlignment=4
          vBaseEnvClockSettings: vBaseEnvOscClock=16000000, vBaseEnvPeriphClock=50000000, vBaseEnvTimebaseClock=100000000
        RH850_1530: vBaseEnvCpuMaxFrequency=120000000, vBaseEnvAvailableChannels_Flexray=2, vBaseEnvAvailableChannels_Can=8, vBaseEnvAvailableChannels_Lin=6, vBaseEnvAvailableChannels_Ethernet=0, vBaseEnvCpuCoreAmount=2, vBaseEnvTestedDerivative=RH850_1530, vBaseEnvTestedDerivativeDescription=Renesas RH850 F1H Family R7F701530, vBaseEnvCpuCore=G3M
          vBaseEnvAdditionalParameters: vBaseEnvClockGroup=A, vBaseEnvDerivativeGroup=F1H, vBaseEnvPllGroup=A1, vBaseEnvProtectionGroup=A, vBaseEnvPortGroup=A, vBaseEnvResetGroup=A
          11 x vBaseEnvMemLayoutHwRegion:
            CodeFlash_A: vBaseEnvHwRegionSize=1572864, vBaseEnvHwRegionStartAddress=0
            CodeFlash_B: vBaseEnvHwRegionSize=1572864, vBaseEnvHwRegionStartAddress=8388608
            LocalRAM_CPU0: vBaseEnvHwRegionSize=262144, vBaseEnvHwRegionStartAddress=4273733632, vBaseEnvHwRegionEccAlignment=4
            LocalRAM_CPU1: vBaseEnvHwRegionSize=131072, vBaseEnvHwRegionStartAddress=4271767552, vBaseEnvHwRegionEccAlignment=4
            GlobalRAM_A: vBaseEnvHwRegionSize=32768, vBaseEnvHwRegionStartAddress=4277108736, vBaseEnvHwRegionEccAlignment=4
            GlobalRAM_B: vBaseEnvHwRegionSize=32768, vBaseEnvHwRegionStartAddress=4278157312, vBaseEnvHwRegionEccAlignment=4
            DataFlash: vBaseEnvHwRegionSize=65536, vBaseEnvHwRegionStartAddress=4280287232
            CodeFlash_Ext: vBaseEnvHwRegionSize=32768, vBaseEnvHwRegionStartAddress=16777216
            RetentionRAM: vBaseEnvHwRegionSize=65536, vBaseEnvHwRegionStartAddress=4277141504, vBaseEnvHwRegionEccAlignment=4
            FCU_RAM: vBaseEnvHwRegionSize=4096, vBaseEnvHwRegionStartAddress=4288749568, vBaseEnvHwRegionEccAlignment=4
            LocalRAM_Self: vBaseEnvHwRegionSize=262144, vBaseEnvHwRegionStartAddress=4275830784, vBaseEnvHwRegionEccAlignment=4
          vBaseEnvClockSettings: vBaseEnvOscClock=16000000, vBaseEnvPeriphClock=50000000, vBaseEnvTimebaseClock=100000000
        RH850_1531: vBaseEnvCpuMaxFrequency=120000000, vBaseEnvAvailableChannels_Flexray=0, vBaseEnvAvailableChannels_Can=8, vBaseEnvAvailableChannels_Lin=6, vBaseEnvAvailableChannels_Ethernet=0, vBaseEnvCpuCoreAmount=2, vBaseEnvTestedDerivative=RH850_1531, vBaseEnvTestedDerivativeDescription=Renesas RH850 F1H Family R7F701531, vBaseEnvCpuCore=G3M
          vBaseEnvAdditionalParameters: vBaseEnvClockGroup=A, vBaseEnvDerivativeGroup=F1H, vBaseEnvPllGroup=A1, vBaseEnvProtectionGroup=A, vBaseEnvPortGroup=A, vBaseEnvResetGroup=A
          11 x vBaseEnvMemLayoutHwRegion:
            CodeFlash_A: vBaseEnvHwRegionSize=2097152, vBaseEnvHwRegionStartAddress=0
            CodeFlash_B: vBaseEnvHwRegionSize=2097152, vBaseEnvHwRegionStartAddress=8388608
            LocalRAM_CPU0: vBaseEnvHwRegionSize=262144, vBaseEnvHwRegionStartAddress=4273733632, vBaseEnvHwRegionEccAlignment=4
            LocalRAM_CPU1: vBaseEnvHwRegionSize=131072, vBaseEnvHwRegionStartAddress=4271767552, vBaseEnvHwRegionEccAlignment=4
            GlobalRAM_A: vBaseEnvHwRegionSize=32768, vBaseEnvHwRegionStartAddress=4277108736, vBaseEnvHwRegionEccAlignment=4
            GlobalRAM_B: vBaseEnvHwRegionSize=32768, vBaseEnvHwRegionStartAddress=4278157312, vBaseEnvHwRegionEccAlignment=4
            DataFlash: vBaseEnvHwRegionSize=65536, vBaseEnvHwRegionStartAddress=4280287232
            CodeFlash_Ext: vBaseEnvHwRegionSize=32768, vBaseEnvHwRegionStartAddress=16777216
            RetentionRAM: vBaseEnvHwRegionSize=65536, vBaseEnvHwRegionStartAddress=4277141504, vBaseEnvHwRegionEccAlignment=4
            FCU_RAM: vBaseEnvHwRegionSize=4096, vBaseEnvHwRegionStartAddress=4288749568, vBaseEnvHwRegionEccAlignment=4
            LocalRAM_Self: vBaseEnvHwRegionSize=262144, vBaseEnvHwRegionStartAddress=4275830784, vBaseEnvHwRegionEccAlignment=4
          vBaseEnvClockSettings: vBaseEnvOscClock=16000000, vBaseEnvPeriphClock=50000000, vBaseEnvTimebaseClock=100000000
        RH850_1534: vBaseEnvCpuMaxFrequency=120000000, vBaseEnvAvailableChannels_Flexray=2, vBaseEnvAvailableChannels_Can=8, vBaseEnvAvailableChannels_Lin=16, vBaseEnvAvailableChannels_Ethernet=1, vBaseEnvCpuCoreAmount=2, vBaseEnvTestedDerivative=RH850_1534, vBaseEnvTestedDerivativeDescription=Renesas RH850 F1H Family R7F701534, vBaseEnvCpuCore=G3M
          vBaseEnvAdditionalParameters: vBaseEnvClockGroup=A, vBaseEnvDerivativeGroup=F1H, vBaseEnvPllGroup=A1, vBaseEnvProtectionGroup=A, vBaseEnvPortGroup=A, vBaseEnvResetGroup=A
          11 x vBaseEnvMemLayoutHwRegion:
            CodeFlash_A: vBaseEnvHwRegionSize=4194304, vBaseEnvHwRegionStartAddress=0
            CodeFlash_B: vBaseEnvHwRegionSize=2097152, vBaseEnvHwRegionStartAddress=8388608
            LocalRAM_CPU0: vBaseEnvHwRegionSize=262144, vBaseEnvHwRegionStartAddress=4273733632, vBaseEnvHwRegionEccAlignment=4
            LocalRAM_CPU1: vBaseEnvHwRegionSize=262144, vBaseEnvHwRegionStartAddress=4271636480, vBaseEnvHwRegionEccAlignment=4
            GlobalRAM_A: vBaseEnvHwRegionSize=65536, vBaseEnvHwRegionStartAddress=4277075968, vBaseEnvHwRegionEccAlignment=4
            GlobalRAM_B: vBaseEnvHwRegionSize=65536, vBaseEnvHwRegionStartAddress=4278124544, vBaseEnvHwRegionEccAlignment=4
            DataFlash: vBaseEnvHwRegionSize=65536, vBaseEnvHwRegionStartAddress=4280287232
            CodeFlash_Ext: vBaseEnvHwRegionSize=32768, vBaseEnvHwRegionStartAddress=16777216
            RetentionRAM: vBaseEnvHwRegionSize=131072, vBaseEnvHwRegionStartAddress=4277141504, vBaseEnvHwRegionEccAlignment=4
            FCU_RAM: vBaseEnvHwRegionSize=4096, vBaseEnvHwRegionStartAddress=4288749568, vBaseEnvHwRegionEccAlignment=4
            LocalRAM_Self: vBaseEnvHwRegionSize=262144, vBaseEnvHwRegionStartAddress=4275830784, vBaseEnvHwRegionEccAlignment=4
          vBaseEnvClockSettings: vBaseEnvOscClock=16000000, vBaseEnvPeriphClock=50000000, vBaseEnvTimebaseClock=100000000
        RH850_1542: vBaseEnvCpuMaxFrequency=80000000, vBaseEnvAvailableChannels_Flexray=0, vBaseEnvAvailableChannels_Can=6, vBaseEnvAvailableChannels_Lin=12, vBaseEnvAvailableChannels_Ethernet=0, vBaseEnvCpuCoreAmount=1, vBaseEnvTestedDerivative=RH850_1542, vBaseEnvTestedDerivativeDescription=Renesas RH850 F1K Family R7F701542, vBaseEnvCpuCore=G3KH
          vBaseEnvAdditionalParameters: vBaseEnvClockGroup=A2, vBaseEnvDerivativeGroup=F1K, vBaseEnvPllGroup=A3, vBaseEnvProtectionGroup=A, vBaseEnvPortGroup=A, vBaseEnvResetGroup=A
          7 x vBaseEnvMemLayoutHwRegion:
            CodeFlash_A: vBaseEnvHwRegionSize=1572864, vBaseEnvHwRegionStartAddress=0
            LocalRAM_CPU0: vBaseEnvHwRegionSize=98304, vBaseEnvHwRegionStartAddress=4273831936, vBaseEnvHwRegionEccAlignment=4
            DataFlash: vBaseEnvHwRegionSize=65536, vBaseEnvHwRegionStartAddress=4280287232
            CodeFlash_Ext: vBaseEnvHwRegionSize=32768, vBaseEnvHwRegionStartAddress=16777216
            RetentionRAM: vBaseEnvHwRegionSize=65536, vBaseEnvHwRegionStartAddress=4273930240, vBaseEnvHwRegionEccAlignment=4
            LocalRAM_Self: vBaseEnvHwRegionSize=98304, vBaseEnvHwRegionStartAddress=4275929088, vBaseEnvHwRegionEccAlignment=4
            RetentionRAM_Self: vBaseEnvHwRegionSize=65536, vBaseEnvHwRegionStartAddress=4276027392, vBaseEnvHwRegionEccAlignment=4
          vBaseEnvClockSettings: vBaseEnvOscClock=16000000, vBaseEnvPeriphClock=60000000, vBaseEnvTimebaseClock=80000000
        RH850_1543: vBaseEnvCpuMaxFrequency=80000000, vBaseEnvAvailableChannels_Flexray=0, vBaseEnvAvailableChannels_Can=6, vBaseEnvAvailableChannels_Lin=12, vBaseEnvAvailableChannels_Ethernet=0, vBaseEnvCpuCoreAmount=1, vBaseEnvTestedDerivative=RH850_1543, vBaseEnvTestedDerivativeDescription=Renesas RH850 F1K Family R7F701543, vBaseEnvCpuCore=G3KH
          vBaseEnvAdditionalParameters: vBaseEnvClockGroup=A2, vBaseEnvDerivativeGroup=F1K, vBaseEnvPllGroup=A3, vBaseEnvProtectionGroup=A, vBaseEnvPortGroup=A, vBaseEnvResetGroup=A
          7 x vBaseEnvMemLayoutHwRegion:
            CodeFlash_A: vBaseEnvHwRegionSize=2097152, vBaseEnvHwRegionStartAddress=0
            LocalRAM_CPU0: vBaseEnvHwRegionSize=131072, vBaseEnvHwRegionStartAddress=4273831936, vBaseEnvHwRegionEccAlignment=4
            DataFlash: vBaseEnvHwRegionSize=65536, vBaseEnvHwRegionStartAddress=4280287232
            CodeFlash_Ext: vBaseEnvHwRegionSize=32768, vBaseEnvHwRegionStartAddress=16777216
            RetentionRAM: vBaseEnvHwRegionSize=65536, vBaseEnvHwRegionStartAddress=4273930240, vBaseEnvHwRegionEccAlignment=4
            LocalRAM_Self: vBaseEnvHwRegionSize=98304, vBaseEnvHwRegionStartAddress=4275929088, vBaseEnvHwRegionEccAlignment=4
            RetentionRAM_Self: vBaseEnvHwRegionSize=65536, vBaseEnvHwRegionStartAddress=4276027392, vBaseEnvHwRegionEccAlignment=4
          vBaseEnvClockSettings: vBaseEnvOscClock=16000000, vBaseEnvPeriphClock=60000000, vBaseEnvTimebaseClock=80000000
        RH850_1560: vBaseEnvCpuMaxFrequency=120000000, vBaseEnvAvailableChannels_Flexray=0, vBaseEnvAvailableChannels_Can=6, vBaseEnvAvailableChannels_Lin=7, vBaseEnvAvailableChannels_Ethernet=0, vBaseEnvCpuCoreAmount=1, vBaseEnvTestedDerivative=RH850_1560, vBaseEnvTestedDerivativeDescription=Renesas RH850 F1K Family R7F701560, vBaseEnvCpuCore=G3KH
          vBaseEnvAdditionalParameters: vBaseEnvClockGroup=A2, vBaseEnvDerivativeGroup=F1K, vBaseEnvPllGroup=A3, vBaseEnvProtectionGroup=A, vBaseEnvPortGroup=A, vBaseEnvResetGroup=A
          7 x vBaseEnvMemLayoutHwRegion:
            CodeFlash_A: vBaseEnvHwRegionSize=1572864, vBaseEnvHwRegionStartAddress=0
            LocalRAM_CPU0: vBaseEnvHwRegionSize=98304, vBaseEnvHwRegionStartAddress=4273831936, vBaseEnvHwRegionEccAlignment=4
            DataFlash: vBaseEnvHwRegionSize=65536, vBaseEnvHwRegionStartAddress=4280287232
            CodeFlash_Ext: vBaseEnvHwRegionSize=32768, vBaseEnvHwRegionStartAddress=16777216
            RetentionRAM: vBaseEnvHwRegionSize=65536, vBaseEnvHwRegionStartAddress=4273930240, vBaseEnvHwRegionEccAlignment=4
            LocalRAM_Self: vBaseEnvHwRegionSize=98304, vBaseEnvHwRegionStartAddress=4275929088, vBaseEnvHwRegionEccAlignment=4
            RetentionRAM_Self: vBaseEnvHwRegionSize=65536, vBaseEnvHwRegionStartAddress=4276027392, vBaseEnvHwRegionEccAlignment=4
          vBaseEnvClockSettings: vBaseEnvOscClock=16000000, vBaseEnvPeriphClock=60000000, vBaseEnvTimebaseClock=80000000
        RH850_1561: vBaseEnvCpuMaxFrequency=120000000, vBaseEnvAvailableChannels_Flexray=0, vBaseEnvAvailableChannels_Can=6, vBaseEnvAvailableChannels_Lin=12, vBaseEnvAvailableChannels_Ethernet=0, vBaseEnvCpuCoreAmount=1, vBaseEnvTestedDerivative=RH850_1562, vBaseEnvTestedDerivativeDescription=Renesas RH850 F1K Family R7F701562, vBaseEnvCpuCore=G3KH
          vBaseEnvAdditionalParameters: vBaseEnvClockGroup=A2, vBaseEnvDerivativeGroup=F1K, vBaseEnvPllGroup=A3, vBaseEnvProtectionGroup=A, vBaseEnvPortGroup=A, vBaseEnvResetGroup=A
          7 x vBaseEnvMemLayoutHwRegion:
            CodeFlash_A: vBaseEnvHwRegionSize=2097152, vBaseEnvHwRegionStartAddress=0
            LocalRAM_CPU0: vBaseEnvHwRegionSize=131072, vBaseEnvHwRegionStartAddress=4273799168, vBaseEnvHwRegionEccAlignment=4
            DataFlash: vBaseEnvHwRegionSize=65536, vBaseEnvHwRegionStartAddress=4280287232
            CodeFlash_Ext: vBaseEnvHwRegionSize=32768, vBaseEnvHwRegionStartAddress=16777216
            RetentionRAM: vBaseEnvHwRegionSize=65536, vBaseEnvHwRegionStartAddress=4273930240, vBaseEnvHwRegionEccAlignment=4
            LocalRAM_Self: vBaseEnvHwRegionSize=131072, vBaseEnvHwRegionStartAddress=4275896320, vBaseEnvHwRegionEccAlignment=4
            RetentionRAM_Self: vBaseEnvHwRegionSize=65536, vBaseEnvHwRegionStartAddress=4276027392, vBaseEnvHwRegionEccAlignment=4
          vBaseEnvClockSettings: vBaseEnvOscClock=16000000, vBaseEnvPeriphClock=60000000, vBaseEnvTimebaseClock=80000000
        RH850_1562: vBaseEnvCpuMaxFrequency=120000000, vBaseEnvAvailableChannels_Flexray=0, vBaseEnvAvailableChannels_Can=6, vBaseEnvAvailableChannels_Lin=12, vBaseEnvAvailableChannels_Ethernet=0, vBaseEnvCpuCoreAmount=1, vBaseEnvTestedDerivative=RH850_1562, vBaseEnvTestedDerivativeDescription=Renesas RH850 F1K Family R7F701562, vBaseEnvCpuCore=G3KH
          vBaseEnvAdditionalParameters: vBaseEnvClockGroup=A2, vBaseEnvDerivativeGroup=F1K, vBaseEnvPllGroup=A3, vBaseEnvProtectionGroup=A, vBaseEnvPortGroup=A, vBaseEnvResetGroup=A
          7 x vBaseEnvMemLayoutHwRegion:
            CodeFlash_A: vBaseEnvHwRegionSize=1572864, vBaseEnvHwRegionStartAddress=0
            LocalRAM_CPU0: vBaseEnvHwRegionSize=98304, vBaseEnvHwRegionStartAddress=4273831936, vBaseEnvHwRegionEccAlignment=4
            DataFlash: vBaseEnvHwRegionSize=65536, vBaseEnvHwRegionStartAddress=4280287232
            CodeFlash_Ext: vBaseEnvHwRegionSize=32768, vBaseEnvHwRegionStartAddress=16777216
            RetentionRAM: vBaseEnvHwRegionSize=65536, vBaseEnvHwRegionStartAddress=4273930240, vBaseEnvHwRegionEccAlignment=4
            LocalRAM_Self: vBaseEnvHwRegionSize=98304, vBaseEnvHwRegionStartAddress=4275929088, vBaseEnvHwRegionEccAlignment=4
            RetentionRAM_Self: vBaseEnvHwRegionSize=65536, vBaseEnvHwRegionStartAddress=4276027392, vBaseEnvHwRegionEccAlignment=4
          vBaseEnvClockSettings: vBaseEnvOscClock=16000000, vBaseEnvPeriphClock=60000000, vBaseEnvTimebaseClock=80000000
        RH850_1563: vBaseEnvCpuMaxFrequency=120000000, vBaseEnvAvailableChannels_Flexray=0, vBaseEnvAvailableChannels_Can=6, vBaseEnvAvailableChannels_Lin=12, vBaseEnvAvailableChannels_Ethernet=0, vBaseEnvCpuCoreAmount=1, vBaseEnvTestedDerivative=RH850_1563, vBaseEnvTestedDerivativeDescription=Renesas RH850 F1K Family R7F701563, vBaseEnvCpuCore=G3KH
          vBaseEnvAdditionalParameters: vBaseEnvClockGroup=A2, vBaseEnvDerivativeGroup=F1K, vBaseEnvPllGroup=A3, vBaseEnvProtectionGroup=A, vBaseEnvPortGroup=A, vBaseEnvResetGroup=A
          7 x vBaseEnvMemLayoutHwRegion:
            CodeFlash_A: vBaseEnvHwRegionSize=2097152, vBaseEnvHwRegionStartAddress=0
            LocalRAM_CPU0: vBaseEnvHwRegionSize=131072, vBaseEnvHwRegionStartAddress=4273831936, vBaseEnvHwRegionEccAlignment=4
            DataFlash: vBaseEnvHwRegionSize=65536, vBaseEnvHwRegionStartAddress=4280287232
            CodeFlash_Ext: vBaseEnvHwRegionSize=32768, vBaseEnvHwRegionStartAddress=16777216
            RetentionRAM: vBaseEnvHwRegionSize=65536, vBaseEnvHwRegionStartAddress=4273930240, vBaseEnvHwRegionEccAlignment=4
            LocalRAM_Self: vBaseEnvHwRegionSize=131072, vBaseEnvHwRegionStartAddress=4275929088, vBaseEnvHwRegionEccAlignment=4
            RetentionRAM_Self: vBaseEnvHwRegionSize=65536, vBaseEnvHwRegionStartAddress=4276027392, vBaseEnvHwRegionEccAlignment=4
          vBaseEnvClockSettings: vBaseEnvOscClock=16000000, vBaseEnvPeriphClock=60000000, vBaseEnvTimebaseClock=80000000
        RH850_1566: vBaseEnvCpuMaxFrequency=120000000, vBaseEnvAvailableChannels_Flexray=0, vBaseEnvAvailableChannels_Can=7, vBaseEnvAvailableChannels_Lin=16, vBaseEnvAvailableChannels_Ethernet=0, vBaseEnvCpuCoreAmount=1, vBaseEnvTestedDerivative=RH850_1566, vBaseEnvTestedDerivativeDescription=Renesas RH850 F1K Family R7F701566, vBaseEnvCpuCore=G3KH
          vBaseEnvAdditionalParameters: vBaseEnvClockGroup=A2, vBaseEnvDerivativeGroup=F1K, vBaseEnvPllGroup=A3, vBaseEnvProtectionGroup=A, vBaseEnvPortGroup=A, vBaseEnvResetGroup=A
          7 x vBaseEnvMemLayoutHwRegion:
            CodeFlash_A: vBaseEnvHwRegionSize=1572864, vBaseEnvHwRegionStartAddress=0
            LocalRAM_CPU0: vBaseEnvHwRegionSize=98304, vBaseEnvHwRegionStartAddress=4273799168, vBaseEnvHwRegionEccAlignment=4
            DataFlash: vBaseEnvHwRegionSize=65536, vBaseEnvHwRegionStartAddress=4280287232
            CodeFlash_Ext: vBaseEnvHwRegionSize=32768, vBaseEnvHwRegionStartAddress=16777216
            RetentionRAM: vBaseEnvHwRegionSize=65536, vBaseEnvHwRegionStartAddress=4273930240, vBaseEnvHwRegionEccAlignment=4
            LocalRAM_Self: vBaseEnvHwRegionSize=98304, vBaseEnvHwRegionStartAddress=4275896320, vBaseEnvHwRegionEccAlignment=4
            RetentionRAM_Self: vBaseEnvHwRegionSize=65536, vBaseEnvHwRegionStartAddress=4276027392, vBaseEnvHwRegionEccAlignment=4
          vBaseEnvClockSettings: vBaseEnvOscClock=16000000, vBaseEnvPeriphClock=60000000, vBaseEnvTimebaseClock=80000000
        RH850_1567: vBaseEnvCpuMaxFrequency=120000000, vBaseEnvAvailableChannels_Flexray=0, vBaseEnvAvailableChannels_Can=7, vBaseEnvAvailableChannels_Lin=16, vBaseEnvAvailableChannels_Ethernet=0, vBaseEnvCpuCoreAmount=1, vBaseEnvTestedDerivative=RH850_1567, vBaseEnvTestedDerivativeDescription=Renesas RH850 F1K Family R7F701567, vBaseEnvCpuCore=G3KH
          vBaseEnvAdditionalParameters: vBaseEnvClockGroup=A2, vBaseEnvDerivativeGroup=F1K, vBaseEnvPllGroup=A3, vBaseEnvProtectionGroup=A, vBaseEnvPortGroup=A, vBaseEnvResetGroup=A
          7 x vBaseEnvMemLayoutHwRegion:
            CodeFlash_A: vBaseEnvHwRegionSize=2097152, vBaseEnvHwRegionStartAddress=0
            LocalRAM_CPU0: vBaseEnvHwRegionSize=131072, vBaseEnvHwRegionStartAddress=4273799168, vBaseEnvHwRegionEccAlignment=4
            DataFlash: vBaseEnvHwRegionSize=65536, vBaseEnvHwRegionStartAddress=4280287232
            CodeFlash_Ext: vBaseEnvHwRegionSize=32768, vBaseEnvHwRegionStartAddress=16777216
            RetentionRAM: vBaseEnvHwRegionSize=65536, vBaseEnvHwRegionStartAddress=4273930240, vBaseEnvHwRegionEccAlignment=4
            LocalRAM_Self: vBaseEnvHwRegionSize=131072, vBaseEnvHwRegionStartAddress=4275896320, vBaseEnvHwRegionEccAlignment=4
            RetentionRAM_Self: vBaseEnvHwRegionSize=65536, vBaseEnvHwRegionStartAddress=4276027392, vBaseEnvHwRegionEccAlignment=4
          vBaseEnvClockSettings: vBaseEnvOscClock=16000000, vBaseEnvPeriphClock=60000000, vBaseEnvTimebaseClock=80000000
        RH850_1577: vBaseEnvCpuMaxFrequency=120000000, vBaseEnvAvailableChannels_Flexray=0, vBaseEnvAvailableChannels_Can=6, vBaseEnvAvailableChannels_Lin=12, vBaseEnvAvailableChannels_Ethernet=0, vBaseEnvCpuCoreAmount=1, vBaseEnvTestedDerivative=RH850_1562, vBaseEnvTestedDerivativeDescription=Renesas RH850 F1K Family R7F701562, vBaseEnvCpuCore=G3KH
          vBaseEnvAdditionalParameters: vBaseEnvClockGroup=A2, vBaseEnvDerivativeGroup=F1K, vBaseEnvPllGroup=A3, vBaseEnvProtectionGroup=A, vBaseEnvPortGroup=A, vBaseEnvResetGroup=A
          7 x vBaseEnvMemLayoutHwRegion:
            CodeFlash_A: vBaseEnvHwRegionSize=1048576, vBaseEnvHwRegionStartAddress=0
            LocalRAM_CPU0: vBaseEnvHwRegionSize=65536, vBaseEnvHwRegionStartAddress=4273864704, vBaseEnvHwRegionEccAlignment=4
            DataFlash: vBaseEnvHwRegionSize=65536, vBaseEnvHwRegionStartAddress=4280287232
            CodeFlash_Ext: vBaseEnvHwRegionSize=32768, vBaseEnvHwRegionStartAddress=16777216
            RetentionRAM: vBaseEnvHwRegionSize=65536, vBaseEnvHwRegionStartAddress=4273930240, vBaseEnvHwRegionEccAlignment=4
            LocalRAM_Self: vBaseEnvHwRegionSize=65536, vBaseEnvHwRegionStartAddress=4275961856, vBaseEnvHwRegionEccAlignment=4
            RetentionRAM_Self: vBaseEnvHwRegionSize=65536, vBaseEnvHwRegionStartAddress=4276027392, vBaseEnvHwRegionEccAlignment=4
          vBaseEnvClockSettings: vBaseEnvOscClock=16000000, vBaseEnvPeriphClock=60000000, vBaseEnvTimebaseClock=80000000
        RH850_1580: vBaseEnvCpuMaxFrequency=120000000, vBaseEnvAvailableChannels_Flexray=0, vBaseEnvAvailableChannels_Can=6, vBaseEnvAvailableChannels_Lin=7, vBaseEnvAvailableChannels_Ethernet=0, vBaseEnvCpuCoreAmount=1, vBaseEnvTestedDerivative=RH850_1580, vBaseEnvTestedDerivativeDescription=Renesas RH850 F1K Family R7F701580, vBaseEnvCpuCore=G3KH
          vBaseEnvAdditionalParameters: vBaseEnvClockGroup=A2, vBaseEnvDerivativeGroup=F1K, vBaseEnvPllGroup=A3, vBaseEnvProtectionGroup=A, vBaseEnvPortGroup=A, vBaseEnvResetGroup=A
          7 x vBaseEnvMemLayoutHwRegion:
            CodeFlash_A: vBaseEnvHwRegionSize=1572864, vBaseEnvHwRegionStartAddress=0
            LocalRAM_CPU0: vBaseEnvHwRegionSize=98304, vBaseEnvHwRegionStartAddress=4273831936, vBaseEnvHwRegionEccAlignment=4
            DataFlash: vBaseEnvHwRegionSize=65536, vBaseEnvHwRegionStartAddress=4280287232
            CodeFlash_Ext: vBaseEnvHwRegionSize=32768, vBaseEnvHwRegionStartAddress=16777216
            RetentionRAM: vBaseEnvHwRegionSize=65536, vBaseEnvHwRegionStartAddress=4273930240, vBaseEnvHwRegionEccAlignment=4
            RetentionRAM_Self: vBaseEnvHwRegionSize=65536, vBaseEnvHwRegionStartAddress=4276027392, vBaseEnvHwRegionEccAlignment=4
            LocalRAM_Self: vBaseEnvHwRegionSize=98304, vBaseEnvHwRegionStartAddress=4275929088, vBaseEnvHwRegionEccAlignment=4
          vBaseEnvClockSettings: vBaseEnvOscClock=16000000, vBaseEnvPeriphClock=60000000, vBaseEnvTimebaseClock=80000000
        RH850_1581: vBaseEnvCpuMaxFrequency=120000000, vBaseEnvAvailableChannels_Flexray=0, vBaseEnvAvailableChannels_Can=6, vBaseEnvAvailableChannels_Lin=7, vBaseEnvAvailableChannels_Ethernet=0, vBaseEnvCpuCoreAmount=1, vBaseEnvTestedDerivative=RH850_1581, vBaseEnvTestedDerivativeDescription=Renesas RH850 F1K Family R7F701581, vBaseEnvCpuCore=G3KH
          vBaseEnvAdditionalParameters: vBaseEnvClockGroup=A2, vBaseEnvDerivativeGroup=F1K, vBaseEnvPllGroup=A3, vBaseEnvProtectionGroup=A, vBaseEnvPortGroup=A, vBaseEnvResetGroup=A
          7 x vBaseEnvMemLayoutHwRegion:
            CodeFlash_A: vBaseEnvHwRegionSize=2097152, vBaseEnvHwRegionStartAddress=0
            LocalRAM_CPU0: vBaseEnvHwRegionSize=131072, vBaseEnvHwRegionStartAddress=4273799168, vBaseEnvHwRegionEccAlignment=4
            DataFlash: vBaseEnvHwRegionSize=65536, vBaseEnvHwRegionStartAddress=4280287232
            CodeFlash_Ext: vBaseEnvHwRegionSize=32768, vBaseEnvHwRegionStartAddress=16777216
            RetentionRAM: vBaseEnvHwRegionSize=65536, vBaseEnvHwRegionStartAddress=4273930240, vBaseEnvHwRegionEccAlignment=4
            LocalRAM_Self: vBaseEnvHwRegionSize=131072, vBaseEnvHwRegionStartAddress=4275896320, vBaseEnvHwRegionEccAlignment=4
            RetentionRAM_Self: vBaseEnvHwRegionSize=65536, vBaseEnvHwRegionStartAddress=4276027392, vBaseEnvHwRegionEccAlignment=4
          vBaseEnvClockSettings: vBaseEnvOscClock=16000000, vBaseEnvPeriphClock=60000000, vBaseEnvTimebaseClock=80000000
        RH850_1582: vBaseEnvCpuMaxFrequency=120000000, vBaseEnvAvailableChannels_Flexray=0, vBaseEnvAvailableChannels_Can=6, vBaseEnvAvailableChannels_Lin=12, vBaseEnvAvailableChannels_Ethernet=0, vBaseEnvCpuCoreAmount=1, vBaseEnvTestedDerivative=RH850_1582, vBaseEnvTestedDerivativeDescription=Renesas RH850 F1K Family R7F701582, vBaseEnvCpuCore=G3KH
          vBaseEnvAdditionalParameters: vBaseEnvClockGroup=A2, vBaseEnvDerivativeGroup=F1K, vBaseEnvPllGroup=A3, vBaseEnvProtectionGroup=A, vBaseEnvPortGroup=A, vBaseEnvResetGroup=A
          7 x vBaseEnvMemLayoutHwRegion:
            CodeFlash_A: vBaseEnvHwRegionSize=1572864, vBaseEnvHwRegionStartAddress=0
            LocalRAM_CPU0: vBaseEnvHwRegionSize=98304, vBaseEnvHwRegionStartAddress=4273831936, vBaseEnvHwRegionEccAlignment=4
            DataFlash: vBaseEnvHwRegionSize=65536, vBaseEnvHwRegionStartAddress=4280287232
            CodeFlash_Ext: vBaseEnvHwRegionSize=32768, vBaseEnvHwRegionStartAddress=16777216
            RetentionRAM: vBaseEnvHwRegionSize=65536, vBaseEnvHwRegionStartAddress=4273930240, vBaseEnvHwRegionEccAlignment=4
            LocalRAM_Self: vBaseEnvHwRegionSize=98304, vBaseEnvHwRegionStartAddress=4275929088, vBaseEnvHwRegionEccAlignment=4
            RetentionRAM_Self: vBaseEnvHwRegionSize=65536, vBaseEnvHwRegionStartAddress=4276027392, vBaseEnvHwRegionEccAlignment=4
          vBaseEnvClockSettings: vBaseEnvOscClock=16000000, vBaseEnvPeriphClock=60000000, vBaseEnvTimebaseClock=80000000
        RH850_1583: vBaseEnvCpuMaxFrequency=120000000, vBaseEnvAvailableChannels_Flexray=0, vBaseEnvAvailableChannels_Can=6, vBaseEnvAvailableChannels_Lin=12, vBaseEnvAvailableChannels_Ethernet=0, vBaseEnvCpuCoreAmount=1, vBaseEnvTestedDerivative=RH850_1583, vBaseEnvTestedDerivativeDescription=Renesas RH850 F1K Family R7F701583, vBaseEnvCpuCore=G3KH
          vBaseEnvAdditionalParameters: vBaseEnvClockGroup=A2, vBaseEnvDerivativeGroup=F1K, vBaseEnvPllGroup=A3, vBaseEnvProtectionGroup=A, vBaseEnvPortGroup=A, vBaseEnvResetGroup=A
          7 x vBaseEnvMemLayoutHwRegion:
            CodeFlash_A: vBaseEnvHwRegionSize=2097152, vBaseEnvHwRegionStartAddress=0
            LocalRAM_CPU0: vBaseEnvHwRegionSize=131072, vBaseEnvHwRegionStartAddress=4273799168, vBaseEnvHwRegionEccAlignment=4
            DataFlash: vBaseEnvHwRegionSize=65536, vBaseEnvHwRegionStartAddress=4280287232
            CodeFlash_Ext: vBaseEnvHwRegionSize=32768, vBaseEnvHwRegionStartAddress=16777216
            RetentionRAM: vBaseEnvHwRegionSize=65536, vBaseEnvHwRegionStartAddress=4273930240, vBaseEnvHwRegionEccAlignment=4
            LocalRAM_Self: vBaseEnvHwRegionSize=131072, vBaseEnvHwRegionStartAddress=4275896320, vBaseEnvHwRegionEccAlignment=4
            RetentionRAM_Self: vBaseEnvHwRegionSize=65536, vBaseEnvHwRegionStartAddress=4276027392, vBaseEnvHwRegionEccAlignment=4
          vBaseEnvClockSettings: vBaseEnvOscClock=16000000, vBaseEnvPeriphClock=60000000, vBaseEnvTimebaseClock=80000000
        RH850_1586: vBaseEnvCpuMaxFrequency=120000000, vBaseEnvAvailableChannels_Flexray=0, vBaseEnvAvailableChannels_Can=7, vBaseEnvAvailableChannels_Lin=16, vBaseEnvAvailableChannels_Ethernet=0, vBaseEnvCpuCoreAmount=1, vBaseEnvTestedDerivative=RH850_1586, vBaseEnvTestedDerivativeDescription=Renesas RH850 F1K Family R7F701586, vBaseEnvCpuCore=G3KH
          vBaseEnvAdditionalParameters: vBaseEnvClockGroup=A2, vBaseEnvDerivativeGroup=F1K, vBaseEnvPllGroup=A3, vBaseEnvProtectionGroup=A, vBaseEnvPortGroup=A, vBaseEnvResetGroup=A
          7 x vBaseEnvMemLayoutHwRegion:
            CodeFlash_A: vBaseEnvHwRegionSize=1572864, vBaseEnvHwRegionStartAddress=0
            LocalRAM_CPU0: vBaseEnvHwRegionSize=98304, vBaseEnvHwRegionStartAddress=4273799168, vBaseEnvHwRegionEccAlignment=4
            DataFlash: vBaseEnvHwRegionSize=65536, vBaseEnvHwRegionStartAddress=4280287232
            CodeFlash_Ext: vBaseEnvHwRegionSize=32768, vBaseEnvHwRegionStartAddress=16777216
            RetentionRAM: vBaseEnvHwRegionSize=65536, vBaseEnvHwRegionStartAddress=4273930240, vBaseEnvHwRegionEccAlignment=4
            LocalRAM_Self: vBaseEnvHwRegionSize=131072, vBaseEnvHwRegionStartAddress=4275896320, vBaseEnvHwRegionEccAlignment=4
            RetentionRAM_Self: vBaseEnvHwRegionSize=65536, vBaseEnvHwRegionStartAddress=4276027392, vBaseEnvHwRegionEccAlignment=4
          vBaseEnvClockSettings: vBaseEnvOscClock=16000000, vBaseEnvPeriphClock=60000000, vBaseEnvTimebaseClock=80000000
        RH850_1587: vBaseEnvCpuMaxFrequency=120000000, vBaseEnvAvailableChannels_Flexray=0, vBaseEnvAvailableChannels_Can=7, vBaseEnvAvailableChannels_Lin=16, vBaseEnvAvailableChannels_Ethernet=0, vBaseEnvCpuCoreAmount=1, vBaseEnvTestedDerivative=RH850_1587, vBaseEnvTestedDerivativeDescription=Renesas RH850 F1K Family R7F701587, vBaseEnvCpuCore=G3KH
          vBaseEnvAdditionalParameters: vBaseEnvClockGroup=A2, vBaseEnvDerivativeGroup=F1K, vBaseEnvPllGroup=A3, vBaseEnvProtectionGroup=A, vBaseEnvPortGroup=A, vBaseEnvResetGroup=A
          7 x vBaseEnvMemLayoutHwRegion:
            CodeFlash_A: vBaseEnvHwRegionSize=2097152, vBaseEnvHwRegionStartAddress=0
            LocalRAM_CPU0: vBaseEnvHwRegionSize=131072, vBaseEnvHwRegionStartAddress=4273799168, vBaseEnvHwRegionEccAlignment=4
            DataFlash: vBaseEnvHwRegionSize=65536, vBaseEnvHwRegionStartAddress=4280287232
            CodeFlash_Ext: vBaseEnvHwRegionSize=32768, vBaseEnvHwRegionStartAddress=16777216
            RetentionRAM: vBaseEnvHwRegionSize=65536, vBaseEnvHwRegionStartAddress=4273930240, vBaseEnvHwRegionEccAlignment=4
            LocalRAM_Self: vBaseEnvHwRegionSize=131072, vBaseEnvHwRegionStartAddress=4275896320, vBaseEnvHwRegionEccAlignment=4
            RetentionRAM_Self: vBaseEnvHwRegionSize=65536, vBaseEnvHwRegionStartAddress=4276027392, vBaseEnvHwRegionEccAlignment=4
          vBaseEnvClockSettings: vBaseEnvOscClock=16000000, vBaseEnvPeriphClock=60000000, vBaseEnvTimebaseClock=80000000
        RH850_1597: vBaseEnvCpuMaxFrequency=120000000, vBaseEnvAvailableChannels_Flexray=0, vBaseEnvAvailableChannels_Can=7, vBaseEnvAvailableChannels_Lin=16, vBaseEnvAvailableChannels_Ethernet=0, vBaseEnvCpuCoreAmount=1, vBaseEnvTestedDerivative=RH850_1597, vBaseEnvTestedDerivativeDescription=Renesas RH850 F1K Family R7F701597, vBaseEnvCpuCore=G3KH
          vBaseEnvAdditionalParameters: vBaseEnvClockGroup=A2, vBaseEnvDerivativeGroup=F1K, vBaseEnvPllGroup=A3, vBaseEnvProtectionGroup=A, vBaseEnvPortGroup=A, vBaseEnvResetGroup=A
          7 x vBaseEnvMemLayoutHwRegion:
            CodeFlash_A: vBaseEnvHwRegionSize=1048576, vBaseEnvHwRegionStartAddress=0
            LocalRAM_CPU0: vBaseEnvHwRegionSize=65536, vBaseEnvHwRegionStartAddress=4273864704, vBaseEnvHwRegionEccAlignment=4
            DataFlash: vBaseEnvHwRegionSize=65536, vBaseEnvHwRegionStartAddress=4280287232
            CodeFlash_Ext: vBaseEnvHwRegionSize=32768, vBaseEnvHwRegionStartAddress=16777216
            RetentionRAM: vBaseEnvHwRegionSize=65536, vBaseEnvHwRegionStartAddress=4273930240, vBaseEnvHwRegionEccAlignment=4
            LocalRAM_Self: vBaseEnvHwRegionSize=65536, vBaseEnvHwRegionStartAddress=4275961856, vBaseEnvHwRegionEccAlignment=4
            RetentionRAM_Self: vBaseEnvHwRegionSize=65536, vBaseEnvHwRegionStartAddress=4276027392, vBaseEnvHwRegionEccAlignment=4
          vBaseEnvClockSettings: vBaseEnvOscClock=16000000, vBaseEnvPeriphClock=60000000, vBaseEnvTimebaseClock=80000000
        RH850_1602: vBaseEnvCpuMaxFrequency=80000000, vBaseEnvAvailableChannels_Flexray=0, vBaseEnvAvailableChannels_Can=6, vBaseEnvAvailableChannels_Lin=12, vBaseEnvAvailableChannels_Ethernet=0, vBaseEnvCpuCoreAmount=1, vBaseEnvTestedDerivative=RH850_1602, vBaseEnvTestedDerivativeDescription=Renesas RH850 F1K Family R7F701602, vBaseEnvCpuCore=G3KH
          vBaseEnvAdditionalParameters: vBaseEnvClockGroup=A2, vBaseEnvDerivativeGroup=F1K, vBaseEnvPllGroup=A3, vBaseEnvProtectionGroup=A, vBaseEnvPortGroup=A, vBaseEnvResetGroup=A
          7 x vBaseEnvMemLayoutHwRegion:
            CodeFlash_A: vBaseEnvHwRegionSize=786432, vBaseEnvHwRegionStartAddress=0
            LocalRAM_CPU0: vBaseEnvHwRegionSize=32768, vBaseEnvHwRegionStartAddress=4273897472, vBaseEnvHwRegionEccAlignment=4
            DataFlash: vBaseEnvHwRegionSize=65536, vBaseEnvHwRegionStartAddress=4280287232
            CodeFlash_Ext: vBaseEnvHwRegionSize=32768, vBaseEnvHwRegionStartAddress=16777216
            RetentionRAM: vBaseEnvHwRegionSize=65536, vBaseEnvHwRegionStartAddress=4273930240, vBaseEnvHwRegionEccAlignment=4
            LocalRAM_Self: vBaseEnvHwRegionSize=32768, vBaseEnvHwRegionStartAddress=4275994624, vBaseEnvHwRegionEccAlignment=4
            RetentionRAM_Self: vBaseEnvHwRegionSize=65536, vBaseEnvHwRegionStartAddress=4276027392, vBaseEnvHwRegionEccAlignment=4
          vBaseEnvClockSettings: vBaseEnvOscClock=16000000, vBaseEnvPeriphClock=60000000, vBaseEnvTimebaseClock=80000000
        RH850_1620: vBaseEnvCpuMaxFrequency=120000000, vBaseEnvAvailableChannels_Flexray=0, vBaseEnvAvailableChannels_Can=6, vBaseEnvAvailableChannels_Lin=7, vBaseEnvAvailableChannels_Ethernet=0, vBaseEnvCpuCoreAmount=1, vBaseEnvTestedDerivative=RH850_1620, vBaseEnvTestedDerivativeDescription=Renesas RH850 F1K Family R7F701620, vBaseEnvCpuCore=G3KH
          vBaseEnvAdditionalParameters: vBaseEnvClockGroup=A2, vBaseEnvDerivativeGroup=F1K, vBaseEnvPllGroup=A3, vBaseEnvProtectionGroup=A, vBaseEnvPortGroup=A, vBaseEnvResetGroup=A
          7 x vBaseEnvMemLayoutHwRegion:
            CodeFlash_A: vBaseEnvHwRegionSize=786432, vBaseEnvHwRegionStartAddress=0
            LocalRAM_CPU0: vBaseEnvHwRegionSize=32768, vBaseEnvHwRegionStartAddress=4273897472, vBaseEnvHwRegionEccAlignment=4
            DataFlash: vBaseEnvHwRegionSize=65536, vBaseEnvHwRegionStartAddress=4280287232
            CodeFlash_Ext: vBaseEnvHwRegionSize=32768, vBaseEnvHwRegionStartAddress=16777216
            RetentionRAM: vBaseEnvHwRegionSize=65536, vBaseEnvHwRegionStartAddress=4273930240, vBaseEnvHwRegionEccAlignment=4
            LocalRAM_Self: vBaseEnvHwRegionSize=32768, vBaseEnvHwRegionStartAddress=4275994624, vBaseEnvHwRegionEccAlignment=4
            RetentionRAM_Self: vBaseEnvHwRegionSize=65536, vBaseEnvHwRegionStartAddress=4276027392, vBaseEnvHwRegionEccAlignment=4
          vBaseEnvClockSettings: vBaseEnvOscClock=16000000, vBaseEnvPeriphClock=60000000, vBaseEnvTimebaseClock=80000000
        RH850_1621: vBaseEnvCpuMaxFrequency=120000000, vBaseEnvAvailableChannels_Flexray=0, vBaseEnvAvailableChannels_Can=6, vBaseEnvAvailableChannels_Lin=7, vBaseEnvAvailableChannels_Ethernet=0, vBaseEnvCpuCoreAmount=1, vBaseEnvTestedDerivative=RH850_1621, vBaseEnvTestedDerivativeDescription=Renesas RH850 F1K Family R7F701621, vBaseEnvCpuCore=G3KH
          vBaseEnvAdditionalParameters: vBaseEnvClockGroup=A2, vBaseEnvDerivativeGroup=F1K, vBaseEnvPllGroup=A3, vBaseEnvProtectionGroup=A, vBaseEnvPortGroup=A, vBaseEnvResetGroup=A
          7 x vBaseEnvMemLayoutHwRegion:
            CodeFlash_A: vBaseEnvHwRegionSize=1048576, vBaseEnvHwRegionStartAddress=0
            LocalRAM_CPU0: vBaseEnvHwRegionSize=65536, vBaseEnvHwRegionStartAddress=4273864704, vBaseEnvHwRegionEccAlignment=4
            DataFlash: vBaseEnvHwRegionSize=65536, vBaseEnvHwRegionStartAddress=4280287232
            CodeFlash_Ext: vBaseEnvHwRegionSize=32768, vBaseEnvHwRegionStartAddress=16777216
            RetentionRAM: vBaseEnvHwRegionSize=65536, vBaseEnvHwRegionStartAddress=4273930240, vBaseEnvHwRegionEccAlignment=4
            LocalRAM_Self: vBaseEnvHwRegionSize=65536, vBaseEnvHwRegionStartAddress=4275961856, vBaseEnvHwRegionEccAlignment=4
            RetentionRAM_Self: vBaseEnvHwRegionSize=65536, vBaseEnvHwRegionStartAddress=4276027392, vBaseEnvHwRegionEccAlignment=4
          vBaseEnvClockSettings: vBaseEnvOscClock=16000000, vBaseEnvPeriphClock=60000000, vBaseEnvTimebaseClock=80000000
        RH850_1623: vBaseEnvCpuMaxFrequency=120000000, vBaseEnvAvailableChannels_Flexray=0, vBaseEnvAvailableChannels_Can=6, vBaseEnvAvailableChannels_Lin=12, vBaseEnvAvailableChannels_Ethernet=0, vBaseEnvCpuCoreAmount=1, vBaseEnvTestedDerivative=RH850_1623, vBaseEnvTestedDerivativeDescription=Renesas RH850 F1K Family R7F701623, vBaseEnvCpuCore=G3KH
          vBaseEnvAdditionalParameters: vBaseEnvClockGroup=A2, vBaseEnvDerivativeGroup=F1K, vBaseEnvPllGroup=A3, vBaseEnvProtectionGroup=A, vBaseEnvPortGroup=A, vBaseEnvResetGroup=A
          7 x vBaseEnvMemLayoutHwRegion:
            CodeFlash_A: vBaseEnvHwRegionSize=1048576, vBaseEnvHwRegionStartAddress=0
            LocalRAM_CPU0: vBaseEnvHwRegionSize=65536, vBaseEnvHwRegionStartAddress=4273864704, vBaseEnvHwRegionEccAlignment=4
            DataFlash: vBaseEnvHwRegionSize=65536, vBaseEnvHwRegionStartAddress=4280287232
            CodeFlash_Ext: vBaseEnvHwRegionSize=32768, vBaseEnvHwRegionStartAddress=16777216
            RetentionRAM: vBaseEnvHwRegionSize=65536, vBaseEnvHwRegionStartAddress=4276027392, vBaseEnvHwRegionEccAlignment=4
            LocalRAM_Self: vBaseEnvHwRegionSize=65536, vBaseEnvHwRegionStartAddress=4275961856, vBaseEnvHwRegionEccAlignment=4
            RetentionRAM_Self: vBaseEnvHwRegionSize=65536, vBaseEnvHwRegionStartAddress=4276027392, vBaseEnvHwRegionEccAlignment=4
          vBaseEnvClockSettings: vBaseEnvOscClock=16000000, vBaseEnvPeriphClock=60000000, vBaseEnvTimebaseClock=80000000
        RH850_1610: vBaseEnvCpuMaxFrequency=120000000, vBaseEnvAvailableChannels_Flexray=0, vBaseEnvAvailableChannels_Can=6, vBaseEnvAvailableChannels_Lin=7, vBaseEnvAvailableChannels_Ethernet=0, vBaseEnvCpuCoreAmount=1, vBaseEnvTestedDerivative=RH850_1610, vBaseEnvTestedDerivativeDescription=Renesas RH850 F1K Family R7F701610, vBaseEnvCpuCore=G3KH
          vBaseEnvAdditionalParameters: vBaseEnvClockGroup=A2, vBaseEnvDerivativeGroup=F1K, vBaseEnvPllGroup=A3, vBaseEnvProtectionGroup=A, vBaseEnvPortGroup=A, vBaseEnvResetGroup=A
          7 x vBaseEnvMemLayoutHwRegion:
            CodeFlash_A: vBaseEnvHwRegionSize=786432, vBaseEnvHwRegionStartAddress=0
            LocalRAM_CPU0: vBaseEnvHwRegionSize=32768, vBaseEnvHwRegionStartAddress=4273897472, vBaseEnvHwRegionEccAlignment=4
            DataFlash: vBaseEnvHwRegionSize=65536, vBaseEnvHwRegionStartAddress=4280287232
            CodeFlash_Ext: vBaseEnvHwRegionSize=32768, vBaseEnvHwRegionStartAddress=16777216
            RetentionRAM: vBaseEnvHwRegionSize=65536, vBaseEnvHwRegionStartAddress=4273930240, vBaseEnvHwRegionEccAlignment=4
            LocalRAM_Self: vBaseEnvHwRegionSize=32768, vBaseEnvHwRegionStartAddress=4275994624, vBaseEnvHwRegionEccAlignment=4
            RetentionRAM_Self: vBaseEnvHwRegionSize=65536, vBaseEnvHwRegionStartAddress=4276027392, vBaseEnvHwRegionEccAlignment=4
          vBaseEnvClockSettings: vBaseEnvOscClock=16000000, vBaseEnvPeriphClock=60000000, vBaseEnvTimebaseClock=80000000
        RH850_1611: vBaseEnvCpuMaxFrequency=120000000, vBaseEnvAvailableChannels_Flexray=0, vBaseEnvAvailableChannels_Can=6, vBaseEnvAvailableChannels_Lin=7, vBaseEnvAvailableChannels_Ethernet=0, vBaseEnvCpuCoreAmount=1, vBaseEnvTestedDerivative=RH850_1611, vBaseEnvTestedDerivativeDescription=Renesas RH850 F1K Family R7F701611, vBaseEnvCpuCore=G3KH
          vBaseEnvAdditionalParameters: vBaseEnvClockGroup=A2, vBaseEnvDerivativeGroup=F1K, vBaseEnvPllGroup=A3, vBaseEnvProtectionGroup=A, vBaseEnvPortGroup=A, vBaseEnvResetGroup=A
          7 x vBaseEnvMemLayoutHwRegion:
            CodeFlash_A: vBaseEnvHwRegionSize=1048576, vBaseEnvHwRegionStartAddress=0
            LocalRAM_CPU0: vBaseEnvHwRegionSize=65536, vBaseEnvHwRegionStartAddress=4273864704, vBaseEnvHwRegionEccAlignment=4
            DataFlash: vBaseEnvHwRegionSize=65536, vBaseEnvHwRegionStartAddress=4280287232
            CodeFlash_Ext: vBaseEnvHwRegionSize=32768, vBaseEnvHwRegionStartAddress=16777216
            RetentionRAM: vBaseEnvHwRegionSize=65536, vBaseEnvHwRegionStartAddress=4273930240, vBaseEnvHwRegionEccAlignment=4
            LocalRAM_Self: vBaseEnvHwRegionSize=65536, vBaseEnvHwRegionStartAddress=4275961856, vBaseEnvHwRegionEccAlignment=4
            RetentionRAM_Self: vBaseEnvHwRegionSize=65536, vBaseEnvHwRegionStartAddress=4276027392, vBaseEnvHwRegionEccAlignment=4
          vBaseEnvClockSettings: vBaseEnvOscClock=16000000, vBaseEnvPeriphClock=60000000, vBaseEnvTimebaseClock=80000000
        RH850_1708: vBaseEnvCpuMaxFrequency=240000000, vBaseEnvAvailableChannels_Flexray=2, vBaseEnvAvailableChannels_Can=8, vBaseEnvAvailableChannels_Lin=18, vBaseEnvAvailableChannels_Ethernet=1, vBaseEnvCpuCoreAmount=2, vBaseEnvTestedDerivative=RH850_1708, vBaseEnvTestedDerivativeDescription=Renesas RH850 F1KH Family R7F701708, vBaseEnvCpuCore=G3KH
          vBaseEnvAdditionalParameters: vBaseEnvClockGroup=A2, vBaseEnvDerivativeGroup=F1KH, vBaseEnvPllGroup=A4, vBaseEnvProtectionGroup=A, vBaseEnvPortGroup=A, vBaseEnvResetGroup=A
          10 x vBaseEnvMemLayoutHwRegion:
            CodeFlash_A: vBaseEnvHwRegionSize=3145728, vBaseEnvHwRegionStartAddress=0
            CodeFlash_B: vBaseEnvHwRegionSize=3145728, vBaseEnvHwRegionStartAddress=8388608
            LocalRAM_CPU0: vBaseEnvHwRegionSize=163840, vBaseEnvHwRegionStartAddress=4273831936, vBaseEnvHwRegionEccAlignment=4
            LocalRAM_CPU1: vBaseEnvHwRegionSize=163840, vBaseEnvHwRegionStartAddress=4271734784, vBaseEnvHwRegionEccAlignment=4
            GlobalRAM_A: vBaseEnvHwRegionSize=262144, vBaseEnvHwRegionStartAddress=4276879360, vBaseEnvHwRegionEccAlignment=4
            GlobalRAM_B: vBaseEnvHwRegionSize=262144, vBaseEnvHwRegionStartAddress=4277927936, vBaseEnvHwRegionEccAlignment=4
            DataFlash: vBaseEnvHwRegionSize=262144, vBaseEnvHwRegionStartAddress=4280287232
            CodeFlash_Ext: vBaseEnvHwRegionSize=32768, vBaseEnvHwRegionStartAddress=16777216
            RetentionRAM: vBaseEnvHwRegionSize=65536, vBaseEnvHwRegionStartAddress=4277141504, vBaseEnvHwRegionEccAlignment=4
            LocalRAM_Self: vBaseEnvHwRegionSize=163840, vBaseEnvHwRegionStartAddress=4275929088, vBaseEnvHwRegionEccAlignment=4
          vBaseEnvClockSettings: vBaseEnvOscClock=16000000, vBaseEnvPeriphClock=60000000, vBaseEnvTimebaseClock=240000000
        RH850_1709: vBaseEnvCpuMaxFrequency=240000000, vBaseEnvAvailableChannels_Flexray=2, vBaseEnvAvailableChannels_Can=8, vBaseEnvAvailableChannels_Lin=18, vBaseEnvAvailableChannels_Ethernet=1, vBaseEnvCpuCoreAmount=2, vBaseEnvTestedDerivative=RH850_1709, vBaseEnvTestedDerivativeDescription=Renesas RH850 F1KH Family R7F701709, vBaseEnvCpuCore=G3KH
          vBaseEnvAdditionalParameters: vBaseEnvClockGroup=A2, vBaseEnvDerivativeGroup=F1KH, vBaseEnvPllGroup=A4, vBaseEnvProtectionGroup=A, vBaseEnvPortGroup=A, vBaseEnvResetGroup=A
          10 x vBaseEnvMemLayoutHwRegion:
            CodeFlash_A: vBaseEnvHwRegionSize=4194304, vBaseEnvHwRegionStartAddress=0
            CodeFlash_B: vBaseEnvHwRegionSize=4194304, vBaseEnvHwRegionStartAddress=8388608
            LocalRAM_CPU0: vBaseEnvHwRegionSize=196608, vBaseEnvHwRegionStartAddress=4273799168, vBaseEnvHwRegionEccAlignment=4
            LocalRAM_CPU1: vBaseEnvHwRegionSize=196608, vBaseEnvHwRegionStartAddress=4271702016, vBaseEnvHwRegionEccAlignment=4
            GlobalRAM_A: vBaseEnvHwRegionSize=294912, vBaseEnvHwRegionStartAddress=4276846592, vBaseEnvHwRegionEccAlignment=4
            GlobalRAM_B: vBaseEnvHwRegionSize=294912, vBaseEnvHwRegionStartAddress=4277895168, vBaseEnvHwRegionEccAlignment=4
            DataFlash: vBaseEnvHwRegionSize=262144, vBaseEnvHwRegionStartAddress=4280287232
            CodeFlash_Ext: vBaseEnvHwRegionSize=32768, vBaseEnvHwRegionStartAddress=16777216
            RetentionRAM: vBaseEnvHwRegionSize=65536, vBaseEnvHwRegionStartAddress=4277141504, vBaseEnvHwRegionEccAlignment=4
            LocalRAM_Self: vBaseEnvHwRegionSize=196608, vBaseEnvHwRegionStartAddress=4275896320, vBaseEnvHwRegionEccAlignment=4
          vBaseEnvClockSettings: vBaseEnvOscClock=16000000, vBaseEnvPeriphClock=60000000, vBaseEnvTimebaseClock=240000000
        RH850_1711: vBaseEnvCpuMaxFrequency=240000000, vBaseEnvAvailableChannels_Flexray=2, vBaseEnvAvailableChannels_Can=8, vBaseEnvAvailableChannels_Lin=20, vBaseEnvAvailableChannels_Ethernet=1, vBaseEnvCpuCoreAmount=2, vBaseEnvTestedDerivative=RH850_1711, vBaseEnvTestedDerivativeDescription=Renesas RH850 F1KH Family R7F701711, vBaseEnvCpuCore=G3KH
          vBaseEnvAdditionalParameters: vBaseEnvClockGroup=A2, vBaseEnvDerivativeGroup=F1KH, vBaseEnvPllGroup=A4, vBaseEnvProtectionGroup=A, vBaseEnvPortGroup=A, vBaseEnvResetGroup=A
          10 x vBaseEnvMemLayoutHwRegion:
            CodeFlash_A: vBaseEnvHwRegionSize=4194304, vBaseEnvHwRegionStartAddress=0
            CodeFlash_B: vBaseEnvHwRegionSize=4194304, vBaseEnvHwRegionStartAddress=8388608
            LocalRAM_CPU0: vBaseEnvHwRegionSize=196608, vBaseEnvHwRegionStartAddress=4273799168, vBaseEnvHwRegionEccAlignment=4
            LocalRAM_CPU1: vBaseEnvHwRegionSize=196608, vBaseEnvHwRegionStartAddress=4271702016, vBaseEnvHwRegionEccAlignment=4
            GlobalRAM_A: vBaseEnvHwRegionSize=294912, vBaseEnvHwRegionStartAddress=4276846592, vBaseEnvHwRegionEccAlignment=4
            GlobalRAM_B: vBaseEnvHwRegionSize=294912, vBaseEnvHwRegionStartAddress=4277895168, vBaseEnvHwRegionEccAlignment=4
            DataFlash: vBaseEnvHwRegionSize=262144, vBaseEnvHwRegionStartAddress=4280287232
            CodeFlash_Ext: vBaseEnvHwRegionSize=32768, vBaseEnvHwRegionStartAddress=16777216
            RetentionRAM: vBaseEnvHwRegionSize=65536, vBaseEnvHwRegionStartAddress=4277141504, vBaseEnvHwRegionEccAlignment=4
            LocalRAM_Self: vBaseEnvHwRegionSize=196608, vBaseEnvHwRegionStartAddress=4275896320, vBaseEnvHwRegionEccAlignment=4
          vBaseEnvClockSettings: vBaseEnvOscClock=16000000, vBaseEnvPeriphClock=60000000, vBaseEnvTimebaseClock=240000000
        RH850_1715: vBaseEnvCpuMaxFrequency=240000000, vBaseEnvAvailableChannels_Flexray=2, vBaseEnvAvailableChannels_Can=12, vBaseEnvAvailableChannels_Lin=24, vBaseEnvAvailableChannels_Ethernet=2, vBaseEnvCpuCoreAmount=2, vBaseEnvTestedDerivative=RH850_1715, vBaseEnvTestedDerivativeDescription=Renesas RH850 F1KH Family R7F701715, vBaseEnvCpuCore=G3KH
          vBaseEnvAdditionalParameters: vBaseEnvClockGroup=A2, vBaseEnvDerivativeGroup=F1KH, vBaseEnvPllGroup=A4, vBaseEnvProtectionGroup=A, vBaseEnvPortGroup=A, vBaseEnvResetGroup=A
          10 x vBaseEnvMemLayoutHwRegion:
            CodeFlash_A: vBaseEnvHwRegionSize=4194304, vBaseEnvHwRegionStartAddress=0
            CodeFlash_B: vBaseEnvHwRegionSize=4194304, vBaseEnvHwRegionStartAddress=8388608
            LocalRAM_CPU0: vBaseEnvHwRegionSize=196608, vBaseEnvHwRegionStartAddress=4273799168, vBaseEnvHwRegionEccAlignment=4
            LocalRAM_CPU1: vBaseEnvHwRegionSize=196608, vBaseEnvHwRegionStartAddress=4271702016, vBaseEnvHwRegionEccAlignment=4
            GlobalRAM_A: vBaseEnvHwRegionSize=294912, vBaseEnvHwRegionStartAddress=4276846592, vBaseEnvHwRegionEccAlignment=4
            GlobalRAM_B: vBaseEnvHwRegionSize=294912, vBaseEnvHwRegionStartAddress=4277895168, vBaseEnvHwRegionEccAlignment=4
            DataFlash: vBaseEnvHwRegionSize=262144, vBaseEnvHwRegionStartAddress=4280287232
            CodeFlash_Ext: vBaseEnvHwRegionSize=32768, vBaseEnvHwRegionStartAddress=16777216
            RetentionRAM: vBaseEnvHwRegionSize=65536, vBaseEnvHwRegionStartAddress=4277141504, vBaseEnvHwRegionEccAlignment=4
            LocalRAM_Self: vBaseEnvHwRegionSize=196608, vBaseEnvHwRegionStartAddress=4275896320, vBaseEnvHwRegionEccAlignment=4
          vBaseEnvClockSettings: vBaseEnvOscClock=16000000, vBaseEnvPeriphClock=60000000, vBaseEnvTimebaseClock=240000000
        RH850_1684: vBaseEnvCpuMaxFrequency=120000000, vBaseEnvAvailableChannels_Flexray=0, vBaseEnvAvailableChannels_Can=6, vBaseEnvAvailableChannels_Lin=7, vBaseEnvAvailableChannels_Ethernet=0, vBaseEnvCpuCoreAmount=1, vBaseEnvTestedDerivative=RH850_1684, vBaseEnvTestedDerivativeDescription=Renesas RH850 F1KM_S1 Family R7F701684, vBaseEnvCpuCore=G3KH
          vBaseEnvAdditionalParameters: vBaseEnvClockGroup=A2, vBaseEnvDerivativeGroup=F1KM_S1, vBaseEnvPllGroup=A3, vBaseEnvProtectionGroup=A, vBaseEnvPortGroup=A, vBaseEnvResetGroup=A
          7 x vBaseEnvMemLayoutHwRegion:
            CodeFlash_A: vBaseEnvHwRegionSize=1048576, vBaseEnvHwRegionStartAddress=0
            LocalRAM_CPU0: vBaseEnvHwRegionSize=98304, vBaseEnvHwRegionStartAddress=4273864704, vBaseEnvHwRegionEccAlignment=4
            DataFlash: vBaseEnvHwRegionSize=65536, vBaseEnvHwRegionStartAddress=4280287232
            CodeFlash_Ext: vBaseEnvHwRegionSize=32768, vBaseEnvHwRegionStartAddress=16777216
            RetentionRAM: vBaseEnvHwRegionSize=32768, vBaseEnvHwRegionStartAddress=4273963008, vBaseEnvHwRegionEccAlignment=4
            LocalRAM_Self: vBaseEnvHwRegionSize=98304, vBaseEnvHwRegionStartAddress=4275961856, vBaseEnvHwRegionEccAlignment=4
            RetentionRAM_Self: vBaseEnvHwRegionSize=32768, vBaseEnvHwRegionStartAddress=4276060160, vBaseEnvHwRegionEccAlignment=4
          vBaseEnvClockSettings: vBaseEnvOscClock=16000000, vBaseEnvPeriphClock=60000000, vBaseEnvTimebaseClock=120000000
        RH850_1685: vBaseEnvCpuMaxFrequency=120000000, vBaseEnvAvailableChannels_Flexray=0, vBaseEnvAvailableChannels_Can=6, vBaseEnvAvailableChannels_Lin=7, vBaseEnvAvailableChannels_Ethernet=0, vBaseEnvCpuCoreAmount=1, vBaseEnvTestedDerivative=RH850_1685, vBaseEnvTestedDerivativeDescription=Renesas RH850 F1KM_S1 Family R7F701685, vBaseEnvCpuCore=G3KH
          vBaseEnvAdditionalParameters: vBaseEnvClockGroup=A2, vBaseEnvDerivativeGroup=F1KM_S1, vBaseEnvPllGroup=A3, vBaseEnvProtectionGroup=A, vBaseEnvPortGroup=A, vBaseEnvResetGroup=A
          7 x vBaseEnvMemLayoutHwRegion:
            CodeFlash_A: vBaseEnvHwRegionSize=786432, vBaseEnvHwRegionStartAddress=0
            LocalRAM_CPU0: vBaseEnvHwRegionSize=65536, vBaseEnvHwRegionStartAddress=4273897472, vBaseEnvHwRegionEccAlignment=4
            DataFlash: vBaseEnvHwRegionSize=65536, vBaseEnvHwRegionStartAddress=4280287232
            CodeFlash_Ext: vBaseEnvHwRegionSize=32768, vBaseEnvHwRegionStartAddress=16777216
            RetentionRAM: vBaseEnvHwRegionSize=32768, vBaseEnvHwRegionStartAddress=4273963008, vBaseEnvHwRegionEccAlignment=4
            RetentionRAM_Self: vBaseEnvHwRegionSize=32768, vBaseEnvHwRegionStartAddress=4276060160, vBaseEnvHwRegionEccAlignment=4
            LocalRAM_Self: vBaseEnvHwRegionSize=65536, vBaseEnvHwRegionStartAddress=4275994624, vBaseEnvHwRegionEccAlignment=4
          vBaseEnvClockSettings: vBaseEnvOscClock=16000000, vBaseEnvPeriphClock=60000000, vBaseEnvTimebaseClock=120000000
        RH850_1686: vBaseEnvCpuMaxFrequency=120000000, vBaseEnvAvailableChannels_Flexray=0, vBaseEnvAvailableChannels_Can=6, vBaseEnvAvailableChannels_Lin=7, vBaseEnvAvailableChannels_Ethernet=0, vBaseEnvCpuCoreAmount=1, vBaseEnvTestedDerivative=RH850_1686, vBaseEnvTestedDerivativeDescription=Renesas RH850 F1KM_S1 Family R7F701686, vBaseEnvCpuCore=G3KH
          vBaseEnvAdditionalParameters: vBaseEnvClockGroup=A2, vBaseEnvDerivativeGroup=F1KM_S1, vBaseEnvPllGroup=A3, vBaseEnvProtectionGroup=A, vBaseEnvPortGroup=A, vBaseEnvResetGroup=A
          7 x vBaseEnvMemLayoutHwRegion:
            CodeFlash_A: vBaseEnvHwRegionSize=524288, vBaseEnvHwRegionStartAddress=0
            LocalRAM_CPU0: vBaseEnvHwRegionSize=32768, vBaseEnvHwRegionStartAddress=4273930240, vBaseEnvHwRegionEccAlignment=4
            DataFlash: vBaseEnvHwRegionSize=65536, vBaseEnvHwRegionStartAddress=4280287232
            CodeFlash_Ext: vBaseEnvHwRegionSize=32768, vBaseEnvHwRegionStartAddress=16777216
            RetentionRAM: vBaseEnvHwRegionSize=32768, vBaseEnvHwRegionStartAddress=4273963008, vBaseEnvHwRegionEccAlignment=4
            LocalRAM_Self: vBaseEnvHwRegionSize=32768, vBaseEnvHwRegionStartAddress=4276027392, vBaseEnvHwRegionEccAlignment=4
            RetentionRAM_Self: vBaseEnvHwRegionSize=32768, vBaseEnvHwRegionStartAddress=4276060160, vBaseEnvHwRegionEccAlignment=4
          vBaseEnvClockSettings: vBaseEnvOscClock=16000000, vBaseEnvPeriphClock=60000000, vBaseEnvTimebaseClock=120000000
        RH850_1687: vBaseEnvCpuMaxFrequency=120000000, vBaseEnvAvailableChannels_Flexray=0, vBaseEnvAvailableChannels_Can=3, vBaseEnvAvailableChannels_Lin=5, vBaseEnvAvailableChannels_Ethernet=0, vBaseEnvCpuCoreAmount=1, vBaseEnvTestedDerivative=RH850_1687, vBaseEnvTestedDerivativeDescription=Renesas RH850 F1KM_S1 Family R7F701687, vBaseEnvCpuCore=G3KH
          vBaseEnvAdditionalParameters: vBaseEnvClockGroup=A2, vBaseEnvDerivativeGroup=F1KM_S1, vBaseEnvPllGroup=A3, vBaseEnvProtectionGroup=A, vBaseEnvPortGroup=A, vBaseEnvResetGroup=A
          7 x vBaseEnvMemLayoutHwRegion:
            CodeFlash_A: vBaseEnvHwRegionSize=1048576, vBaseEnvHwRegionStartAddress=0
            LocalRAM_CPU0: vBaseEnvHwRegionSize=98304, vBaseEnvHwRegionStartAddress=4273864704, vBaseEnvHwRegionEccAlignment=4
            DataFlash: vBaseEnvHwRegionSize=65536, vBaseEnvHwRegionStartAddress=4280287232
            CodeFlash_Ext: vBaseEnvHwRegionSize=32768, vBaseEnvHwRegionStartAddress=16777216
            RetentionRAM: vBaseEnvHwRegionSize=32768, vBaseEnvHwRegionStartAddress=4273963008, vBaseEnvHwRegionEccAlignment=4
            LocalRAM_Self: vBaseEnvHwRegionSize=98304, vBaseEnvHwRegionStartAddress=4275961856, vBaseEnvHwRegionEccAlignment=4
            RetentionRAM_Self: vBaseEnvHwRegionSize=32768, vBaseEnvHwRegionStartAddress=4276060160, vBaseEnvHwRegionEccAlignment=4
          vBaseEnvClockSettings: vBaseEnvOscClock=16000000, vBaseEnvPeriphClock=60000000, vBaseEnvTimebaseClock=120000000
        RH850_1688: vBaseEnvCpuMaxFrequency=120000000, vBaseEnvAvailableChannels_Flexray=0, vBaseEnvAvailableChannels_Can=3, vBaseEnvAvailableChannels_Lin=5, vBaseEnvAvailableChannels_Ethernet=0, vBaseEnvCpuCoreAmount=1, vBaseEnvTestedDerivative=RH850_1688, vBaseEnvTestedDerivativeDescription=Renesas RH850 F1KM_S1 Family R7F701688, vBaseEnvCpuCore=G3KH
          vBaseEnvAdditionalParameters: vBaseEnvClockGroup=A2, vBaseEnvDerivativeGroup=F1KM_S1, vBaseEnvPllGroup=A3, vBaseEnvProtectionGroup=A, vBaseEnvPortGroup=A, vBaseEnvResetGroup=A
          7 x vBaseEnvMemLayoutHwRegion:
            CodeFlash_A: vBaseEnvHwRegionSize=786432, vBaseEnvHwRegionStartAddress=0
            LocalRAM_CPU0: vBaseEnvHwRegionSize=65536, vBaseEnvHwRegionStartAddress=4273897472, vBaseEnvHwRegionEccAlignment=4
            DataFlash: vBaseEnvHwRegionSize=65536, vBaseEnvHwRegionStartAddress=4280287232
            CodeFlash_Ext: vBaseEnvHwRegionSize=32768, vBaseEnvHwRegionStartAddress=16777216
            RetentionRAM: vBaseEnvHwRegionSize=32768, vBaseEnvHwRegionStartAddress=4273963008, vBaseEnvHwRegionEccAlignment=4
            RetentionRAM_Self: vBaseEnvHwRegionSize=32768, vBaseEnvHwRegionStartAddress=4276060160, vBaseEnvHwRegionEccAlignment=4
            LocalRAM_Self: vBaseEnvHwRegionSize=65536, vBaseEnvHwRegionStartAddress=4275994624, vBaseEnvHwRegionEccAlignment=4
          vBaseEnvClockSettings: vBaseEnvOscClock=16000000, vBaseEnvPeriphClock=60000000, vBaseEnvTimebaseClock=120000000
        RH850_1689: vBaseEnvCpuMaxFrequency=120000000, vBaseEnvAvailableChannels_Flexray=0, vBaseEnvAvailableChannels_Can=3, vBaseEnvAvailableChannels_Lin=5, vBaseEnvAvailableChannels_Ethernet=0, vBaseEnvCpuCoreAmount=1, vBaseEnvTestedDerivative=RH850_1689, vBaseEnvTestedDerivativeDescription=Renesas RH850 F1KM_S1 Family R7F701689, vBaseEnvCpuCore=G3KH
          vBaseEnvAdditionalParameters: vBaseEnvClockGroup=A2, vBaseEnvDerivativeGroup=F1KM_S1, vBaseEnvPllGroup=A3, vBaseEnvProtectionGroup=A, vBaseEnvPortGroup=A, vBaseEnvResetGroup=A
          7 x vBaseEnvMemLayoutHwRegion:
            CodeFlash_A: vBaseEnvHwRegionSize=524288, vBaseEnvHwRegionStartAddress=0
            LocalRAM_CPU0: vBaseEnvHwRegionSize=32768, vBaseEnvHwRegionStartAddress=4273930240, vBaseEnvHwRegionEccAlignment=4
            DataFlash: vBaseEnvHwRegionSize=65536, vBaseEnvHwRegionStartAddress=4280287232
            CodeFlash_Ext: vBaseEnvHwRegionSize=32768, vBaseEnvHwRegionStartAddress=16777216
            RetentionRAM: vBaseEnvHwRegionSize=32768, vBaseEnvHwRegionStartAddress=4273963008, vBaseEnvHwRegionEccAlignment=4
            LocalRAM_Self: vBaseEnvHwRegionSize=32768, vBaseEnvHwRegionStartAddress=4276027392, vBaseEnvHwRegionEccAlignment=4
            RetentionRAM_Self: vBaseEnvHwRegionSize=32768, vBaseEnvHwRegionStartAddress=4276060160, vBaseEnvHwRegionEccAlignment=4
          vBaseEnvClockSettings: vBaseEnvOscClock=16000000, vBaseEnvPeriphClock=60000000, vBaseEnvTimebaseClock=120000000
        RH850_1690: vBaseEnvCpuMaxFrequency=120000000, vBaseEnvAvailableChannels_Flexray=0, vBaseEnvAvailableChannels_Can=3, vBaseEnvAvailableChannels_Lin=4, vBaseEnvAvailableChannels_Ethernet=0, vBaseEnvCpuCoreAmount=1, vBaseEnvTestedDerivative=RH850_1690, vBaseEnvTestedDerivativeDescription=Renesas RH850 F1KM_S1 Family R7F701690, vBaseEnvCpuCore=G3KH
          vBaseEnvAdditionalParameters: vBaseEnvClockGroup=A2, vBaseEnvDerivativeGroup=F1KM_S1, vBaseEnvPllGroup=A3, vBaseEnvProtectionGroup=A, vBaseEnvPortGroup=A, vBaseEnvResetGroup=A
          7 x vBaseEnvMemLayoutHwRegion:
            CodeFlash_A: vBaseEnvHwRegionSize=1048576, vBaseEnvHwRegionStartAddress=0
            LocalRAM_CPU0: vBaseEnvHwRegionSize=98304, vBaseEnvHwRegionStartAddress=4273864704, vBaseEnvHwRegionEccAlignment=4
            DataFlash: vBaseEnvHwRegionSize=65536, vBaseEnvHwRegionStartAddress=4280287232
            CodeFlash_Ext: vBaseEnvHwRegionSize=32768, vBaseEnvHwRegionStartAddress=16777216
            RetentionRAM: vBaseEnvHwRegionSize=32768, vBaseEnvHwRegionStartAddress=4273963008, vBaseEnvHwRegionEccAlignment=4
            LocalRAM_Self: vBaseEnvHwRegionSize=98304, vBaseEnvHwRegionStartAddress=4275961856, vBaseEnvHwRegionEccAlignment=4
            RetentionRAM_Self: vBaseEnvHwRegionSize=32768, vBaseEnvHwRegionStartAddress=4276060160, vBaseEnvHwRegionEccAlignment=4
          vBaseEnvClockSettings: vBaseEnvOscClock=16000000, vBaseEnvPeriphClock=60000000, vBaseEnvTimebaseClock=120000000
        RH850_1691: vBaseEnvCpuMaxFrequency=120000000, vBaseEnvAvailableChannels_Flexray=0, vBaseEnvAvailableChannels_Can=3, vBaseEnvAvailableChannels_Lin=4, vBaseEnvAvailableChannels_Ethernet=0, vBaseEnvCpuCoreAmount=1, vBaseEnvTestedDerivative=RH850_1691, vBaseEnvTestedDerivativeDescription=Renesas RH850 F1KM_S1 Family R7F701691, vBaseEnvCpuCore=G3KH
          vBaseEnvAdditionalParameters: vBaseEnvClockGroup=A2, vBaseEnvDerivativeGroup=F1KM_S1, vBaseEnvPllGroup=A3, vBaseEnvProtectionGroup=A, vBaseEnvPortGroup=A, vBaseEnvResetGroup=A
          7 x vBaseEnvMemLayoutHwRegion:
            CodeFlash_A: vBaseEnvHwRegionSize=786432, vBaseEnvHwRegionStartAddress=0
            LocalRAM_CPU0: vBaseEnvHwRegionSize=65536, vBaseEnvHwRegionStartAddress=4273897472, vBaseEnvHwRegionEccAlignment=4
            DataFlash: vBaseEnvHwRegionSize=65536, vBaseEnvHwRegionStartAddress=4280287232
            CodeFlash_Ext: vBaseEnvHwRegionSize=32768, vBaseEnvHwRegionStartAddress=16777216
            RetentionRAM: vBaseEnvHwRegionSize=32768, vBaseEnvHwRegionStartAddress=4273963008, vBaseEnvHwRegionEccAlignment=4
            RetentionRAM_Self: vBaseEnvHwRegionSize=32768, vBaseEnvHwRegionStartAddress=4276060160, vBaseEnvHwRegionEccAlignment=4
            LocalRAM_Self: vBaseEnvHwRegionSize=65536, vBaseEnvHwRegionStartAddress=4275994624, vBaseEnvHwRegionEccAlignment=4
          vBaseEnvClockSettings: vBaseEnvOscClock=16000000, vBaseEnvPeriphClock=60000000, vBaseEnvTimebaseClock=120000000
        RH850_1692: vBaseEnvCpuMaxFrequency=120000000, vBaseEnvAvailableChannels_Flexray=0, vBaseEnvAvailableChannels_Can=3, vBaseEnvAvailableChannels_Lin=4, vBaseEnvAvailableChannels_Ethernet=0, vBaseEnvCpuCoreAmount=1, vBaseEnvTestedDerivative=RH850_1692, vBaseEnvTestedDerivativeDescription=Renesas RH850 F1KM_S1 Family R7F701692, vBaseEnvCpuCore=G3KH
          vBaseEnvAdditionalParameters: vBaseEnvClockGroup=A2, vBaseEnvDerivativeGroup=F1KM_S1, vBaseEnvPllGroup=A3, vBaseEnvProtectionGroup=A, vBaseEnvPortGroup=A, vBaseEnvResetGroup=A
          7 x vBaseEnvMemLayoutHwRegion:
            CodeFlash_A: vBaseEnvHwRegionSize=524288, vBaseEnvHwRegionStartAddress=0
            LocalRAM_CPU0: vBaseEnvHwRegionSize=32768, vBaseEnvHwRegionStartAddress=4273930240, vBaseEnvHwRegionEccAlignment=4
            DataFlash: vBaseEnvHwRegionSize=65536, vBaseEnvHwRegionStartAddress=4280287232
            CodeFlash_Ext: vBaseEnvHwRegionSize=32768, vBaseEnvHwRegionStartAddress=16777216
            RetentionRAM: vBaseEnvHwRegionSize=32768, vBaseEnvHwRegionStartAddress=4273963008, vBaseEnvHwRegionEccAlignment=4
            LocalRAM_Self: vBaseEnvHwRegionSize=32768, vBaseEnvHwRegionStartAddress=4276027392, vBaseEnvHwRegionEccAlignment=4
            RetentionRAM_Self: vBaseEnvHwRegionSize=32768, vBaseEnvHwRegionStartAddress=4276027392, vBaseEnvHwRegionEccAlignment=4
          vBaseEnvClockSettings: vBaseEnvOscClock=16000000, vBaseEnvPeriphClock=60000000, vBaseEnvTimebaseClock=120000000
        RH850_1693: vBaseEnvCpuMaxFrequency=120000000, vBaseEnvAvailableChannels_Flexray=0, vBaseEnvAvailableChannels_Can=1, vBaseEnvAvailableChannels_Lin=1, vBaseEnvAvailableChannels_Ethernet=0, vBaseEnvCpuCoreAmount=1, vBaseEnvTestedDerivative=RH850_1693, vBaseEnvTestedDerivativeDescription=Renesas RH850 F1KM_S1 Family R7F701693, vBaseEnvCpuCore=G3KH
          vBaseEnvAdditionalParameters: vBaseEnvClockGroup=A2, vBaseEnvDerivativeGroup=F1KM_S1, vBaseEnvPllGroup=A3, vBaseEnvProtectionGroup=A, vBaseEnvPortGroup=A, vBaseEnvResetGroup=A
          7 x vBaseEnvMemLayoutHwRegion:
            CodeFlash_A: vBaseEnvHwRegionSize=1048576, vBaseEnvHwRegionStartAddress=0
            LocalRAM_CPU0: vBaseEnvHwRegionSize=98304, vBaseEnvHwRegionStartAddress=4273864704, vBaseEnvHwRegionEccAlignment=4
            DataFlash: vBaseEnvHwRegionSize=65536, vBaseEnvHwRegionStartAddress=4280287232
            CodeFlash_Ext: vBaseEnvHwRegionSize=32768, vBaseEnvHwRegionStartAddress=16777216
            RetentionRAM: vBaseEnvHwRegionSize=32768, vBaseEnvHwRegionStartAddress=4273963008, vBaseEnvHwRegionEccAlignment=4
            LocalRAM_Self: vBaseEnvHwRegionSize=98304, vBaseEnvHwRegionStartAddress=4275961856, vBaseEnvHwRegionEccAlignment=4
            RetentionRAM_Self: vBaseEnvHwRegionSize=32768, vBaseEnvHwRegionStartAddress=4276060160, vBaseEnvHwRegionEccAlignment=4
          vBaseEnvClockSettings: vBaseEnvOscClock=16000000, vBaseEnvPeriphClock=60000000, vBaseEnvTimebaseClock=120000000
        RH850_1694: vBaseEnvAvailableChannels_Can=1, vBaseEnvAvailableChannels_Ethernet=0, vBaseEnvAvailableChannels_Flexray=0, vBaseEnvAvailableChannels_Lin=1, vBaseEnvCpuCore=G3KH, vBaseEnvCpuCoreAmount=1, vBaseEnvTestedDerivative=RH850_1694, vBaseEnvTestedDerivativeDescription=Renesas RH850 F1KM_S1 Family R7F701694, vBaseEnvCpuMaxFrequency=120000000
          vBaseEnvAdditionalParameters: vBaseEnvClockGroup=A2, vBaseEnvDerivativeGroup=F1KM_S1, vBaseEnvPllGroup=A3, vBaseEnvPortGroup=A, vBaseEnvProtectionGroup=A, vBaseEnvResetGroup=A
          7 x vBaseEnvMemLayoutHwRegion:
            CodeFlash_A: vBaseEnvHwRegionSize=786432, vBaseEnvHwRegionStartAddress=0
            LocalRAM_CPU0: vBaseEnvHwRegionSize=65536, vBaseEnvHwRegionStartAddress=4273897472, vBaseEnvHwRegionEccAlignment=4
            DataFlash: vBaseEnvHwRegionSize=65536, vBaseEnvHwRegionStartAddress=4280287232
            CodeFlash_Ext: vBaseEnvHwRegionStartAddress=16777216, vBaseEnvHwRegionSize=32768
            RetentionRAM: vBaseEnvHwRegionSize=32768, vBaseEnvHwRegionStartAddress=4273963008, vBaseEnvHwRegionEccAlignment=4
            LocalRAM_Self: vBaseEnvHwRegionSize=65536, vBaseEnvHwRegionStartAddress=4275994624, vBaseEnvHwRegionEccAlignment=4
            RetentionRAM_Self: vBaseEnvHwRegionSize=32768, vBaseEnvHwRegionStartAddress=4276060160, vBaseEnvHwRegionEccAlignment=4
          vBaseEnvClockSettings: vBaseEnvOscClock=16000000, vBaseEnvPeriphClock=60000000, vBaseEnvTimebaseClock=120000000
        RH850_1695: vBaseEnvAvailableChannels_Can=1, vBaseEnvAvailableChannels_Ethernet=0, vBaseEnvAvailableChannels_Flexray=0, vBaseEnvAvailableChannels_Lin=1, vBaseEnvCpuCore=G3KH, vBaseEnvCpuCoreAmount=1, vBaseEnvCpuMaxFrequency=120000000, vBaseEnvTestedDerivative=RH850_1695, vBaseEnvTestedDerivativeDescription=Renesas RH850 F1KM_S1 Family R7F701695
          vBaseEnvAdditionalParameters: vBaseEnvClockGroup=A2, vBaseEnvDerivativeGroup=F1KM_S1, vBaseEnvPllGroup=A3, vBaseEnvPortGroup=A, vBaseEnvProtectionGroup=A, vBaseEnvResetGroup=A
          7 x vBaseEnvMemLayoutHwRegion:
            CodeFlash_A: vBaseEnvHwRegionSize=524288, vBaseEnvHwRegionStartAddress=0
            LocalRAM_CPU0: vBaseEnvHwRegionSize=32768, vBaseEnvHwRegionStartAddress=4273930240, vBaseEnvHwRegionEccAlignment=4
            DataFlash: vBaseEnvHwRegionSize=65536, vBaseEnvHwRegionStartAddress=4280287232
            CodeFlash_Ext: vBaseEnvHwRegionSize=32768, vBaseEnvHwRegionStartAddress=16777216
            RetentionRAM: vBaseEnvHwRegionSize=32768, vBaseEnvHwRegionStartAddress=4273963008, vBaseEnvHwRegionEccAlignment=4
            LocalRAM_Self: vBaseEnvHwRegionSize=32768, vBaseEnvHwRegionStartAddress=4276027392, vBaseEnvHwRegionEccAlignment=4
            RetentionRAM_Self: vBaseEnvHwRegionSize=32768, vBaseEnvHwRegionStartAddress=4276060160, vBaseEnvHwRegionEccAlignment=4
          vBaseEnvClockSettings: vBaseEnvOscClock=16000000, vBaseEnvPeriphClock=60000000, vBaseEnvTimebaseClock=120000000
        RH850_1638: vBaseEnvCpuMaxFrequency=160000000, vBaseEnvAvailableChannels_Flexray=2, vBaseEnvAvailableChannels_Can=8, vBaseEnvAvailableChannels_Lin=18, vBaseEnvAvailableChannels_Ethernet=1, vBaseEnvCpuCoreAmount=1, vBaseEnvTestedDerivative=RH850_1638, vBaseEnvTestedDerivativeDescription=Renesas RH850 F1KM_S4 Family R7F701638, vBaseEnvCpuCore=G3KH
          vBaseEnvAdditionalParameters: vBaseEnvClockGroup=A2, vBaseEnvDerivativeGroup=F1KM_S4, vBaseEnvPllGroup=A4, vBaseEnvProtectionGroup=A, vBaseEnvPortGroup=A, vBaseEnvResetGroup=A
          8 x vBaseEnvMemLayoutHwRegion:
            CodeFlash_A: vBaseEnvHwRegionSize=3145728, vBaseEnvHwRegionStartAddress=0
            LocalRAM_CPU0: vBaseEnvHwRegionSize=196608, vBaseEnvHwRegionStartAddress=4273799168, vBaseEnvHwRegionEccAlignment=4
            GlobalRAM_A: vBaseEnvHwRegionSize=49152, vBaseEnvHwRegionStartAddress=4277092352, vBaseEnvHwRegionEccAlignment=4
            GlobalRAM_B: vBaseEnvHwRegionSize=49152, vBaseEnvHwRegionStartAddress=4278140928, vBaseEnvHwRegionEccAlignment=4
            DataFlash: vBaseEnvHwRegionSize=98304, vBaseEnvHwRegionStartAddress=4280287232
            CodeFlash_Ext: vBaseEnvHwRegionSize=32768, vBaseEnvHwRegionStartAddress=16777216
            RetentionRAM: vBaseEnvHwRegionSize=65536, vBaseEnvHwRegionStartAddress=4277141504, vBaseEnvHwRegionEccAlignment=4
            LocalRAM_Self: vBaseEnvHwRegionSize=163840, vBaseEnvHwRegionStartAddress=4275929088, vBaseEnvHwRegionEccAlignment=4
          vBaseEnvClockSettings: vBaseEnvOscClock=16000000, vBaseEnvPeriphClock=40000000, vBaseEnvTimebaseClock=160000000
        RH850_1639: vBaseEnvCpuMaxFrequency=160000000, vBaseEnvAvailableChannels_Flexray=2, vBaseEnvAvailableChannels_Can=8, vBaseEnvAvailableChannels_Lin=18, vBaseEnvAvailableChannels_Ethernet=1, vBaseEnvCpuCoreAmount=1, vBaseEnvTestedDerivative=RH850_1639, vBaseEnvTestedDerivativeDescription=Renesas RH850 F1KM_S4 Family R7F701639, vBaseEnvCpuCore=G3KH
          vBaseEnvAdditionalParameters: vBaseEnvClockGroup=A2, vBaseEnvDerivativeGroup=F1KM_S4, vBaseEnvPllGroup=A4, vBaseEnvProtectionGroup=A, vBaseEnvPortGroup=A, vBaseEnvResetGroup=A
          8 x vBaseEnvMemLayoutHwRegion:
            CodeFlash_A: vBaseEnvHwRegionSize=4194304, vBaseEnvHwRegionStartAddress=0
            LocalRAM_CPU0: vBaseEnvHwRegionSize=262144, vBaseEnvHwRegionStartAddress=4273733632, vBaseEnvHwRegionEccAlignment=4
            GlobalRAM_A: vBaseEnvHwRegionSize=65536, vBaseEnvHwRegionStartAddress=4277075968, vBaseEnvHwRegionEccAlignment=4
            GlobalRAM_B: vBaseEnvHwRegionSize=65536, vBaseEnvHwRegionStartAddress=4278124544, vBaseEnvHwRegionEccAlignment=4
            DataFlash: vBaseEnvHwRegionSize=131072, vBaseEnvHwRegionStartAddress=4280287232
            CodeFlash_Ext: vBaseEnvHwRegionSize=32768, vBaseEnvHwRegionStartAddress=16777216
            RetentionRAM: vBaseEnvHwRegionSize=65536, vBaseEnvHwRegionStartAddress=4277141504, vBaseEnvHwRegionEccAlignment=4
            LocalRAM_Self: vBaseEnvHwRegionSize=262144, vBaseEnvHwRegionStartAddress=4275830784, vBaseEnvHwRegionEccAlignment=4
          vBaseEnvClockSettings: vBaseEnvOscClock=16000000, vBaseEnvPeriphClock=40000000, vBaseEnvTimebaseClock=160000000
        RH850_1644: vBaseEnvCpuMaxFrequency=240000000, vBaseEnvAvailableChannels_Flexray=2, vBaseEnvAvailableChannels_Can=8, vBaseEnvAvailableChannels_Lin=6, vBaseEnvAvailableChannels_Ethernet=0, vBaseEnvCpuCoreAmount=1, vBaseEnvTestedDerivative=RH850_1644, vBaseEnvTestedDerivativeDescription=Renesas RH850 F1KM_S4 Family R7F701644, vBaseEnvCpuCore=G3KH
          vBaseEnvAdditionalParameters: vBaseEnvClockGroup=A2, vBaseEnvDerivativeGroup=F1KM_S4, vBaseEnvPllGroup=A4, vBaseEnvProtectionGroup=A, vBaseEnvPortGroup=A, vBaseEnvResetGroup=A
          8 x vBaseEnvMemLayoutHwRegion:
            CodeFlash_A: vBaseEnvHwRegionSize=3145728, vBaseEnvHwRegionStartAddress=0
            LocalRAM_CPU0: vBaseEnvHwRegionSize=196608, vBaseEnvHwRegionStartAddress=4273799168, vBaseEnvHwRegionEccAlignment=4
            GlobalRAM_A: vBaseEnvHwRegionSize=65536, vBaseEnvHwRegionStartAddress=4277075968, vBaseEnvHwRegionEccAlignment=4
            GlobalRAM_B: vBaseEnvHwRegionSize=65536, vBaseEnvHwRegionStartAddress=4278124544, vBaseEnvHwRegionEccAlignment=4
            DataFlash: vBaseEnvHwRegionSize=131072, vBaseEnvHwRegionStartAddress=4280287232
            CodeFlash_Ext: vBaseEnvHwRegionSize=32768, vBaseEnvHwRegionStartAddress=16777216
            RetentionRAM: vBaseEnvHwRegionSize=65536, vBaseEnvHwRegionStartAddress=4277141504, vBaseEnvHwRegionEccAlignment=4
            LocalRAM_Self: vBaseEnvHwRegionSize=196608, vBaseEnvHwRegionStartAddress=4275896320, vBaseEnvHwRegionEccAlignment=4
          vBaseEnvClockSettings: vBaseEnvOscClock=16000000, vBaseEnvPeriphClock=40000000, vBaseEnvTimebaseClock=160000000
        RH850_1647: vBaseEnvCpuMaxFrequency=240000000, vBaseEnvAvailableChannels_Flexray=2, vBaseEnvAvailableChannels_Can=8, vBaseEnvAvailableChannels_Lin=12, vBaseEnvAvailableChannels_Ethernet=0, vBaseEnvCpuCoreAmount=1, vBaseEnvTestedDerivative=RH850_1647, vBaseEnvTestedDerivativeDescription=Renesas RH850 F1KM_S4 Family R7F701647, vBaseEnvCpuCore=G3KH
          vBaseEnvAdditionalParameters: vBaseEnvClockGroup=A2, vBaseEnvDerivativeGroup=F1KM_S4, vBaseEnvPllGroup=A4, vBaseEnvProtectionGroup=A, vBaseEnvPortGroup=A, vBaseEnvResetGroup=A
          8 x vBaseEnvMemLayoutHwRegion:
            CodeFlash_A: vBaseEnvHwRegionSize=4194304, vBaseEnvHwRegionStartAddress=0
            LocalRAM_CPU0: vBaseEnvHwRegionSize=262144, vBaseEnvHwRegionStartAddress=4273733632, vBaseEnvHwRegionEccAlignment=4
            GlobalRAM_A: vBaseEnvHwRegionSize=98304, vBaseEnvHwRegionStartAddress=4277043200, vBaseEnvHwRegionEccAlignment=4
            GlobalRAM_B: vBaseEnvHwRegionSize=98304, vBaseEnvHwRegionStartAddress=4278091776, vBaseEnvHwRegionEccAlignment=4
            DataFlash: vBaseEnvHwRegionSize=131072, vBaseEnvHwRegionStartAddress=4280287232
            CodeFlash_Ext: vBaseEnvHwRegionSize=32768, vBaseEnvHwRegionStartAddress=1048576
            RetentionRAM: vBaseEnvHwRegionSize=65536, vBaseEnvHwRegionStartAddress=4277141504, vBaseEnvHwRegionEccAlignment=4
            LocalRAM_Self: vBaseEnvHwRegionSize=262144, vBaseEnvHwRegionStartAddress=4275830784, vBaseEnvHwRegionEccAlignment=4
          vBaseEnvClockSettings: vBaseEnvOscClock=16000000, vBaseEnvPeriphClock=40000000, vBaseEnvTimebaseClock=160000000
        RH850_1646: vBaseEnvCpuMaxFrequency=240000000, vBaseEnvAvailableChannels_Flexray=2, vBaseEnvAvailableChannels_Can=8, vBaseEnvAvailableChannels_Lin=18, vBaseEnvAvailableChannels_Ethernet=0, vBaseEnvCpuCoreAmount=1, vBaseEnvTestedDerivative=RH850_1646, vBaseEnvTestedDerivativeDescription=Renesas RH850 F1KM_S4 Family R7F701646, vBaseEnvCpuCore=G3KH
          vBaseEnvAdditionalParameters: vBaseEnvClockGroup=A2, vBaseEnvDerivativeGroup=F1KM_S4, vBaseEnvPllGroup=A4, vBaseEnvProtectionGroup=A, vBaseEnvPortGroup=A, vBaseEnvResetGroup=A
          8 x vBaseEnvMemLayoutHwRegion:
            CodeFlash_A: vBaseEnvHwRegionSize=3145728, vBaseEnvHwRegionStartAddress=0
            LocalRAM_CPU0: vBaseEnvHwRegionSize=196608, vBaseEnvHwRegionStartAddress=4273799168, vBaseEnvHwRegionEccAlignment=4
            GlobalRAM_A: vBaseEnvHwRegionSize=65536, vBaseEnvHwRegionStartAddress=4277075968, vBaseEnvHwRegionEccAlignment=4
            GlobalRAM_B: vBaseEnvHwRegionSize=65536, vBaseEnvHwRegionStartAddress=4278124544, vBaseEnvHwRegionEccAlignment=4
            DataFlash: vBaseEnvHwRegionSize=131072, vBaseEnvHwRegionStartAddress=4280287232
            CodeFlash_Ext: vBaseEnvHwRegionSize=32768, vBaseEnvHwRegionStartAddress=16777216
            RetentionRAM: vBaseEnvHwRegionSize=65536, vBaseEnvHwRegionStartAddress=4277141504, vBaseEnvHwRegionEccAlignment=4
            LocalRAM_Self: vBaseEnvHwRegionSize=262144, vBaseEnvHwRegionStartAddress=4275896320, vBaseEnvHwRegionEccAlignment=4
          vBaseEnvClockSettings: vBaseEnvOscClock=16000000, vBaseEnvPeriphClock=40000000, vBaseEnvTimebaseClock=160000000
        RH850_1648: vBaseEnvCpuMaxFrequency=240000000, vBaseEnvAvailableChannels_Flexray=2, vBaseEnvAvailableChannels_Can=8, vBaseEnvAvailableChannels_Lin=18, vBaseEnvAvailableChannels_Ethernet=1, vBaseEnvCpuCoreAmount=1, vBaseEnvTestedDerivative=RH850_1648, vBaseEnvTestedDerivativeDescription=Renesas RH850 F1KM_S4 Family R7F701648, vBaseEnvCpuCore=G3KH
          vBaseEnvAdditionalParameters: vBaseEnvClockGroup=A2, vBaseEnvDerivativeGroup=F1KM_S4, vBaseEnvPllGroup=A4, vBaseEnvProtectionGroup=A, vBaseEnvPortGroup=A, vBaseEnvResetGroup=A
          8 x vBaseEnvMemLayoutHwRegion:
            CodeFlash_A: vBaseEnvHwRegionSize=3145728, vBaseEnvHwRegionStartAddress=0
            LocalRAM_CPU0: vBaseEnvHwRegionSize=196608, vBaseEnvHwRegionStartAddress=4273799168, vBaseEnvHwRegionEccAlignment=4
            GlobalRAM_A: vBaseEnvHwRegionSize=65536, vBaseEnvHwRegionStartAddress=4277075968, vBaseEnvHwRegionEccAlignment=4
            GlobalRAM_B: vBaseEnvHwRegionSize=65536, vBaseEnvHwRegionStartAddress=4278124544, vBaseEnvHwRegionEccAlignment=4
            DataFlash: vBaseEnvHwRegionSize=131072, vBaseEnvHwRegionStartAddress=4280287232
            CodeFlash_Ext: vBaseEnvHwRegionSize=32768, vBaseEnvHwRegionStartAddress=16777216
            RetentionRAM: vBaseEnvHwRegionSize=65536, vBaseEnvHwRegionStartAddress=4277141504, vBaseEnvHwRegionEccAlignment=4
            LocalRAM_Self: vBaseEnvHwRegionSize=196608, vBaseEnvHwRegionStartAddress=4275896320, vBaseEnvHwRegionEccAlignment=4
          vBaseEnvClockSettings: vBaseEnvOscClock=16000000, vBaseEnvPeriphClock=40000000, vBaseEnvTimebaseClock=160000000
        RH850_1649: vBaseEnvCpuMaxFrequency=240000000, vBaseEnvAvailableChannels_Flexray=2, vBaseEnvAvailableChannels_Can=8, vBaseEnvAvailableChannels_Lin=18, vBaseEnvAvailableChannels_Ethernet=1, vBaseEnvCpuCoreAmount=1, vBaseEnvTestedDerivative=RH850_1649, vBaseEnvTestedDerivativeDescription=Renesas RH850 F1KM_S4 Family R7F701649, vBaseEnvCpuCore=G3KH
          vBaseEnvAdditionalParameters: vBaseEnvClockGroup=A2, vBaseEnvDerivativeGroup=F1KM_S4, vBaseEnvPllGroup=A4, vBaseEnvProtectionGroup=A, vBaseEnvPortGroup=A, vBaseEnvResetGroup=A
          8 x vBaseEnvMemLayoutHwRegion:
            CodeFlash_A: vBaseEnvHwRegionSize=4194304, vBaseEnvHwRegionStartAddress=0
            LocalRAM_CPU0: vBaseEnvHwRegionSize=262144, vBaseEnvHwRegionStartAddress=4273733632, vBaseEnvHwRegionEccAlignment=4
            GlobalRAM_A: vBaseEnvHwRegionSize=98304, vBaseEnvHwRegionStartAddress=4277043200, vBaseEnvHwRegionEccAlignment=4
            GlobalRAM_B: vBaseEnvHwRegionSize=98304, vBaseEnvHwRegionStartAddress=4278091776, vBaseEnvHwRegionEccAlignment=4
            DataFlash: vBaseEnvHwRegionSize=131072, vBaseEnvHwRegionStartAddress=4280287232
            CodeFlash_Ext: vBaseEnvHwRegionSize=32768, vBaseEnvHwRegionStartAddress=16777216
            RetentionRAM: vBaseEnvHwRegionSize=65536, vBaseEnvHwRegionStartAddress=4277141504, vBaseEnvHwRegionEccAlignment=4
            LocalRAM_Self: vBaseEnvHwRegionSize=262144, vBaseEnvHwRegionStartAddress=4275830784, vBaseEnvHwRegionEccAlignment=4
          vBaseEnvClockSettings: vBaseEnvOscClock=16000000, vBaseEnvPeriphClock=40000000, vBaseEnvTimebaseClock=160000000
