[part 2 of 2: package /ActiveEcuC]
AUTOSAR XML (schema 00053)
package /ActiveEcuC  (continued)
  module config vBaseEnv: implementation-config-variant=VARIANT-PRE-COMPILE, module-description=vBaseEnv_Impl  (continued)
    vBaseEnvGeneral: vBaseEnvTestedDerivativeRef=RH850_1649  (continued)
      181 x vBaseEnvDerivativeInformation, all with vBaseEnvAvailableChannels_Hyperbus=0, vBaseEnvAvailableChannels_I2c=0, vBaseEnvAvailableChannels_Spi=0, vBaseEnvAvailableChannels_EthernetSwitch=0:  (continued)
        RH850_1651: vBaseEnvCpuMaxFrequency=240000000, vBaseEnvAvailableChannels_Flexray=2, vBaseEnvAvailableChannels_Can=8, vBaseEnvAvailableChannels_Lin=20, vBaseEnvAvailableChannels_Ethernet=1, vBaseEnvCpuCoreAmount=1, vBaseEnvTestedDerivative=RH850_1651, vBaseEnvTestedDerivativeDescription=Renesas RH850 F1KM_S4 Family R7F7016514ABG-C, vBaseEnvCpuCore=G3KH
          vBaseEnvAdditionalParameters: vBaseEnvClockGroup=A2, vBaseEnvDerivativeGroup=F1KM_S4, vBaseEnvPllGroup=A4, vBaseEnvProtectionGroup=A, vBaseEnvPortGroup=A, vBaseEnvResetGroup=A
          8 x vBaseEnvMemLayoutHwRegion:
            CodeFlash_A: vBaseEnvHwRegionSize=4194304, vBaseEnvHwRegionStartAddress=0
            LocalRAM_CPU0: vBaseEnvHwRegionSize=262144, vBaseEnvHwRegionStartAddress=4273733632, vBaseEnvHwRegionEccAlignment=4
            GlobalRAM_A: vBaseEnvHwRegionSize=98304, vBaseEnvHwRegionStartAddress=4277043200, vBaseEnvHwRegionEccAlignment=4
            GlobalRAM_B: vBaseEnvHwRegionSize=98304, vBaseEnvHwRegionStartAddress=4278091776, vBaseEnvHwRegionEccAlignment=4
            DataFlash: vBaseEnvHwRegionSize=131072, vBaseEnvHwRegionStartAddress=4280287232
            CodeFlash_Ext: vBaseEnvHwRegionSize=32768, vBaseEnvHwRegionStartAddress=16777216
            RetentionRAM: vBaseEnvHwRegionSize=65536, vBaseEnvHwRegionStartAddress=4277141504, vBaseEnvHwRegionEccAlignment=4
            LocalRAM_Self: vBaseEnvHwRegionSize=262144, vBaseEnvHwRegionStartAddress=4275830784, vBaseEnvHwRegionEccAlignment=4
          vBaseEnvClockSettings: vBaseEnvOscClock=16000000, vBaseEnvPeriphClock=40000000, vBaseEnvTimebaseClock=160000000
        RH850_1653: vBaseEnvCpuMaxFrequency=240000000, vBaseEnvAvailableChannels_Flexray=2, vBaseEnvAvailableChannels_Can=8, vBaseEnvAvailableChannels_Lin=20, vBaseEnvAvailableChannels_Ethernet=1, vBaseEnvCpuCoreAmount=1, vBaseEnvTestedDerivative=RH850_1653, vBaseEnvTestedDerivativeDescription=Renesas RH850 F1KM_S4 Family R7F7016534ABG-C, vBaseEnvCpuCore=G3KH
          vBaseEnvAdditionalParameters: vBaseEnvClockGroup=A2, vBaseEnvDerivativeGroup=F1KM_S4, vBaseEnvPllGroup=A4, vBaseEnvProtectionGroup=A, vBaseEnvPortGroup=A, vBaseEnvResetGroup=A
          8 x vBaseEnvMemLayoutHwRegion:
            CodeFlash_A: vBaseEnvHwRegionSize=4194304, vBaseEnvHwRegionStartAddress=0
            LocalRAM_CPU0: vBaseEnvHwRegionSize=262144, vBaseEnvHwRegionStartAddress=4273733632, vBaseEnvHwRegionEccAlignment=4
            GlobalRAM_A: vBaseEnvHwRegionSize=98304, vBaseEnvHwRegionStartAddress=4277043200, vBaseEnvHwRegionEccAlignment=4
            GlobalRAM_B: vBaseEnvHwRegionSize=98304, vBaseEnvHwRegionStartAddress=4278091776, vBaseEnvHwRegionEccAlignment=4
            DataFlash: vBaseEnvHwRegionSize=131072, vBaseEnvHwRegionStartAddress=4280287232
            CodeFlash_Ext: vBaseEnvHwRegionSize=32768, vBaseEnvHwRegionStartAddress=16777216
            RetentionRAM: vBaseEnvHwRegionSize=65536, vBaseEnvHwRegionStartAddress=4277141504, vBaseEnvHwRegionEccAlignment=4
            LocalRAM_Self: vBaseEnvHwRegionSize=262144, vBaseEnvHwRegionStartAddress=4275830784, vBaseEnvHwRegionEccAlignment=4
          vBaseEnvClockSettings: vBaseEnvOscClock=16000000, vBaseEnvPeriphClock=40000000, vBaseEnvTimebaseClock=160000000
        RH850_1645: vBaseEnvCpuMaxFrequency=240000000, vBaseEnvAvailableChannels_Flexray=2, vBaseEnvAvailableChannels_Can=8, vBaseEnvAvailableChannels_Lin=6, vBaseEnvAvailableChannels_Ethernet=0, vBaseEnvCpuCoreAmount=1, vBaseEnvTestedDerivative=RH850_1645, vBaseEnvTestedDerivativeDescription=Renesas RH850 F1KM_S4 Family R7F701645, vBaseEnvCpuCore=G3KH
          vBaseEnvAdditionalParameters: vBaseEnvClockGroup=A2, vBaseEnvDerivativeGroup=F1KM_S4, vBaseEnvPllGroup=A4, vBaseEnvProtectionGroup=A, vBaseEnvPortGroup=A, vBaseEnvResetGroup=A
          8 x vBaseEnvMemLayoutHwRegion:
            CodeFlash_A: vBaseEnvHwRegionSize=4194304, vBaseEnvHwRegionStartAddress=0
            LocalRAM_CPU0: vBaseEnvHwRegionSize=262144, vBaseEnvHwRegionStartAddress=4273733632, vBaseEnvHwRegionEccAlignment=4
            GlobalRAM_A: vBaseEnvHwRegionSize=98304, vBaseEnvHwRegionStartAddress=4277043200, vBaseEnvHwRegionEccAlignment=4
            GlobalRAM_B: vBaseEnvHwRegionSize=98304, vBaseEnvHwRegionStartAddress=4278091776, vBaseEnvHwRegionEccAlignment=4
            DataFlash: vBaseEnvHwRegionSize=131072, vBaseEnvHwRegionStartAddress=4280287232
            CodeFlash_Ext: vBaseEnvHwRegionSize=32768, vBaseEnvHwRegionStartAddress=16777216
            RetentionRAM: vBaseEnvHwRegionSize=65536, vBaseEnvHwRegionStartAddress=4277141504, vBaseEnvHwRegionEccAlignment=4
            LocalRAM_Self: vBaseEnvHwRegionSize=262144, vBaseEnvHwRegionStartAddress=4275830784, vBaseEnvHwRegionEccAlignment=4
          vBaseEnvClockSettings: vBaseEnvOscClock=16000000, vBaseEnvPeriphClock=40000000, vBaseEnvTimebaseClock=160000000
        RH850_1760: vBaseEnvCpuMaxFrequency=240000000, vBaseEnvAvailableChannels_Flexray=0, vBaseEnvAvailableChannels_Can=8, vBaseEnvAvailableChannels_Lin=6, vBaseEnvAvailableChannels_Ethernet=0, vBaseEnvCpuCoreAmount=1, vBaseEnvTestedDerivative=RH850_1760, vBaseEnvTestedDerivativeDescription=Renesas RH850 F1KM_S2 Family R7F701760, vBaseEnvCpuCore=G3KH
          vBaseEnvAdditionalParameters: vBaseEnvClockGroup=A2, vBaseEnvDerivativeGroup=F1KM_S4, vBaseEnvPllGroup=A4, vBaseEnvProtectionGroup=A, vBaseEnvPortGroup=A, vBaseEnvResetGroup=A
          8 x vBaseEnvMemLayoutHwRegion:
            CodeFlash_A: vBaseEnvHwRegionSize=2097152, vBaseEnvHwRegionStartAddress=0
            LocalRAM_CPU0: vBaseEnvHwRegionSize=131072, vBaseEnvHwRegionStartAddress=4273864704, vBaseEnvHwRegionEccAlignment=4
            GlobalRAM_A: vBaseEnvHwRegionSize=49152, vBaseEnvHwRegionStartAddress=4277092352, vBaseEnvHwRegionEccAlignment=4
            GlobalRAM_B: vBaseEnvHwRegionSize=49152, vBaseEnvHwRegionStartAddress=4278140928, vBaseEnvHwRegionEccAlignment=4
            DataFlash: vBaseEnvHwRegionSize=131072, vBaseEnvHwRegionStartAddress=4280287232
            CodeFlash_Ext: vBaseEnvHwRegionSize=32768, vBaseEnvHwRegionStartAddress=16777216
            RetentionRAM: vBaseEnvHwRegionSize=32768, vBaseEnvHwRegionStartAddress=4277141504, vBaseEnvHwRegionEccAlignment=4
            LocalRAM_Self: vBaseEnvHwRegionSize=131072, vBaseEnvHwRegionStartAddress=4275961856, vBaseEnvHwRegionEccAlignment=4
          vBaseEnvClockSettings: vBaseEnvOscClock=16000000, vBaseEnvPeriphClock=40000000, vBaseEnvTimebaseClock=160000000
        RH850_1762: vBaseEnvCpuMaxFrequency=240000000, vBaseEnvAvailableChannels_Flexray=0, vBaseEnvAvailableChannels_Can=8, vBaseEnvAvailableChannels_Lin=12, vBaseEnvAvailableChannels_Ethernet=0, vBaseEnvCpuCoreAmount=1, vBaseEnvTestedDerivative=RH850_1762, vBaseEnvTestedDerivativeDescription=Renesas RH850 F1KM_S2 Family R7F701762, vBaseEnvCpuCore=G3KH
          vBaseEnvAdditionalParameters: vBaseEnvClockGroup=A2, vBaseEnvDerivativeGroup=F1KM_S4, vBaseEnvPllGroup=A4, vBaseEnvProtectionGroup=A, vBaseEnvPortGroup=A, vBaseEnvResetGroup=A
          8 x vBaseEnvMemLayoutHwRegion:
            CodeFlash_A: vBaseEnvHwRegionSize=2097152, vBaseEnvHwRegionStartAddress=0
            LocalRAM_CPU0: vBaseEnvHwRegionSize=131072, vBaseEnvHwRegionStartAddress=4273864704, vBaseEnvHwRegionEccAlignment=4
            GlobalRAM_A: vBaseEnvHwRegionSize=49152, vBaseEnvHwRegionStartAddress=4277092352, vBaseEnvHwRegionEccAlignment=4
            GlobalRAM_B: vBaseEnvHwRegionSize=49152, vBaseEnvHwRegionStartAddress=4278140928, vBaseEnvHwRegionEccAlignment=4
            DataFlash: vBaseEnvHwRegionSize=131072, vBaseEnvHwRegionStartAddress=4280287232
            CodeFlash_Ext: vBaseEnvHwRegionSize=32768, vBaseEnvHwRegionStartAddress=16777216
            RetentionRAM: vBaseEnvHwRegionSize=32768, vBaseEnvHwRegionStartAddress=4277141504, vBaseEnvHwRegionEccAlignment=4
            LocalRAM_Self: vBaseEnvHwRegionSize=131072, vBaseEnvHwRegionStartAddress=4275961856, vBaseEnvHwRegionEccAlignment=4
          vBaseEnvClockSettings: vBaseEnvOscClock=16000000, vBaseEnvPeriphClock=40000000, vBaseEnvTimebaseClock=160000000
        RH850_1764: vBaseEnvCpuMaxFrequency=240000000, vBaseEnvAvailableChannels_Flexray=0, vBaseEnvAvailableChannels_Can=8, vBaseEnvAvailableChannels_Lin=18, vBaseEnvAvailableChannels_Ethernet=0, vBaseEnvCpuCoreAmount=1, vBaseEnvTestedDerivative=RH850_1764, vBaseEnvTestedDerivativeDescription=Renesas RH850 F1KM_S2 Family R7F701764, vBaseEnvCpuCore=G3KH
          vBaseEnvAdditionalParameters: vBaseEnvClockGroup=A2, vBaseEnvDerivativeGroup=F1KM_S4, vBaseEnvPllGroup=A4, vBaseEnvProtectionGroup=A, vBaseEnvPortGroup=A, vBaseEnvResetGroup=A
          8 x vBaseEnvMemLayoutHwRegion:
            CodeFlash_A: vBaseEnvHwRegionSize=2097152, vBaseEnvHwRegionStartAddress=0
            LocalRAM_CPU0: vBaseEnvHwRegionSize=131072, vBaseEnvHwRegionStartAddress=4273864704, vBaseEnvHwRegionEccAlignment=4
            GlobalRAM_A: vBaseEnvHwRegionSize=49152, vBaseEnvHwRegionStartAddress=4277092352, vBaseEnvHwRegionEccAlignment=4
            GlobalRAM_B: vBaseEnvHwRegionSize=49152, vBaseEnvHwRegionStartAddress=4278140928, vBaseEnvHwRegionEccAlignment=4
            DataFlash: vBaseEnvHwRegionSize=131072, vBaseEnvHwRegionStartAddress=4280287232
            CodeFlash_Ext: vBaseEnvHwRegionSize=32768, vBaseEnvHwRegionStartAddress=16777216
            RetentionRAM: vBaseEnvHwRegionSize=32768, vBaseEnvHwRegionStartAddress=4277141504, vBaseEnvHwRegionEccAlignment=4
            LocalRAM_Self: vBaseEnvHwRegionSize=131072, vBaseEnvHwRegionStartAddress=4275961856, vBaseEnvHwRegionEccAlignment=4
          vBaseEnvClockSettings: vBaseEnvOscClock=16000000, vBaseEnvPeriphClock=40000000, vBaseEnvTimebaseClock=160000000
        RH850_1003: vBaseEnvCpuMaxFrequency=96000000, vBaseEnvAvailableChannels_Flexray=0, vBaseEnvAvailableChannels_Can=6, vBaseEnvAvailableChannels_Lin=7, vBaseEnvAvailableChannels_Ethernet=0, vBaseEnvCpuCoreAmount=1, vBaseEnvTestedDerivative=RH850_1003, vBaseEnvTestedDerivativeDescription=Renesas RH850 F1L Family R7F701003, vBaseEnvCpuCore=G3K
          vBaseEnvAdditionalParameters: vBaseEnvClockGroup=A, vBaseEnvDerivativeGroup=F1L, vBaseEnvPllGroup=A, vBaseEnvProtectionGroup=A, vBaseEnvPortGroup=A, vBaseEnvResetGroup=A
          5 x vBaseEnvMemLayoutHwRegion:
            CodeFlash_A: vBaseEnvHwRegionSize=1048576, vBaseEnvHwRegionStartAddress=0
            LocalRAM_CPU0: vBaseEnvHwRegionSize=98304, vBaseEnvHwRegionStartAddress=4275994624, vBaseEnvHwRegionEccAlignment=4
            DataFlash: vBaseEnvHwRegionSize=32768, vBaseEnvHwRegionStartAddress=4280287232
            CodeFlash_Ext: vBaseEnvHwRegionSize=32768, vBaseEnvHwRegionStartAddress=16777216
            RetentionRAM: vBaseEnvHwRegionSize=32768, vBaseEnvHwRegionStartAddress=4276092928, vBaseEnvHwRegionEccAlignment=4
          vBaseEnvClockSettings: vBaseEnvOscClock=8000000, vBaseEnvPeriphClock=40000000, vBaseEnvTimebaseClock=80000000
        RH850_1006: vBaseEnvCpuMaxFrequency=80000000, vBaseEnvAvailableChannels_Flexray=0, vBaseEnvAvailableChannels_Can=6, vBaseEnvAvailableChannels_Lin=12, vBaseEnvAvailableChannels_Ethernet=0, vBaseEnvCpuCoreAmount=1, vBaseEnvTestedDerivative=RH850_1006, vBaseEnvTestedDerivativeDescription=Renesas RH850 F1L Family R7F701006, vBaseEnvCpuCore=G3K
          vBaseEnvAdditionalParameters: vBaseEnvClockGroup=A, vBaseEnvDerivativeGroup=F1L, vBaseEnvPllGroup=A, vBaseEnvProtectionGroup=A, vBaseEnvPortGroup=A, vBaseEnvResetGroup=A
          5 x vBaseEnvMemLayoutHwRegion:
            CodeFlash_A: vBaseEnvHwRegionSize=2097152, vBaseEnvHwRegionStartAddress=0
            LocalRAM_CPU0: vBaseEnvHwRegionSize=131072, vBaseEnvHwRegionStartAddress=4275961856, vBaseEnvHwRegionEccAlignment=4
            DataFlash: vBaseEnvHwRegionSize=32768, vBaseEnvHwRegionStartAddress=4280287232
            CodeFlash_Ext: vBaseEnvHwRegionSize=32768, vBaseEnvHwRegionStartAddress=16777216
            RetentionRAM: vBaseEnvHwRegionSize=32768, vBaseEnvHwRegionStartAddress=4276092928, vBaseEnvHwRegionEccAlignment=4
          vBaseEnvClockSettings: vBaseEnvOscClock=8000000, vBaseEnvPeriphClock=40000000, vBaseEnvTimebaseClock=80000000
        RH850_1010: vBaseEnvCpuMaxFrequency=80000000, vBaseEnvAvailableChannels_Flexray=0, vBaseEnvAvailableChannels_Can=1, vBaseEnvAvailableChannels_Lin=3, vBaseEnvAvailableChannels_Ethernet=0, vBaseEnvCpuCoreAmount=1, vBaseEnvTestedDerivative=RH850_1010, vBaseEnvTestedDerivativeDescription=Renesas RH850 F1L Family R7F701010, vBaseEnvCpuCore=G3K
          vBaseEnvAdditionalParameters: vBaseEnvClockGroup=A, vBaseEnvDerivativeGroup=F1L, vBaseEnvPllGroup=A, vBaseEnvProtectionGroup=A, vBaseEnvPortGroup=A, vBaseEnvResetGroup=A
          5 x vBaseEnvMemLayoutHwRegion:
            CodeFlash_A: vBaseEnvHwRegionSize=524288, vBaseEnvHwRegionStartAddress=0
            LocalRAM_CPU0: vBaseEnvHwRegionSize=32768, vBaseEnvHwRegionStartAddress=4276060160, vBaseEnvHwRegionEccAlignment=4
            DataFlash: vBaseEnvHwRegionSize=32768, vBaseEnvHwRegionStartAddress=4280287232
            CodeFlash_Ext: vBaseEnvHwRegionSize=32768, vBaseEnvHwRegionStartAddress=16777216
            RetentionRAM: vBaseEnvHwRegionSize=32768, vBaseEnvHwRegionStartAddress=4276092928, vBaseEnvHwRegionEccAlignment=4
          vBaseEnvClockSettings: vBaseEnvOscClock=8000000, vBaseEnvPeriphClock=40000000, vBaseEnvTimebaseClock=80000000
        RH850_1012: vBaseEnvCpuMaxFrequency=80000000, vBaseEnvAvailableChannels_Flexray=0, vBaseEnvAvailableChannels_Can=3, vBaseEnvAvailableChannels_Lin=4, vBaseEnvAvailableChannels_Ethernet=0, vBaseEnvCpuCoreAmount=1, vBaseEnvTestedDerivative=RH850_1012, vBaseEnvTestedDerivativeDescription=Renesas RH850 F1L Family R7F701012, vBaseEnvCpuCore=G3K
          vBaseEnvAdditionalParameters: vBaseEnvClockGroup=A, vBaseEnvDerivativeGroup=F1L, vBaseEnvPllGroup=A, vBaseEnvProtectionGroup=A, vBaseEnvPortGroup=A, vBaseEnvResetGroup=A
          5 x vBaseEnvMemLayoutHwRegion:
            CodeFlash_A: vBaseEnvHwRegionSize=393216, vBaseEnvHwRegionStartAddress=0
            LocalRAM_CPU0: vBaseEnvHwRegionSize=16384, vBaseEnvHwRegionStartAddress=4276076544, vBaseEnvHwRegionEccAlignment=4
            DataFlash: vBaseEnvHwRegionSize=32768, vBaseEnvHwRegionStartAddress=4280287232
            CodeFlash_Ext: vBaseEnvHwRegionSize=32768, vBaseEnvHwRegionStartAddress=16777216
            RetentionRAM: vBaseEnvHwRegionSize=32768, vBaseEnvHwRegionStartAddress=4276092928, vBaseEnvHwRegionEccAlignment=4
          vBaseEnvClockSettings: vBaseEnvOscClock=8000000, vBaseEnvPeriphClock=40000000, vBaseEnvTimebaseClock=80000000
        RH850_1013: vBaseEnvCpuMaxFrequency=80000000, vBaseEnvAvailableChannels_Flexray=0, vBaseEnvAvailableChannels_Can=3, vBaseEnvAvailableChannels_Lin=4, vBaseEnvAvailableChannels_Ethernet=0, vBaseEnvCpuCoreAmount=1, vBaseEnvTestedDerivative=RH850_1013, vBaseEnvTestedDerivativeDescription=Renesas RH850 F1L Family R7F701013, vBaseEnvCpuCore=G3K
          vBaseEnvAdditionalParameters: vBaseEnvClockGroup=A, vBaseEnvDerivativeGroup=F1L, vBaseEnvPllGroup=A, vBaseEnvProtectionGroup=A, vBaseEnvPortGroup=A, vBaseEnvResetGroup=A
          5 x vBaseEnvMemLayoutHwRegion:
            CodeFlash_A: vBaseEnvHwRegionSize=524288, vBaseEnvHwRegionStartAddress=0
            LocalRAM_CPU0: vBaseEnvHwRegionSize=32768, vBaseEnvHwRegionStartAddress=4276060160, vBaseEnvHwRegionEccAlignment=4
            DataFlash: vBaseEnvHwRegionSize=32768, vBaseEnvHwRegionStartAddress=4280287232
            CodeFlash_Ext: vBaseEnvHwRegionSize=32768, vBaseEnvHwRegionStartAddress=16777216
            RetentionRAM: vBaseEnvHwRegionSize=32768, vBaseEnvHwRegionStartAddress=4276092928, vBaseEnvHwRegionEccAlignment=4
          vBaseEnvClockSettings: vBaseEnvOscClock=8000000, vBaseEnvPeriphClock=40000000, vBaseEnvTimebaseClock=80000000
        RH850_1014: vBaseEnvCpuMaxFrequency=80000000, vBaseEnvAvailableChannels_Flexray=0, vBaseEnvAvailableChannels_Can=3, vBaseEnvAvailableChannels_Lin=4, vBaseEnvAvailableChannels_Ethernet=0, vBaseEnvCpuCoreAmount=1, vBaseEnvTestedDerivative=RH850_1014, vBaseEnvTestedDerivativeDescription=Renesas RH850 F1L Family R7F701014, vBaseEnvCpuCore=G3K
          vBaseEnvAdditionalParameters: vBaseEnvClockGroup=A, vBaseEnvDerivativeGroup=F1L, vBaseEnvPllGroup=A, vBaseEnvProtectionGroup=A, vBaseEnvPortGroup=A, vBaseEnvResetGroup=A
          5 x vBaseEnvMemLayoutHwRegion:
            CodeFlash_A: vBaseEnvHwRegionSize=786432, vBaseEnvHwRegionStartAddress=0
            LocalRAM_CPU0: vBaseEnvHwRegionSize=65536, vBaseEnvHwRegionStartAddress=4276027392, vBaseEnvHwRegionEccAlignment=4
            DataFlash: vBaseEnvHwRegionSize=32768, vBaseEnvHwRegionStartAddress=4280287232
            CodeFlash_Ext: vBaseEnvHwRegionSize=32768, vBaseEnvHwRegionStartAddress=16777216
            RetentionRAM: vBaseEnvHwRegionSize=32768, vBaseEnvHwRegionStartAddress=4276092928, vBaseEnvHwRegionEccAlignment=4
          vBaseEnvClockSettings: vBaseEnvOscClock=8000000, vBaseEnvPeriphClock=40000000, vBaseEnvTimebaseClock=80000000
        RH850_1015: vBaseEnvCpuMaxFrequency=80000000, vBaseEnvAvailableChannels_Flexray=0, vBaseEnvAvailableChannels_Can=3, vBaseEnvAvailableChannels_Lin=4, vBaseEnvAvailableChannels_Ethernet=0, vBaseEnvCpuCoreAmount=1, vBaseEnvTestedDerivative=RH850_1015, vBaseEnvTestedDerivativeDescription=Renesas RH850 F1L Family R7F701015, vBaseEnvCpuCore=G3K
          vBaseEnvAdditionalParameters: vBaseEnvClockGroup=A, vBaseEnvDerivativeGroup=F1L, vBaseEnvPllGroup=A, vBaseEnvProtectionGroup=A, vBaseEnvPortGroup=A, vBaseEnvResetGroup=A
          5 x vBaseEnvMemLayoutHwRegion:
            CodeFlash_A: vBaseEnvHwRegionSize=1048576, vBaseEnvHwRegionStartAddress=0
            LocalRAM_CPU0: vBaseEnvHwRegionSize=98304, vBaseEnvHwRegionStartAddress=4275994624, vBaseEnvHwRegionEccAlignment=4
            DataFlash: vBaseEnvHwRegionSize=32768, vBaseEnvHwRegionStartAddress=4280287232
            CodeFlash_Ext: vBaseEnvHwRegionSize=32768, vBaseEnvHwRegionStartAddress=16777216
            RetentionRAM: vBaseEnvHwRegionSize=32768, vBaseEnvHwRegionStartAddress=4276092928, vBaseEnvHwRegionEccAlignment=4
          vBaseEnvClockSettings: vBaseEnvOscClock=8000000, vBaseEnvPeriphClock=40000000, vBaseEnvTimebaseClock=80000000
        RH850_1018: vBaseEnvCpuMaxFrequency=80000000, vBaseEnvAvailableChannels_Flexray=0, vBaseEnvAvailableChannels_Can=3, vBaseEnvAvailableChannels_Lin=5, vBaseEnvAvailableChannels_Ethernet=0, vBaseEnvCpuCoreAmount=1, vBaseEnvTestedDerivative=RH850_1018, vBaseEnvTestedDerivativeDescription=Renesas RH850 F1L Family R7F701018, vBaseEnvCpuCore=G3K
          vBaseEnvAdditionalParameters: vBaseEnvClockGroup=A, vBaseEnvDerivativeGroup=F1L, vBaseEnvPllGroup=A, vBaseEnvProtectionGroup=A, vBaseEnvPortGroup=A, vBaseEnvResetGroup=A
          5 x vBaseEnvMemLayoutHwRegion:
            CodeFlash_A: vBaseEnvHwRegionSize=524288, vBaseEnvHwRegionStartAddress=0
            LocalRAM_CPU0: vBaseEnvHwRegionSize=32768, vBaseEnvHwRegionStartAddress=4276060160, vBaseEnvHwRegionEccAlignment=4
            DataFlash: vBaseEnvHwRegionSize=32768, vBaseEnvHwRegionStartAddress=4280287232
            CodeFlash_Ext: vBaseEnvHwRegionSize=32768, vBaseEnvHwRegionStartAddress=16777216
            RetentionRAM: vBaseEnvHwRegionSize=32768, vBaseEnvHwRegionStartAddress=4276092928, vBaseEnvHwRegionEccAlignment=4
          vBaseEnvClockSettings: vBaseEnvOscClock=8000000, vBaseEnvPeriphClock=40000000, vBaseEnvTimebaseClock=80000000
        RH850_1019: vBaseEnvCpuMaxFrequency=80000000, vBaseEnvAvailableChannels_Flexray=0, vBaseEnvAvailableChannels_Can=3, vBaseEnvAvailableChannels_Lin=5, vBaseEnvAvailableChannels_Ethernet=0, vBaseEnvCpuCoreAmount=1, vBaseEnvTestedDerivative=RH850_1019, vBaseEnvTestedDerivativeDescription=Renesas RH850 F1L Family R7F701019, vBaseEnvCpuCore=G3K
          vBaseEnvAdditionalParameters: vBaseEnvClockGroup=A, vBaseEnvDerivativeGroup=F1L, vBaseEnvPllGroup=A, vBaseEnvProtectionGroup=A, vBaseEnvPortGroup=A, vBaseEnvResetGroup=A
          5 x vBaseEnvMemLayoutHwRegion:
            CodeFlash_A: vBaseEnvHwRegionSize=786432, vBaseEnvHwRegionStartAddress=0
            LocalRAM_CPU0: vBaseEnvHwRegionSize=65536, vBaseEnvHwRegionStartAddress=4276027392, vBaseEnvHwRegionEccAlignment=4
            DataFlash: vBaseEnvHwRegionSize=32768, vBaseEnvHwRegionStartAddress=4280287232
            CodeFlash_Ext: vBaseEnvHwRegionSize=32768, vBaseEnvHwRegionStartAddress=16777216
            RetentionRAM: vBaseEnvHwRegionSize=32768, vBaseEnvHwRegionStartAddress=4276092928, vBaseEnvHwRegionEccAlignment=4
          vBaseEnvClockSettings: vBaseEnvOscClock=8000000, vBaseEnvPeriphClock=40000000, vBaseEnvTimebaseClock=80000000
        RH850_1020: vBaseEnvCpuMaxFrequency=80000000, vBaseEnvAvailableChannels_Flexray=0, vBaseEnvAvailableChannels_Can=3, vBaseEnvAvailableChannels_Lin=5, vBaseEnvAvailableChannels_Ethernet=0, vBaseEnvCpuCoreAmount=1, vBaseEnvTestedDerivative=RH850_1020, vBaseEnvTestedDerivativeDescription=Renesas RH850 F1L Family R7F701020, vBaseEnvCpuCore=G3K
          vBaseEnvAdditionalParameters: vBaseEnvClockGroup=A, vBaseEnvDerivativeGroup=F1L, vBaseEnvPllGroup=A, vBaseEnvProtectionGroup=A, vBaseEnvPortGroup=A, vBaseEnvResetGroup=A
          5 x vBaseEnvMemLayoutHwRegion:
            CodeFlash_A: vBaseEnvHwRegionSize=1048576, vBaseEnvHwRegionStartAddress=0
            LocalRAM_CPU0: vBaseEnvHwRegionSize=98304, vBaseEnvHwRegionStartAddress=4275994624, vBaseEnvHwRegionEccAlignment=4
            DataFlash: vBaseEnvHwRegionSize=32768, vBaseEnvHwRegionStartAddress=4280287232
            CodeFlash_Ext: vBaseEnvHwRegionSize=32768, vBaseEnvHwRegionStartAddress=16777216
            RetentionRAM: vBaseEnvHwRegionSize=32768, vBaseEnvHwRegionStartAddress=4276092928, vBaseEnvHwRegionEccAlignment=4
          vBaseEnvClockSettings: vBaseEnvOscClock=8000000, vBaseEnvPeriphClock=40000000, vBaseEnvTimebaseClock=80000000
        RH850_1021: vBaseEnvCpuMaxFrequency=80000000, vBaseEnvAvailableChannels_Flexray=0, vBaseEnvAvailableChannels_Can=3, vBaseEnvAvailableChannels_Lin=7, vBaseEnvAvailableChannels_Ethernet=0, vBaseEnvCpuCoreAmount=1, vBaseEnvTestedDerivative=RH850_1021, vBaseEnvTestedDerivativeDescription=Renesas RH850 F1L Family R7F701021, vBaseEnvCpuCore=G3K
          vBaseEnvAdditionalParameters: vBaseEnvClockGroup=A, vBaseEnvDerivativeGroup=F1L, vBaseEnvPllGroup=A, vBaseEnvProtectionGroup=A, vBaseEnvPortGroup=A, vBaseEnvResetGroup=A
          4 x vBaseEnvMemLayoutHwRegion:
            CodeFlash_A: vBaseEnvHwRegionSize=262144, vBaseEnvHwRegionStartAddress=0
            LocalRAM_CPU0: vBaseEnvHwRegionSize=32768, vBaseEnvHwRegionStartAddress=4276092928, vBaseEnvHwRegionEccAlignment=4
            DataFlash: vBaseEnvHwRegionSize=32768, vBaseEnvHwRegionStartAddress=4280287232
            CodeFlash_Ext: vBaseEnvHwRegionSize=32768, vBaseEnvHwRegionStartAddress=16777216
          vBaseEnvClockSettings: vBaseEnvOscClock=8000000, vBaseEnvPeriphClock=40000000, vBaseEnvTimebaseClock=80000000
        RH850_1022: vBaseEnvCpuMaxFrequency=80000000, vBaseEnvAvailableChannels_Flexray=0, vBaseEnvAvailableChannels_Can=3, vBaseEnvAvailableChannels_Lin=7, vBaseEnvAvailableChannels_Ethernet=0, vBaseEnvCpuCoreAmount=1, vBaseEnvTestedDerivative=RH850_1022, vBaseEnvTestedDerivativeDescription=Renesas RH850 F1L Family R7F701022, vBaseEnvCpuCore=G3K
          vBaseEnvAdditionalParameters: vBaseEnvClockGroup=A, vBaseEnvDerivativeGroup=F1L, vBaseEnvPllGroup=A, vBaseEnvProtectionGroup=A, vBaseEnvPortGroup=A, vBaseEnvResetGroup=A
          5 x vBaseEnvMemLayoutHwRegion:
            CodeFlash_A: vBaseEnvHwRegionSize=393216, vBaseEnvHwRegionStartAddress=0
            LocalRAM_CPU0: vBaseEnvHwRegionSize=16384, vBaseEnvHwRegionStartAddress=4276076544, vBaseEnvHwRegionEccAlignment=4
            DataFlash: vBaseEnvHwRegionSize=32768, vBaseEnvHwRegionStartAddress=4280287232
            CodeFlash_Ext: vBaseEnvHwRegionSize=32768, vBaseEnvHwRegionStartAddress=16777216
            RetentionRAM: vBaseEnvHwRegionSize=32768, vBaseEnvHwRegionStartAddress=4276092928, vBaseEnvHwRegionEccAlignment=4
          vBaseEnvClockSettings: vBaseEnvOscClock=8000000, vBaseEnvPeriphClock=40000000, vBaseEnvTimebaseClock=80000000
        RH850_1023: vBaseEnvCpuMaxFrequency=80000000, vBaseEnvAvailableChannels_Flexray=0, vBaseEnvAvailableChannels_Can=3, vBaseEnvAvailableChannels_Lin=7, vBaseEnvAvailableChannels_Ethernet=0, vBaseEnvCpuCoreAmount=1, vBaseEnvTestedDerivative=RH850_1023, vBaseEnvTestedDerivativeDescription=Renesas RH850 F1L Family R7F701023, vBaseEnvCpuCore=G3K
          vBaseEnvAdditionalParameters: vBaseEnvClockGroup=A, vBaseEnvDerivativeGroup=F1L, vBaseEnvPllGroup=A, vBaseEnvProtectionGroup=A, vBaseEnvPortGroup=A, vBaseEnvResetGroup=A
          5 x vBaseEnvMemLayoutHwRegion:
            CodeFlash_A: vBaseEnvHwRegionSize=524288, vBaseEnvHwRegionStartAddress=0
            LocalRAM_CPU0: vBaseEnvHwRegionSize=32768, vBaseEnvHwRegionStartAddress=4276060160, vBaseEnvHwRegionEccAlignment=4
            DataFlash: vBaseEnvHwRegionSize=32768, vBaseEnvHwRegionStartAddress=4280287232
            CodeFlash_Ext: vBaseEnvHwRegionSize=32768, vBaseEnvHwRegionStartAddress=16777216
            RetentionRAM: vBaseEnvHwRegionSize=32768, vBaseEnvHwRegionStartAddress=4276092928, vBaseEnvHwRegionEccAlignment=4
          vBaseEnvClockSettings: vBaseEnvOscClock=8000000, vBaseEnvPeriphClock=40000000, vBaseEnvTimebaseClock=80000000
        RH850_1024: vBaseEnvCpuMaxFrequency=80000000, vBaseEnvAvailableChannels_Flexray=0, vBaseEnvAvailableChannels_Can=3, vBaseEnvAvailableChannels_Lin=7, vBaseEnvAvailableChannels_Ethernet=0, vBaseEnvCpuCoreAmount=1, vBaseEnvTestedDerivative=RH850_1024, vBaseEnvTestedDerivativeDescription=Renesas RH850 F1L Family R7F701024, vBaseEnvCpuCore=G3K
          vBaseEnvAdditionalParameters: vBaseEnvClockGroup=A, vBaseEnvDerivativeGroup=F1L, vBaseEnvPllGroup=A, vBaseEnvProtectionGroup=A, vBaseEnvPortGroup=A, vBaseEnvResetGroup=A
          5 x vBaseEnvMemLayoutHwRegion:
            CodeFlash_A: vBaseEnvHwRegionSize=786432, vBaseEnvHwRegionStartAddress=0
            LocalRAM_CPU0: vBaseEnvHwRegionSize=65536, vBaseEnvHwRegionStartAddress=4276027392, vBaseEnvHwRegionEccAlignment=4
            DataFlash: vBaseEnvHwRegionSize=32768, vBaseEnvHwRegionStartAddress=4280287232
            CodeFlash_Ext: vBaseEnvHwRegionSize=32768, vBaseEnvHwRegionStartAddress=16777216
            RetentionRAM: vBaseEnvHwRegionSize=32768, vBaseEnvHwRegionStartAddress=4276092928, vBaseEnvHwRegionEccAlignment=4
          vBaseEnvClockSettings: vBaseEnvOscClock=8000000, vBaseEnvPeriphClock=40000000, vBaseEnvTimebaseClock=80000000
        RH850_1025: vBaseEnvCpuMaxFrequency=80000000, vBaseEnvAvailableChannels_Flexray=0, vBaseEnvAvailableChannels_Can=3, vBaseEnvAvailableChannels_Lin=7, vBaseEnvAvailableChannels_Ethernet=0, vBaseEnvCpuCoreAmount=1, vBaseEnvTestedDerivative=RH850_1025, vBaseEnvTestedDerivativeDescription=Renesas RH850 F1L Family R7F701025, vBaseEnvCpuCore=G3K
          vBaseEnvAdditionalParameters: vBaseEnvClockGroup=A, vBaseEnvDerivativeGroup=F1L, vBaseEnvPllGroup=A, vBaseEnvProtectionGroup=A, vBaseEnvPortGroup=A, vBaseEnvResetGroup=A
          5 x vBaseEnvMemLayoutHwRegion:
            CodeFlash_A: vBaseEnvHwRegionSize=1048576, vBaseEnvHwRegionStartAddress=0
            LocalRAM_CPU0: vBaseEnvHwRegionSize=98304, vBaseEnvHwRegionStartAddress=4275994624, vBaseEnvHwRegionEccAlignment=4
            DataFlash: vBaseEnvHwRegionSize=32768, vBaseEnvHwRegionStartAddress=4280287232
            CodeFlash_Ext: vBaseEnvHwRegionSize=32768, vBaseEnvHwRegionStartAddress=16777216
            RetentionRAM: vBaseEnvHwRegionSize=32768, vBaseEnvHwRegionStartAddress=4276092928, vBaseEnvHwRegionEccAlignment=4
          vBaseEnvClockSettings: vBaseEnvOscClock=8000000, vBaseEnvPeriphClock=40000000, vBaseEnvTimebaseClock=80000000
        RH850_1026: vBaseEnvCpuMaxFrequency=80000000, vBaseEnvAvailableChannels_Flexray=0, vBaseEnvAvailableChannels_Can=4, vBaseEnvAvailableChannels_Lin=12, vBaseEnvAvailableChannels_Ethernet=0, vBaseEnvCpuCoreAmount=1, vBaseEnvTestedDerivative=RH850_1026, vBaseEnvTestedDerivativeDescription=Renesas RH850 F1L Family R7F701026, vBaseEnvCpuCore=G3K
          vBaseEnvAdditionalParameters: vBaseEnvClockGroup=A, vBaseEnvDerivativeGroup=F1L, vBaseEnvPllGroup=A, vBaseEnvProtectionGroup=A, vBaseEnvPortGroup=A, vBaseEnvResetGroup=A
          5 x vBaseEnvMemLayoutHwRegion:
            CodeFlash_A: vBaseEnvHwRegionSize=393216, vBaseEnvHwRegionStartAddress=0
            LocalRAM_CPU0: vBaseEnvHwRegionSize=16384, vBaseEnvHwRegionStartAddress=4276076544, vBaseEnvHwRegionEccAlignment=4
            DataFlash: vBaseEnvHwRegionSize=32768, vBaseEnvHwRegionStartAddress=4280287232
            CodeFlash_Ext: vBaseEnvHwRegionSize=32768, vBaseEnvHwRegionStartAddress=16777216
            RetentionRAM: vBaseEnvHwRegionSize=32768, vBaseEnvHwRegionStartAddress=4276092928, vBaseEnvHwRegionEccAlignment=4
          vBaseEnvClockSettings: vBaseEnvOscClock=8000000, vBaseEnvPeriphClock=40000000, vBaseEnvTimebaseClock=80000000
        RH850_1027: vBaseEnvCpuMaxFrequency=80000000, vBaseEnvAvailableChannels_Flexray=0, vBaseEnvAvailableChannels_Can=4, vBaseEnvAvailableChannels_Lin=12, vBaseEnvAvailableChannels_Ethernet=0, vBaseEnvCpuCoreAmount=1, vBaseEnvTestedDerivative=RH850_1027, vBaseEnvTestedDerivativeDescription=Renesas RH850 F1L Family R7F701027, vBaseEnvCpuCore=G3K
          vBaseEnvAdditionalParameters: vBaseEnvClockGroup=A, vBaseEnvDerivativeGroup=F1L, vBaseEnvPllGroup=A, vBaseEnvProtectionGroup=A, vBaseEnvPortGroup=A, vBaseEnvResetGroup=A
          5 x vBaseEnvMemLayoutHwRegion:
            CodeFlash_A: vBaseEnvHwRegionSize=524288, vBaseEnvHwRegionStartAddress=0
            LocalRAM_CPU0: vBaseEnvHwRegionSize=32768, vBaseEnvHwRegionStartAddress=4276060160, vBaseEnvHwRegionEccAlignment=4
            DataFlash: vBaseEnvHwRegionSize=32768, vBaseEnvHwRegionStartAddress=4280287232
            CodeFlash_Ext: vBaseEnvHwRegionSize=32768, vBaseEnvHwRegionStartAddress=16777216
            RetentionRAM: vBaseEnvHwRegionSize=32768, vBaseEnvHwRegionStartAddress=4276092928, vBaseEnvHwRegionEccAlignment=4
          vBaseEnvClockSettings: vBaseEnvOscClock=8000000, vBaseEnvPeriphClock=40000000, vBaseEnvTimebaseClock=80000000
        RH850_1028: vBaseEnvCpuMaxFrequency=80000000, vBaseEnvAvailableChannels_Flexray=0, vBaseEnvAvailableChannels_Can=4, vBaseEnvAvailableChannels_Lin=12, vBaseEnvAvailableChannels_Ethernet=0, vBaseEnvCpuCoreAmount=1, vBaseEnvTestedDerivative=RH850_1028, vBaseEnvTestedDerivativeDescription=Renesas RH850 F1L Family R7F701028, vBaseEnvCpuCore=G3K
          vBaseEnvAdditionalParameters: vBaseEnvClockGroup=A, vBaseEnvDerivativeGroup=F1L, vBaseEnvPllGroup=A, vBaseEnvProtectionGroup=A, vBaseEnvPortGroup=A, vBaseEnvResetGroup=A
          5 x vBaseEnvMemLayoutHwRegion:
            CodeFlash_A: vBaseEnvHwRegionSize=786432, vBaseEnvHwRegionStartAddress=0
            LocalRAM_CPU0: vBaseEnvHwRegionSize=65536, vBaseEnvHwRegionStartAddress=4276027392, vBaseEnvHwRegionEccAlignment=4
            DataFlash: vBaseEnvHwRegionSize=32768, vBaseEnvHwRegionStartAddress=4280287232
            CodeFlash_Ext: vBaseEnvHwRegionSize=32768, vBaseEnvHwRegionStartAddress=16777216
            RetentionRAM: vBaseEnvHwRegionSize=32768, vBaseEnvHwRegionStartAddress=4276092928, vBaseEnvHwRegionEccAlignment=4
          vBaseEnvClockSettings: vBaseEnvOscClock=8000000, vBaseEnvPeriphClock=40000000, vBaseEnvTimebaseClock=80000000
        RH850_1029: vBaseEnvCpuMaxFrequency=80000000, vBaseEnvAvailableChannels_Flexray=0, vBaseEnvAvailableChannels_Can=4, vBaseEnvAvailableChannels_Lin=12, vBaseEnvAvailableChannels_Ethernet=0, vBaseEnvCpuCoreAmount=1, vBaseEnvTestedDerivative=RH850_1029, vBaseEnvTestedDerivativeDescription=Renesas RH850 F1L Family R7F701029, vBaseEnvCpuCore=G3K
          vBaseEnvAdditionalParameters: vBaseEnvClockGroup=A, vBaseEnvDerivativeGroup=F1L, vBaseEnvPllGroup=A, vBaseEnvProtectionGroup=A, vBaseEnvPortGroup=A, vBaseEnvResetGroup=A
          5 x vBaseEnvMemLayoutHwRegion:
            CodeFlash_A: vBaseEnvHwRegionSize=1048576, vBaseEnvHwRegionStartAddress=0
            LocalRAM_CPU0: vBaseEnvHwRegionSize=98304, vBaseEnvHwRegionStartAddress=4275994624, vBaseEnvHwRegionEccAlignment=4
            DataFlash: vBaseEnvHwRegionSize=32768, vBaseEnvHwRegionStartAddress=4280287232
            CodeFlash_Ext: vBaseEnvHwRegionSize=32768, vBaseEnvHwRegionStartAddress=16777216
            RetentionRAM: vBaseEnvHwRegionSize=32768, vBaseEnvHwRegionStartAddress=4276092928, vBaseEnvHwRegionEccAlignment=4
          vBaseEnvClockSettings: vBaseEnvOscClock=8000000, vBaseEnvPeriphClock=40000000, vBaseEnvTimebaseClock=80000000
        RH850_1030: vBaseEnvCpuMaxFrequency=80000000, vBaseEnvAvailableChannels_Flexray=0, vBaseEnvAvailableChannels_Can=6, vBaseEnvAvailableChannels_Lin=12, vBaseEnvAvailableChannels_Ethernet=0, vBaseEnvCpuCoreAmount=1, vBaseEnvTestedDerivative=RH850_1030, vBaseEnvTestedDerivativeDescription=Renesas RH850 F1L Family R7F701030, vBaseEnvCpuCore=G3K
          vBaseEnvAdditionalParameters: vBaseEnvClockGroup=A, vBaseEnvDerivativeGroup=F1L, vBaseEnvPllGroup=A, vBaseEnvProtectionGroup=A, vBaseEnvPortGroup=A, vBaseEnvResetGroup=A
          5 x vBaseEnvMemLayoutHwRegion:
            CodeFlash_A: vBaseEnvHwRegionSize=1572864, vBaseEnvHwRegionStartAddress=0
            LocalRAM_CPU0: vBaseEnvHwRegionSize=131072, vBaseEnvHwRegionStartAddress=4275961856, vBaseEnvHwRegionEccAlignment=4
            DataFlash: vBaseEnvHwRegionSize=32768, vBaseEnvHwRegionStartAddress=4280287232
            CodeFlash_Ext: vBaseEnvHwRegionSize=32768, vBaseEnvHwRegionStartAddress=16777216
            RetentionRAM: vBaseEnvHwRegionSize=32768, vBaseEnvHwRegionStartAddress=4276092928, vBaseEnvHwRegionEccAlignment=4
          vBaseEnvClockSettings: vBaseEnvOscClock=8000000, vBaseEnvPeriphClock=40000000, vBaseEnvTimebaseClock=80000000
        RH850_1031: vBaseEnvCpuMaxFrequency=80000000, vBaseEnvAvailableChannels_Flexray=0, vBaseEnvAvailableChannels_Can=6, vBaseEnvAvailableChannels_Lin=12, vBaseEnvAvailableChannels_Ethernet=0, vBaseEnvCpuCoreAmount=1, vBaseEnvTestedDerivative=RH850_1031, vBaseEnvTestedDerivativeDescription=Renesas RH850 F1L Family R7F701031, vBaseEnvCpuCore=G3K
          vBaseEnvAdditionalParameters: vBaseEnvClockGroup=A, vBaseEnvDerivativeGroup=F1L, vBaseEnvPllGroup=A, vBaseEnvProtectionGroup=A, vBaseEnvPortGroup=A, vBaseEnvResetGroup=A
          5 x vBaseEnvMemLayoutHwRegion:
            CodeFlash_A: vBaseEnvHwRegionSize=2097152, vBaseEnvHwRegionStartAddress=0
            LocalRAM_CPU0: vBaseEnvHwRegionSize=131072, vBaseEnvHwRegionStartAddress=4275961856, vBaseEnvHwRegionEccAlignment=4
            DataFlash: vBaseEnvHwRegionSize=32768, vBaseEnvHwRegionStartAddress=4280287232
            CodeFlash_Ext: vBaseEnvHwRegionSize=32768, vBaseEnvHwRegionStartAddress=16777216
            RetentionRAM: vBaseEnvHwRegionSize=32768, vBaseEnvHwRegionStartAddress=4276092928, vBaseEnvHwRegionEccAlignment=4
          vBaseEnvClockSettings: vBaseEnvOscClock=8000000, vBaseEnvPeriphClock=40000000, vBaseEnvTimebaseClock=80000000
        RH850_1032: vBaseEnvCpuMaxFrequency=80000000, vBaseEnvAvailableChannels_Flexray=0, vBaseEnvAvailableChannels_Can=6, vBaseEnvAvailableChannels_Lin=16, vBaseEnvAvailableChannels_Ethernet=0, vBaseEnvCpuCoreAmount=1, vBaseEnvTestedDerivative=RH850_1032, vBaseEnvTestedDerivativeDescription=Renesas RH850 F1L Family R7F701032, vBaseEnvCpuCore=G3K
          vBaseEnvAdditionalParameters: vBaseEnvClockGroup=A, vBaseEnvDerivativeGroup=F1L, vBaseEnvPllGroup=A, vBaseEnvProtectionGroup=A, vBaseEnvPortGroup=A, vBaseEnvResetGroup=A
          5 x vBaseEnvMemLayoutHwRegion:
            CodeFlash_A: vBaseEnvHwRegionSize=786432, vBaseEnvHwRegionStartAddress=0
            LocalRAM_CPU0: vBaseEnvHwRegionSize=65536, vBaseEnvHwRegionStartAddress=4275961856, vBaseEnvHwRegionEccAlignment=4
            DataFlash: vBaseEnvHwRegionSize=32768, vBaseEnvHwRegionStartAddress=4280287232
            CodeFlash_Ext: vBaseEnvHwRegionSize=32768, vBaseEnvHwRegionStartAddress=16777216
            RetentionRAM: vBaseEnvHwRegionSize=32768, vBaseEnvHwRegionStartAddress=4276092928, vBaseEnvHwRegionEccAlignment=4
          vBaseEnvClockSettings: vBaseEnvOscClock=8000000, vBaseEnvPeriphClock=40000000, vBaseEnvTimebaseClock=80000000
        RH850_1034: vBaseEnvCpuMaxFrequency=80000000, vBaseEnvAvailableChannels_Flexray=0, vBaseEnvAvailableChannels_Can=6, vBaseEnvAvailableChannels_Lin=16, vBaseEnvAvailableChannels_Ethernet=0, vBaseEnvCpuCoreAmount=1, vBaseEnvTestedDerivative=RH850_1034, vBaseEnvTestedDerivativeDescription=Renesas RH850 F1L Family R7F701034, vBaseEnvCpuCore=G3K
          vBaseEnvAdditionalParameters: vBaseEnvClockGroup=A, vBaseEnvDerivativeGroup=F1L, vBaseEnvPllGroup=A, vBaseEnvProtectionGroup=A, vBaseEnvPortGroup=A, vBaseEnvResetGroup=A
          5 x vBaseEnvMemLayoutHwRegion:
            CodeFlash_A: vBaseEnvHwRegionSize=1572864, vBaseEnvHwRegionStartAddress=0
            LocalRAM_CPU0: vBaseEnvHwRegionSize=131072, vBaseEnvHwRegionStartAddress=4275961856, vBaseEnvHwRegionEccAlignment=4
            DataFlash: vBaseEnvHwRegionSize=32768, vBaseEnvHwRegionStartAddress=4280287232
            CodeFlash_Ext: vBaseEnvHwRegionSize=32768, vBaseEnvHwRegionStartAddress=16777216
            RetentionRAM: vBaseEnvHwRegionSize=32768, vBaseEnvHwRegionStartAddress=4276092928, vBaseEnvHwRegionEccAlignment=4
          vBaseEnvClockSettings: vBaseEnvOscClock=8000000, vBaseEnvPeriphClock=40000000, vBaseEnvTimebaseClock=80000000
        RH850_1035: vBaseEnvCpuMaxFrequency=80000000, vBaseEnvAvailableChannels_Flexray=0, vBaseEnvAvailableChannels_Can=6, vBaseEnvAvailableChannels_Lin=16, vBaseEnvAvailableChannels_Ethernet=0, vBaseEnvCpuCoreAmount=1, vBaseEnvTestedDerivative=RH850_1035, vBaseEnvTestedDerivativeDescription=Renesas RH850 F1L Family R7F701035, vBaseEnvCpuCore=G3K
          vBaseEnvAdditionalParameters: vBaseEnvClockGroup=A, vBaseEnvDerivativeGroup=F1L, vBaseEnvPllGroup=A, vBaseEnvProtectionGroup=A, vBaseEnvPortGroup=A, vBaseEnvResetGroup=A
          5 x vBaseEnvMemLayoutHwRegion:
            CodeFlash_A: vBaseEnvHwRegionSize=2097152, vBaseEnvHwRegionStartAddress=0
            LocalRAM_CPU0: vBaseEnvHwRegionSize=131072, vBaseEnvHwRegionStartAddress=4275961856, vBaseEnvHwRegionEccAlignment=4
            DataFlash: vBaseEnvHwRegionSize=32768, vBaseEnvHwRegionStartAddress=4280287232
            CodeFlash_Ext: vBaseEnvHwRegionSize=32768, vBaseEnvHwRegionStartAddress=16777216
            RetentionRAM: vBaseEnvHwRegionSize=32768, vBaseEnvHwRegionStartAddress=4276092928, vBaseEnvHwRegionEccAlignment=4
          vBaseEnvClockSettings: vBaseEnvOscClock=8000000, vBaseEnvPeriphClock=40000000, vBaseEnvTimebaseClock=80000000
        RH850_1040: vBaseEnvCpuMaxFrequency=96000000, vBaseEnvAvailableChannels_Flexray=0, vBaseEnvAvailableChannels_Can=3, vBaseEnvAvailableChannels_Lin=4, vBaseEnvAvailableChannels_Ethernet=0, vBaseEnvCpuCoreAmount=1, vBaseEnvTestedDerivative=RH850_1040, vBaseEnvTestedDerivativeDescription=Renesas RH850 F1L Family R7F701040, vBaseEnvCpuCore=G3K
          vBaseEnvAdditionalParameters: vBaseEnvClockGroup=A, vBaseEnvDerivativeGroup=F1L, vBaseEnvPllGroup=A, vBaseEnvProtectionGroup=A, vBaseEnvPortGroup=A, vBaseEnvResetGroup=A
          5 x vBaseEnvMemLayoutHwRegion:
            CodeFlash_A: vBaseEnvHwRegionSize=786432, vBaseEnvHwRegionStartAddress=0
            LocalRAM_CPU0: vBaseEnvHwRegionSize=65536, vBaseEnvHwRegionStartAddress=4276027392, vBaseEnvHwRegionEccAlignment=4
            DataFlash: vBaseEnvHwRegionSize=32768, vBaseEnvHwRegionStartAddress=4280287232
            CodeFlash_Ext: vBaseEnvHwRegionSize=32768, vBaseEnvHwRegionStartAddress=16777216
            RetentionRAM: vBaseEnvHwRegionSize=32768, vBaseEnvHwRegionStartAddress=4276092928, vBaseEnvHwRegionEccAlignment=4
          vBaseEnvClockSettings: vBaseEnvOscClock=8000000, vBaseEnvPeriphClock=40000000, vBaseEnvTimebaseClock=80000000
        RH850_1041: vBaseEnvCpuMaxFrequency=96000000, vBaseEnvAvailableChannels_Flexray=0, vBaseEnvAvailableChannels_Can=3, vBaseEnvAvailableChannels_Lin=2, vBaseEnvAvailableChannels_Ethernet=0, vBaseEnvCpuCoreAmount=1, vBaseEnvTestedDerivative=RH850_1041, vBaseEnvTestedDerivativeDescription=Renesas RH850 F1L Family R7F701041, vBaseEnvCpuCore=G3K
          vBaseEnvAdditionalParameters: vBaseEnvClockGroup=A, vBaseEnvDerivativeGroup=F1L, vBaseEnvPllGroup=A, vBaseEnvProtectionGroup=A, vBaseEnvPortGroup=A, vBaseEnvResetGroup=A
          5 x vBaseEnvMemLayoutHwRegion:
            CodeFlash_A: vBaseEnvHwRegionSize=1048576, vBaseEnvHwRegionStartAddress=0
            LocalRAM_CPU0: vBaseEnvHwRegionSize=98304, vBaseEnvHwRegionStartAddress=4275994624, vBaseEnvHwRegionEccAlignment=4
            DataFlash: vBaseEnvHwRegionSize=32768, vBaseEnvHwRegionStartAddress=4280287232
            CodeFlash_Ext: vBaseEnvHwRegionSize=32768, vBaseEnvHwRegionStartAddress=16777216
            RetentionRAM: vBaseEnvHwRegionSize=32768, vBaseEnvHwRegionStartAddress=4276092928, vBaseEnvHwRegionEccAlignment=4
          vBaseEnvClockSettings: vBaseEnvOscClock=8000000, vBaseEnvPeriphClock=40000000, vBaseEnvTimebaseClock=80000000
        RH850_1042: vBaseEnvCpuMaxFrequency=96000000, vBaseEnvAvailableChannels_Flexray=0, vBaseEnvAvailableChannels_Can=3, vBaseEnvAvailableChannels_Lin=3, vBaseEnvAvailableChannels_Ethernet=0, vBaseEnvCpuCoreAmount=1, vBaseEnvTestedDerivative=RH850_1042, vBaseEnvTestedDerivativeDescription=Renesas RH850 F1L Family R7F701042, vBaseEnvCpuCore=G3K
          vBaseEnvAdditionalParameters: vBaseEnvClockGroup=A, vBaseEnvDerivativeGroup=F1L, vBaseEnvPllGroup=A, vBaseEnvProtectionGroup=A, vBaseEnvPortGroup=A, vBaseEnvResetGroup=A
          5 x vBaseEnvMemLayoutHwRegion:
            CodeFlash_A: vBaseEnvHwRegionSize=786432, vBaseEnvHwRegionStartAddress=0
            LocalRAM_CPU0: vBaseEnvHwRegionSize=65536, vBaseEnvHwRegionStartAddress=4276027392, vBaseEnvHwRegionEccAlignment=4
            DataFlash: vBaseEnvHwRegionSize=32768, vBaseEnvHwRegionStartAddress=4280287232
            CodeFlash_Ext: vBaseEnvHwRegionSize=32768, vBaseEnvHwRegionStartAddress=16777216
            RetentionRAM: vBaseEnvHwRegionSize=32768, vBaseEnvHwRegionStartAddress=4276092928, vBaseEnvHwRegionEccAlignment=4
          vBaseEnvClockSettings: vBaseEnvOscClock=8000000, vBaseEnvPeriphClock=40000000, vBaseEnvTimebaseClock=80000000
        RH850_1043: vBaseEnvCpuMaxFrequency=96000000, vBaseEnvAvailableChannels_Flexray=0, vBaseEnvAvailableChannels_Can=3, vBaseEnvAvailableChannels_Lin=5, vBaseEnvAvailableChannels_Ethernet=0, vBaseEnvCpuCoreAmount=1, vBaseEnvTestedDerivative=RH850_1043, vBaseEnvTestedDerivativeDescription=Renesas RH850 F1L Family R7F701043, vBaseEnvCpuCore=G3K
          vBaseEnvAdditionalParameters: vBaseEnvClockGroup=A, vBaseEnvDerivativeGroup=F1L, vBaseEnvPllGroup=A, vBaseEnvProtectionGroup=A, vBaseEnvPortGroup=A, vBaseEnvResetGroup=A
          5 x vBaseEnvMemLayoutHwRegion:
            CodeFlash_A: vBaseEnvHwRegionSize=1048576, vBaseEnvHwRegionStartAddress=0
            LocalRAM_CPU0: vBaseEnvHwRegionSize=98304, vBaseEnvHwRegionStartAddress=4275994624, vBaseEnvHwRegionEccAlignment=4
            DataFlash: vBaseEnvHwRegionSize=32768, vBaseEnvHwRegionStartAddress=4280287232
            CodeFlash_Ext: vBaseEnvHwRegionSize=32768, vBaseEnvHwRegionStartAddress=16777216
            RetentionRAM: vBaseEnvHwRegionSize=32768, vBaseEnvHwRegionStartAddress=4276092928, vBaseEnvHwRegionEccAlignment=4
          vBaseEnvClockSettings: vBaseEnvOscClock=8000000, vBaseEnvPeriphClock=40000000, vBaseEnvTimebaseClock=80000000
        RH850_1044: vBaseEnvCpuMaxFrequency=80000000, vBaseEnvAvailableChannels_Flexray=0, vBaseEnvAvailableChannels_Can=3, vBaseEnvAvailableChannels_Lin=7, vBaseEnvAvailableChannels_Ethernet=0, vBaseEnvCpuCoreAmount=1, vBaseEnvTestedDerivative=RH850_1044, vBaseEnvTestedDerivativeDescription=Renesas RH850 F1L Family R7F701044, vBaseEnvCpuCore=G3K
          vBaseEnvAdditionalParameters: vBaseEnvClockGroup=A, vBaseEnvDerivativeGroup=F1L, vBaseEnvPllGroup=A, vBaseEnvProtectionGroup=A, vBaseEnvPortGroup=A, vBaseEnvResetGroup=A
          5 x vBaseEnvMemLayoutHwRegion:
            CodeFlash_A: vBaseEnvHwRegionSize=786432, vBaseEnvHwRegionStartAddress=0
            LocalRAM_CPU0: vBaseEnvHwRegionSize=65536, vBaseEnvHwRegionStartAddress=4276027392, vBaseEnvHwRegionEccAlignment=4
            DataFlash: vBaseEnvHwRegionSize=32768, vBaseEnvHwRegionStartAddress=4280287232
            CodeFlash_Ext: vBaseEnvHwRegionSize=32768, vBaseEnvHwRegionStartAddress=16777216
            RetentionRAM: vBaseEnvHwRegionSize=32768, vBaseEnvHwRegionStartAddress=4276092928, vBaseEnvHwRegionEccAlignment=4
          vBaseEnvClockSettings: vBaseEnvOscClock=8000000, vBaseEnvPeriphClock=40000000, vBaseEnvTimebaseClock=80000000
        RH850_1045: vBaseEnvCpuMaxFrequency=80000000, vBaseEnvAvailableChannels_Flexray=0, vBaseEnvAvailableChannels_Can=3, vBaseEnvAvailableChannels_Lin=7, vBaseEnvAvailableChannels_Ethernet=0, vBaseEnvCpuCoreAmount=1, vBaseEnvTestedDerivative=RH850_1045, vBaseEnvTestedDerivativeDescription=Renesas RH850 F1L Family R7F701045, vBaseEnvCpuCore=G3K
          vBaseEnvAdditionalParameters: vBaseEnvClockGroup=A, vBaseEnvDerivativeGroup=F1L, vBaseEnvPllGroup=A, vBaseEnvProtectionGroup=A, vBaseEnvPortGroup=A, vBaseEnvResetGroup=A
          5 x vBaseEnvMemLayoutHwRegion:
            CodeFlash_A: vBaseEnvHwRegionSize=1048576, vBaseEnvHwRegionStartAddress=0
            LocalRAM_CPU0: vBaseEnvHwRegionSize=98304, vBaseEnvHwRegionStartAddress=4275994624, vBaseEnvHwRegionEccAlignment=4
            DataFlash: vBaseEnvHwRegionSize=32768, vBaseEnvHwRegionStartAddress=4280287232
            CodeFlash_Ext: vBaseEnvHwRegionSize=32768, vBaseEnvHwRegionStartAddress=16777216
            RetentionRAM: vBaseEnvHwRegionSize=32768, vBaseEnvHwRegionStartAddress=4276092928, vBaseEnvHwRegionEccAlignment=4
          vBaseEnvClockSettings: vBaseEnvOscClock=8000000, vBaseEnvPeriphClock=40000000, vBaseEnvTimebaseClock=80000000
        RH850_1047: vBaseEnvCpuMaxFrequency=96000000, vBaseEnvAvailableChannels_Flexray=0, vBaseEnvAvailableChannels_Can=4, vBaseEnvAvailableChannels_Lin=6, vBaseEnvAvailableChannels_Ethernet=0, vBaseEnvCpuCoreAmount=1, vBaseEnvTestedDerivative=RH850_1047, vBaseEnvTestedDerivativeDescription=Renesas RH850 F1L Family R7F701047, vBaseEnvCpuCore=G3K
          vBaseEnvAdditionalParameters: vBaseEnvClockGroup=A, vBaseEnvDerivativeGroup=F1L, vBaseEnvPllGroup=A, vBaseEnvProtectionGroup=A, vBaseEnvPortGroup=A, vBaseEnvResetGroup=A
          5 x vBaseEnvMemLayoutHwRegion:
            CodeFlash_A: vBaseEnvHwRegionSize=1048576, vBaseEnvHwRegionStartAddress=0
            LocalRAM_CPU0: vBaseEnvHwRegionSize=98304, vBaseEnvHwRegionStartAddress=4275994624, vBaseEnvHwRegionEccAlignment=4
            DataFlash: vBaseEnvHwRegionSize=32768, vBaseEnvHwRegionStartAddress=4280287232
            CodeFlash_Ext: vBaseEnvHwRegionSize=32768, vBaseEnvHwRegionStartAddress=16777216
            RetentionRAM: vBaseEnvHwRegionSize=32768, vBaseEnvHwRegionStartAddress=4276092928, vBaseEnvHwRegionEccAlignment=4
          vBaseEnvClockSettings: vBaseEnvOscClock=8000000, vBaseEnvPeriphClock=40000000, vBaseEnvTimebaseClock=80000000
        RH850_1049: vBaseEnvCpuMaxFrequency=96000000, vBaseEnvAvailableChannels_Flexray=0, vBaseEnvAvailableChannels_Can=6, vBaseEnvAvailableChannels_Lin=12, vBaseEnvAvailableChannels_Ethernet=0, vBaseEnvCpuCoreAmount=1, vBaseEnvTestedDerivative=RH850_1049, vBaseEnvTestedDerivativeDescription=Renesas RH850 F1L Family R7F701049, vBaseEnvCpuCore=G3K
          vBaseEnvAdditionalParameters: vBaseEnvClockGroup=A, vBaseEnvDerivativeGroup=F1L, vBaseEnvPllGroup=A, vBaseEnvProtectionGroup=A, vBaseEnvPortGroup=A, vBaseEnvResetGroup=A
          5 x vBaseEnvMemLayoutHwRegion:
            CodeFlash_A: vBaseEnvHwRegionSize=2097152, vBaseEnvHwRegionStartAddress=0
            LocalRAM_CPU0: vBaseEnvHwRegionSize=131072, vBaseEnvHwRegionStartAddress=4275961856, vBaseEnvHwRegionEccAlignment=4
            DataFlash: vBaseEnvHwRegionSize=32768, vBaseEnvHwRegionStartAddress=4280287232
            CodeFlash_Ext: vBaseEnvHwRegionSize=32768, vBaseEnvHwRegionStartAddress=16777216
            RetentionRAM: vBaseEnvHwRegionSize=32768, vBaseEnvHwRegionStartAddress=4276092928, vBaseEnvHwRegionEccAlignment=4
          vBaseEnvClockSettings: vBaseEnvOscClock=8000000, vBaseEnvPeriphClock=40000000, vBaseEnvTimebaseClock=80000000
        RH850_1053: vBaseEnvCpuMaxFrequency=96000000, vBaseEnvAvailableChannels_Flexray=0, vBaseEnvAvailableChannels_Can=6, vBaseEnvAvailableChannels_Lin=16, vBaseEnvAvailableChannels_Ethernet=0, vBaseEnvCpuCoreAmount=1, vBaseEnvTestedDerivative=RH850_1053, vBaseEnvTestedDerivativeDescription=Renesas RH850 F1L Family R7F701053, vBaseEnvCpuCore=G3K
          vBaseEnvAdditionalParameters: vBaseEnvClockGroup=A, vBaseEnvDerivativeGroup=F1L, vBaseEnvPllGroup=A, vBaseEnvProtectionGroup=A, vBaseEnvPortGroup=A, vBaseEnvResetGroup=A
          5 x vBaseEnvMemLayoutHwRegion:
            CodeFlash_A: vBaseEnvHwRegionSize=2097152, vBaseEnvHwRegionStartAddress=0
            LocalRAM_CPU0: vBaseEnvHwRegionSize=131072, vBaseEnvHwRegionStartAddress=4275961856, vBaseEnvHwRegionEccAlignment=4
            DataFlash: vBaseEnvHwRegionSize=32768, vBaseEnvHwRegionStartAddress=4280287232
            CodeFlash_Ext: vBaseEnvHwRegionSize=32768, vBaseEnvHwRegionStartAddress=16777216
            RetentionRAM: vBaseEnvHwRegionSize=32768, vBaseEnvHwRegionStartAddress=4276092928, vBaseEnvHwRegionEccAlignment=4
          vBaseEnvClockSettings: vBaseEnvOscClock=8000000, vBaseEnvPeriphClock=40000000, vBaseEnvTimebaseClock=80000000
        RH850_1054: vBaseEnvCpuMaxFrequency=96000000, vBaseEnvAvailableChannels_Flexray=0, vBaseEnvAvailableChannels_Can=6, vBaseEnvAvailableChannels_Lin=12, vBaseEnvAvailableChannels_Ethernet=0, vBaseEnvCpuCoreAmount=1, vBaseEnvTestedDerivative=RH850_1054, vBaseEnvTestedDerivativeDescription=Renesas RH850 F1L Family R7F701054, vBaseEnvCpuCore=G3K
          vBaseEnvAdditionalParameters: vBaseEnvClockGroup=A, vBaseEnvDerivativeGroup=F1L, vBaseEnvPllGroup=A, vBaseEnvProtectionGroup=A, vBaseEnvPortGroup=A, vBaseEnvResetGroup=A
          5 x vBaseEnvMemLayoutHwRegion:
            CodeFlash_A: vBaseEnvHwRegionSize=1572864, vBaseEnvHwRegionStartAddress=0
            LocalRAM_CPU0: vBaseEnvHwRegionSize=131072, vBaseEnvHwRegionStartAddress=4275961856, vBaseEnvHwRegionEccAlignment=4
            DataFlash: vBaseEnvHwRegionSize=65536, vBaseEnvHwRegionStartAddress=4280287232
            CodeFlash_Ext: vBaseEnvHwRegionSize=32768, vBaseEnvHwRegionStartAddress=16777216
            RetentionRAM: vBaseEnvHwRegionSize=32768, vBaseEnvHwRegionStartAddress=4276092928, vBaseEnvHwRegionEccAlignment=4
          vBaseEnvClockSettings: vBaseEnvOscClock=8000000, vBaseEnvPeriphClock=40000000, vBaseEnvTimebaseClock=80000000
        RH850_1057: vBaseEnvCpuMaxFrequency=96000000, vBaseEnvAvailableChannels_Flexray=0, vBaseEnvAvailableChannels_Can=6, vBaseEnvAvailableChannels_Lin=16, vBaseEnvAvailableChannels_Ethernet=0, vBaseEnvCpuCoreAmount=1, vBaseEnvTestedDerivative=RH850_1057, vBaseEnvTestedDerivativeDescription=Renesas RH850 F1L Family R7F701057, vBaseEnvCpuCore=G3K
          vBaseEnvAdditionalParameters: vBaseEnvClockGroup=A, vBaseEnvDerivativeGroup=F1L, vBaseEnvPllGroup=A, vBaseEnvProtectionGroup=A, vBaseEnvPortGroup=A, vBaseEnvResetGroup=A
          5 x vBaseEnvMemLayoutHwRegion:
            CodeFlash_A: vBaseEnvHwRegionSize=2097152, vBaseEnvHwRegionStartAddress=0
            LocalRAM_CPU0: vBaseEnvHwRegionSize=131072, vBaseEnvHwRegionStartAddress=4275961856, vBaseEnvHwRegionEccAlignment=4
            DataFlash: vBaseEnvHwRegionSize=65536, vBaseEnvHwRegionStartAddress=4280287232
            CodeFlash_Ext: vBaseEnvHwRegionSize=32768, vBaseEnvHwRegionStartAddress=16777216
            RetentionRAM: vBaseEnvHwRegionSize=32768, vBaseEnvHwRegionStartAddress=4276092928, vBaseEnvHwRegionEccAlignment=4
          vBaseEnvClockSettings: vBaseEnvOscClock=8000000, vBaseEnvPeriphClock=40000000, vBaseEnvTimebaseClock=80000000
        RH850_1A33: vBaseEnvCpuMaxFrequency=96000000, vBaseEnvAvailableChannels_Flexray=0, vBaseEnvAvailableChannels_Can=3, vBaseEnvAvailableChannels_Lin=7, vBaseEnvAvailableChannels_Ethernet=0, vBaseEnvCpuCoreAmount=1, vBaseEnvTestedDerivative=RH850_1A33, vBaseEnvTestedDerivativeDescription=Renesas RH850 F1L Family R7F701A33, vBaseEnvCpuCore=G3K
          vBaseEnvAdditionalParameters: vBaseEnvClockGroup=A, vBaseEnvDerivativeGroup=F1L, vBaseEnvPllGroup=A, vBaseEnvProtectionGroup=A, vBaseEnvPortGroup=A, vBaseEnvResetGroup=A
          5 x vBaseEnvMemLayoutHwRegion:
            CodeFlash_A: vBaseEnvHwRegionSize=524288, vBaseEnvHwRegionStartAddress=0
            LocalRAM_CPU0: vBaseEnvHwRegionSize=32768, vBaseEnvHwRegionStartAddress=4276060160, vBaseEnvHwRegionEccAlignment=4
            DataFlash: vBaseEnvHwRegionSize=32768, vBaseEnvHwRegionStartAddress=4280287232
            CodeFlash_Ext: vBaseEnvHwRegionSize=32768, vBaseEnvHwRegionStartAddress=16777216
            RetentionRAM: vBaseEnvHwRegionSize=32768, vBaseEnvHwRegionStartAddress=4276092928, vBaseEnvHwRegionEccAlignment=4
          vBaseEnvClockSettings: vBaseEnvOscClock=8000000, vBaseEnvPeriphClock=40000000, vBaseEnvTimebaseClock=80000000
        RH850_1544: vBaseEnvCpuMaxFrequency=120000000, vBaseEnvAvailableChannels_Flexray=2, vBaseEnvAvailableChannels_Can=6, vBaseEnvAvailableChannels_Lin=12, vBaseEnvAvailableChannels_Ethernet=0, vBaseEnvCpuCoreAmount=1, vBaseEnvTestedDerivative=RH850_1544, vBaseEnvTestedDerivativeDescription=Renesas RH850 F1M Family R7F701544, vBaseEnvCpuCore=G3M
          vBaseEnvAdditionalParameters: vBaseEnvClockGroup=A, vBaseEnvDerivativeGroup=F1M, vBaseEnvPllGroup=A1, vBaseEnvProtectionGroup=A, vBaseEnvPortGroup=A, vBaseEnvResetGroup=A
          6 x vBaseEnvMemLayoutHwRegion:
            CodeFlash_A: vBaseEnvHwRegionSize=3145728, vBaseEnvHwRegionStartAddress=0
            LocalRAM_CPU0: vBaseEnvHwRegionSize=196608, vBaseEnvHwRegionStartAddress=4273799168, vBaseEnvHwRegionEccAlignment=4
            DataFlash: vBaseEnvHwRegionSize=65536, vBaseEnvHwRegionStartAddress=4280287232
            CodeFlash_Ext: vBaseEnvHwRegionSize=32768, vBaseEnvHwRegionStartAddress=16777216
            RetentionRAM: vBaseEnvHwRegionSize=65536, vBaseEnvHwRegionStartAddress=4277141504, vBaseEnvHwRegionEccAlignment=4
            FCU_RAM: vBaseEnvHwRegionSize=4096, vBaseEnvHwRegionStartAddress=4288749568, vBaseEnvHwRegionEccAlignment=4
          vBaseEnvClockSettings: vBaseEnvOscClock=16000000, vBaseEnvPeriphClock=60000000, vBaseEnvTimebaseClock=120000000
        RH850_1545: vBaseEnvCpuMaxFrequency=120000000, vBaseEnvAvailableChannels_Flexray=2, vBaseEnvAvailableChannels_Can=6, vBaseEnvAvailableChannels_Lin=12, vBaseEnvAvailableChannels_Ethernet=0, vBaseEnvCpuCoreAmount=1, vBaseEnvTestedDerivative=RH850_1545, vBaseEnvTestedDerivativeDescription=Renesas RH850 F1M Family R7F701545, vBaseEnvCpuCore=G3M
          vBaseEnvAdditionalParameters: vBaseEnvClockGroup=A, vBaseEnvDerivativeGroup=F1M, vBaseEnvPllGroup=A1, vBaseEnvProtectionGroup=A, vBaseEnvPortGroup=A, vBaseEnvResetGroup=A
          6 x vBaseEnvMemLayoutHwRegion:
            CodeFlash_A: vBaseEnvHwRegionSize=4194304, vBaseEnvHwRegionStartAddress=0
            LocalRAM_CPU0: vBaseEnvHwRegionSize=262144, vBaseEnvHwRegionStartAddress=4273733632, vBaseEnvHwRegionEccAlignment=4
            DataFlash: vBaseEnvHwRegionSize=65536, vBaseEnvHwRegionStartAddress=4280287232
            CodeFlash_Ext: vBaseEnvHwRegionSize=32768, vBaseEnvHwRegionStartAddress=16777216
            RetentionRAM: vBaseEnvHwRegionSize=65536, vBaseEnvHwRegionStartAddress=4277141504, vBaseEnvHwRegionEccAlignment=4
            FCU_RAM: vBaseEnvHwRegionSize=4096, vBaseEnvHwRegionStartAddress=4288749568, vBaseEnvHwRegionEccAlignment=4
          vBaseEnvClockSettings: vBaseEnvOscClock=16000000, vBaseEnvPeriphClock=60000000, vBaseEnvTimebaseClock=120000000
        RH850_1548: vBaseEnvCpuMaxFrequency=120000000, vBaseEnvAvailableChannels_Flexray=2, vBaseEnvAvailableChannels_Can=6, vBaseEnvAvailableChannels_Lin=16, vBaseEnvAvailableChannels_Ethernet=0, vBaseEnvCpuCoreAmount=1, vBaseEnvTestedDerivative=RH850_1548, vBaseEnvTestedDerivativeDescription=Renesas RH850 F1M Family R7F701548, vBaseEnvCpuCore=G3M
          vBaseEnvAdditionalParameters: vBaseEnvClockGroup=A, vBaseEnvDerivativeGroup=F1M, vBaseEnvPllGroup=A1, vBaseEnvProtectionGroup=A, vBaseEnvPortGroup=A, vBaseEnvResetGroup=A
          6 x vBaseEnvMemLayoutHwRegion:
            CodeFlash_A: vBaseEnvHwRegionSize=3145728, vBaseEnvHwRegionStartAddress=0
            LocalRAM_CPU0: vBaseEnvHwRegionSize=196608, vBaseEnvHwRegionStartAddress=4273799168, vBaseEnvHwRegionEccAlignment=4
            DataFlash: vBaseEnvHwRegionSize=65536, vBaseEnvHwRegionStartAddress=4280287232
            CodeFlash_Ext: vBaseEnvHwRegionSize=32768, vBaseEnvHwRegionStartAddress=16777216
            RetentionRAM: vBaseEnvHwRegionSize=65536, vBaseEnvHwRegionStartAddress=4277141504, vBaseEnvHwRegionEccAlignment=4
            FCU_RAM: vBaseEnvHwRegionSize=4096, vBaseEnvHwRegionStartAddress=4288749568, vBaseEnvHwRegionEccAlignment=4
          vBaseEnvClockSettings: vBaseEnvOscClock=16000000, vBaseEnvPeriphClock=60000000, vBaseEnvTimebaseClock=120000000
        RH850_1549: vBaseEnvCpuMaxFrequency=120000000, vBaseEnvAvailableChannels_Flexray=2, vBaseEnvAvailableChannels_Can=6, vBaseEnvAvailableChannels_Lin=16, vBaseEnvAvailableChannels_Ethernet=0, vBaseEnvCpuCoreAmount=1, vBaseEnvTestedDerivative=RH850_1549, vBaseEnvTestedDerivativeDescription=Renesas RH850 F1M Family R7F701549, vBaseEnvCpuCore=G3M
          vBaseEnvAdditionalParameters: vBaseEnvClockGroup=A, vBaseEnvDerivativeGroup=F1M, vBaseEnvPllGroup=A1, vBaseEnvProtectionGroup=A, vBaseEnvPortGroup=A, vBaseEnvResetGroup=A
          6 x vBaseEnvMemLayoutHwRegion:
            CodeFlash_A: vBaseEnvHwRegionSize=4194304, vBaseEnvHwRegionStartAddress=0
            LocalRAM_CPU0: vBaseEnvHwRegionSize=262144, vBaseEnvHwRegionStartAddress=4273733632, vBaseEnvHwRegionEccAlignment=4
            DataFlash: vBaseEnvHwRegionSize=65536, vBaseEnvHwRegionStartAddress=4280287232
            CodeFlash_Ext: vBaseEnvHwRegionSize=32768, vBaseEnvHwRegionStartAddress=16777216
            RetentionRAM: vBaseEnvHwRegionSize=65536, vBaseEnvHwRegionStartAddress=4277141504, vBaseEnvHwRegionEccAlignment=4
            FCU_RAM: vBaseEnvHwRegionSize=4096, vBaseEnvHwRegionStartAddress=4288749568, vBaseEnvHwRegionEccAlignment=4
          vBaseEnvClockSettings: vBaseEnvOscClock=16000000, vBaseEnvPeriphClock=60000000, vBaseEnvTimebaseClock=120000000
        RH850_1552: vBaseEnvCpuMaxFrequency=120000000, vBaseEnvAvailableChannels_Flexray=2, vBaseEnvAvailableChannels_Can=6, vBaseEnvAvailableChannels_Lin=16, vBaseEnvAvailableChannels_Ethernet=0, vBaseEnvCpuCoreAmount=1, vBaseEnvTestedDerivative=RH850_1552, vBaseEnvTestedDerivativeDescription=Renesas RH850 F1M Family R7F701552, vBaseEnvCpuCore=G3M
          vBaseEnvAdditionalParameters: vBaseEnvClockGroup=A, vBaseEnvDerivativeGroup=F1M, vBaseEnvPllGroup=A1, vBaseEnvProtectionGroup=A, vBaseEnvPortGroup=A, vBaseEnvResetGroup=A
          6 x vBaseEnvMemLayoutHwRegion:
            CodeFlash_A: vBaseEnvHwRegionSize=3145728, vBaseEnvHwRegionStartAddress=0
            LocalRAM_CPU0: vBaseEnvHwRegionSize=196608, vBaseEnvHwRegionStartAddress=4273799168, vBaseEnvHwRegionEccAlignment=4
            DataFlash: vBaseEnvHwRegionSize=65536, vBaseEnvHwRegionStartAddress=4280287232
            CodeFlash_Ext: vBaseEnvHwRegionSize=32768, vBaseEnvHwRegionStartAddress=16777216
            RetentionRAM: vBaseEnvHwRegionSize=65536, vBaseEnvHwRegionStartAddress=4277141504, vBaseEnvHwRegionEccAlignment=4
            FCU_RAM: vBaseEnvHwRegionSize=4096, vBaseEnvHwRegionStartAddress=4288749568, vBaseEnvHwRegionEccAlignment=4
          vBaseEnvClockSettings: vBaseEnvOscClock=16000000, vBaseEnvPeriphClock=60000000, vBaseEnvTimebaseClock=120000000
        RH850_1564: vBaseEnvCpuMaxFrequency=120000000, vBaseEnvAvailableChannels_Flexray=2, vBaseEnvAvailableChannels_Can=6, vBaseEnvAvailableChannels_Lin=12, vBaseEnvAvailableChannels_Ethernet=0, vBaseEnvCpuCoreAmount=1, vBaseEnvTestedDerivative=RH850_1564, vBaseEnvTestedDerivativeDescription=Renesas RH850 F1M Family R7F701564, vBaseEnvCpuCore=G3M
          vBaseEnvAdditionalParameters: vBaseEnvClockGroup=A, vBaseEnvDerivativeGroup=F1M, vBaseEnvPllGroup=A1, vBaseEnvProtectionGroup=A, vBaseEnvPortGroup=A, vBaseEnvResetGroup=A
          6 x vBaseEnvMemLayoutHwRegion:
            CodeFlash_A: vBaseEnvHwRegionSize=3145728, vBaseEnvHwRegionStartAddress=0
            LocalRAM_CPU0: vBaseEnvHwRegionSize=196608, vBaseEnvHwRegionStartAddress=4273799168, vBaseEnvHwRegionEccAlignment=4
            DataFlash: vBaseEnvHwRegionSize=65536, vBaseEnvHwRegionStartAddress=4280287232
            CodeFlash_Ext: vBaseEnvHwRegionSize=32768, vBaseEnvHwRegionStartAddress=16777216
            RetentionRAM: vBaseEnvHwRegionSize=65536, vBaseEnvHwRegionStartAddress=4277141504, vBaseEnvHwRegionEccAlignment=4
            FCU_RAM: vBaseEnvHwRegionSize=4096, vBaseEnvHwRegionStartAddress=4288749568, vBaseEnvHwRegionEccAlignment=4
          vBaseEnvClockSettings: vBaseEnvOscClock=16000000, vBaseEnvPeriphClock=60000000, vBaseEnvTimebaseClock=120000000
        RH850_1565: vBaseEnvCpuMaxFrequency=120000000, vBaseEnvAvailableChannels_Flexray=2, vBaseEnvAvailableChannels_Can=6, vBaseEnvAvailableChannels_Lin=12, vBaseEnvAvailableChannels_Ethernet=0, vBaseEnvCpuCoreAmount=1, vBaseEnvTestedDerivative=RH850_1565, vBaseEnvTestedDerivativeDescription=Renesas RH850 F1M Family R7F701565, vBaseEnvCpuCore=G3M
          vBaseEnvAdditionalParameters: vBaseEnvClockGroup=A, vBaseEnvDerivativeGroup=F1M, vBaseEnvPllGroup=A1, vBaseEnvProtectionGroup=A, vBaseEnvPortGroup=A, vBaseEnvResetGroup=A
          6 x vBaseEnvMemLayoutHwRegion:
            CodeFlash_A: vBaseEnvHwRegionSize=4194304, vBaseEnvHwRegionStartAddress=0
            LocalRAM_CPU0: vBaseEnvHwRegionSize=262144, vBaseEnvHwRegionStartAddress=4273733632, vBaseEnvHwRegionEccAlignment=4
            DataFlash: vBaseEnvHwRegionSize=65536, vBaseEnvHwRegionStartAddress=4280287232
            CodeFlash_Ext: vBaseEnvHwRegionSize=32768, vBaseEnvHwRegionStartAddress=16777216
            RetentionRAM: vBaseEnvHwRegionSize=65536, vBaseEnvHwRegionStartAddress=4277141504, vBaseEnvHwRegionEccAlignment=4
            FCU_RAM: vBaseEnvHwRegionSize=4096, vBaseEnvHwRegionStartAddress=4288749568, vBaseEnvHwRegionEccAlignment=4
          vBaseEnvClockSettings: vBaseEnvOscClock=16000000, vBaseEnvPeriphClock=60000000, vBaseEnvTimebaseClock=120000000
        RH850_1568: vBaseEnvCpuMaxFrequency=120000000, vBaseEnvAvailableChannels_Flexray=2, vBaseEnvAvailableChannels_Can=6, vBaseEnvAvailableChannels_Lin=16, vBaseEnvAvailableChannels_Ethernet=0, vBaseEnvCpuCoreAmount=1, vBaseEnvTestedDerivative=RH850_1568, vBaseEnvTestedDerivativeDescription=Renesas RH850 F1M Family R7F701568, vBaseEnvCpuCore=G3M
          vBaseEnvAdditionalParameters: vBaseEnvClockGroup=A, vBaseEnvDerivativeGroup=F1M, vBaseEnvPllGroup=A1, vBaseEnvProtectionGroup=A, vBaseEnvPortGroup=A, vBaseEnvResetGroup=A
          6 x vBaseEnvMemLayoutHwRegion:
            CodeFlash_A: vBaseEnvHwRegionSize=3145728, vBaseEnvHwRegionStartAddress=0
            LocalRAM_CPU0: vBaseEnvHwRegionSize=196608, vBaseEnvHwRegionStartAddress=4273799168, vBaseEnvHwRegionEccAlignment=4
            DataFlash: vBaseEnvHwRegionSize=65536, vBaseEnvHwRegionStartAddress=4280287232
            CodeFlash_Ext: vBaseEnvHwRegionSize=32768, vBaseEnvHwRegionStartAddress=16777216
            RetentionRAM: vBaseEnvHwRegionSize=65536, vBaseEnvHwRegionStartAddress=4277141504, vBaseEnvHwRegionEccAlignment=4
            FCU_RAM: vBaseEnvHwRegionSize=4096, vBaseEnvHwRegionStartAddress=4288749568, vBaseEnvHwRegionEccAlignment=4
          vBaseEnvClockSettings: vBaseEnvOscClock=16000000, vBaseEnvPeriphClock=60000000, vBaseEnvTimebaseClock=120000000
        RH850_1569: vBaseEnvCpuMaxFrequency=120000000, vBaseEnvAvailableChannels_Flexray=2, vBaseEnvAvailableChannels_Can=6, vBaseEnvAvailableChannels_Lin=16, vBaseEnvAvailableChannels_Ethernet=0, vBaseEnvCpuCoreAmount=1, vBaseEnvTestedDerivative=RH850_1569, vBaseEnvTestedDerivativeDescription=Renesas RH850 F1M Family R7F701569, vBaseEnvCpuCore=G3M
          vBaseEnvAdditionalParameters: vBaseEnvClockGroup=A, vBaseEnvDerivativeGroup=F1M, vBaseEnvPllGroup=A1, vBaseEnvProtectionGroup=A, vBaseEnvPortGroup=A, vBaseEnvResetGroup=A
          6 x vBaseEnvMemLayoutHwRegion:
            CodeFlash_A: vBaseEnvHwRegionSize=4194304, vBaseEnvHwRegionStartAddress=0
            LocalRAM_CPU0: vBaseEnvHwRegionSize=262144, vBaseEnvHwRegionStartAddress=4273733632, vBaseEnvHwRegionEccAlignment=4
            DataFlash: vBaseEnvHwRegionSize=65536, vBaseEnvHwRegionStartAddress=4280287232
            CodeFlash_Ext: vBaseEnvHwRegionSize=32768, vBaseEnvHwRegionStartAddress=16777216
            RetentionRAM: vBaseEnvHwRegionSize=65536, vBaseEnvHwRegionStartAddress=4277141504, vBaseEnvHwRegionEccAlignment=4
            FCU_RAM: vBaseEnvHwRegionSize=4096, vBaseEnvHwRegionStartAddress=4288749568, vBaseEnvHwRegionEccAlignment=4
          vBaseEnvClockSettings: vBaseEnvOscClock=16000000, vBaseEnvPeriphClock=60000000, vBaseEnvTimebaseClock=120000000
        RH850_1371: vBaseEnvCpuMaxFrequency=240000000, vBaseEnvAvailableChannels_Flexray=4, vBaseEnvAvailableChannels_Can=4, vBaseEnvAvailableChannels_Lin=4, vBaseEnvAvailableChannels_Ethernet=1, vBaseEnvCpuCoreAmount=2, vBaseEnvTestedDerivative=RH850_1371, vBaseEnvTestedDerivativeDescription=Renesas RH850 P1H Family R7F701371, vBaseEnvCpuCore=G3M
          vBaseEnvAdditionalParameters:
            vBaseEnvClockGroup = D
            vBaseEnvDerivativeGroup = P1H
            vBaseEnvPllGroup = D
            vBaseEnvProtectionGroup = NONE
            vBaseEnvPortGroup = B2
            vBaseEnvResetGroup = D
            vBaseEnvPowerDownModes = true
          8 x vBaseEnvMemLayoutHwRegion:
            CodeFlash_A: vBaseEnvHwRegionSize=4194304, vBaseEnvHwRegionStartAddress=0
            CodeFlash_B: vBaseEnvHwRegionSize=4194304, vBaseEnvHwRegionStartAddress=8388608
            LocalRAM_CPU0: vBaseEnvHwRegionSize=65536, vBaseEnvHwRegionStartAddress=4273930240, vBaseEnvHwRegionEccAlignment=4
            LocalRAM_CPU1: vBaseEnvHwRegionSize=65536, vBaseEnvHwRegionStartAddress=4271833088, vBaseEnvHwRegionEccAlignment=4
            GlobalRAM_A: vBaseEnvHwRegionSize=491520, vBaseEnvHwRegionStartAddress=4276649984, vBaseEnvHwRegionEccAlignment=4
            GlobalRAM_B: vBaseEnvHwRegionSize=491520, vBaseEnvHwRegionStartAddress=4277141504, vBaseEnvHwRegionEccAlignment=4
            DataFlash: vBaseEnvHwRegionSize=196608, vBaseEnvHwRegionStartAddress=4280287232
            LocalRAM_Self: vBaseEnvHwRegionSize=65536, vBaseEnvHwRegionStartAddress=4276027392, vBaseEnvHwRegionEccAlignment=4
          vBaseEnvClockSettings: vBaseEnvOscClock=16000000, vBaseEnvPeriphClock=80000000, vBaseEnvTimebaseClock=240000000
        RH850_1372: vBaseEnvCpuMaxFrequency=240000000, vBaseEnvAvailableChannels_Flexray=4, vBaseEnvAvailableChannels_Can=2, vBaseEnvAvailableChannels_Lin=4, vBaseEnvAvailableChannels_Ethernet=1, vBaseEnvCpuCoreAmount=2, vBaseEnvTestedDerivative=RH850_1372, vBaseEnvTestedDerivativeDescription=Renesas RH850 P1H Family R7F701372, vBaseEnvCpuCore=G3M
          vBaseEnvAdditionalParameters:
            vBaseEnvClockGroup = D
            vBaseEnvDerivativeGroup = P1H
            vBaseEnvPllGroup = D
            vBaseEnvProtectionGroup = NONE
            vBaseEnvPortGroup = B2
            vBaseEnvResetGroup = D
            vBaseEnvPowerDownModes = true
          8 x vBaseEnvMemLayoutHwRegion:
            CodeFlash_A: vBaseEnvHwRegionSize=2097152, vBaseEnvHwRegionStartAddress=0
            CodeFlash_B: vBaseEnvHwRegionSize=2097152, vBaseEnvHwRegionStartAddress=8388608
            LocalRAM_CPU0: vBaseEnvHwRegionSize=65536, vBaseEnvHwRegionStartAddress=4273930240, vBaseEnvHwRegionEccAlignment=4
            LocalRAM_CPU1: vBaseEnvHwRegionSize=65536, vBaseEnvHwRegionStartAddress=4271833088, vBaseEnvHwRegionEccAlignment=4
            GlobalRAM_A: vBaseEnvHwRegionSize=491520, vBaseEnvHwRegionStartAddress=4276649984, vBaseEnvHwRegionEccAlignment=4
            GlobalRAM_B: vBaseEnvHwRegionSize=491520, vBaseEnvHwRegionStartAddress=4277141504, vBaseEnvHwRegionEccAlignment=4
            DataFlash: vBaseEnvHwRegionSize=131072, vBaseEnvHwRegionStartAddress=4280287232
            LocalRAM_Self: vBaseEnvHwRegionSize=65536, vBaseEnvHwRegionStartAddress=4276027392, vBaseEnvHwRegionEccAlignment=4
          vBaseEnvClockSettings: vBaseEnvOscClock=16000000, vBaseEnvPeriphClock=80000000, vBaseEnvTimebaseClock=240000000
        RH850_1390: vBaseEnvCpuMaxFrequency=120000000, vBaseEnvAvailableChannels_Flexray=0, vBaseEnvAvailableChannels_Can=2, vBaseEnvAvailableChannels_Lin=2, vBaseEnvAvailableChannels_Ethernet=0, vBaseEnvCpuCoreAmount=1, vBaseEnvTestedDerivative=RH850_1390, vBaseEnvTestedDerivativeDescription=Renesas RH850 P1L-C Family R7F701390, vBaseEnvCpuCore=G3M
          vBaseEnvAdditionalParameters: vBaseEnvClockGroup=D, vBaseEnvDerivativeGroup=P1L_C, vBaseEnvPllGroup=E, vBaseEnvProtectionGroup=A, vBaseEnvPortGroup=F, vBaseEnvResetGroup=C
          4 x vBaseEnvMemLayoutHwRegion:
            CodeFlash_A: vBaseEnvHwRegionSize=524288, vBaseEnvHwRegionStartAddress=0
            LocalRAM_CPU0: vBaseEnvHwRegionSize=65536, vBaseEnvHwRegionStartAddress=4273930240, vBaseEnvHwRegionEccAlignment=4
            DataFlash: vBaseEnvHwRegionSize=32768, vBaseEnvHwRegionStartAddress=4280287232
            CodeFlash_Ext: vBaseEnvHwRegionSize=1024, vBaseEnvHwRegionStartAddress=16818176
          vBaseEnvClockSettings: vBaseEnvOscClock=16000000, vBaseEnvPeriphClock=40000000, vBaseEnvTimebaseClock=120000000
        RH850_1391: vBaseEnvCpuMaxFrequency=120000000, vBaseEnvAvailableChannels_Flexray=0, vBaseEnvAvailableChannels_Can=2, vBaseEnvAvailableChannels_Lin=2, vBaseEnvAvailableChannels_Ethernet=0, vBaseEnvCpuCoreAmount=1, vBaseEnvTestedDerivative=RH850_1391, vBaseEnvTestedDerivativeDescription=Renesas RH850 P1L-C Family R7F701391, vBaseEnvCpuCore=G3M
          vBaseEnvAdditionalParameters: vBaseEnvClockGroup=D, vBaseEnvDerivativeGroup=P1L_C, vBaseEnvPllGroup=E, vBaseEnvProtectionGroup=A, vBaseEnvPortGroup=F, vBaseEnvResetGroup=C
          4 x vBaseEnvMemLayoutHwRegion:
            CodeFlash_A: vBaseEnvHwRegionSize=524288, vBaseEnvHwRegionStartAddress=0
            LocalRAM_CPU0: vBaseEnvHwRegionSize=65536, vBaseEnvHwRegionStartAddress=4273930240, vBaseEnvHwRegionEccAlignment=4
            DataFlash: vBaseEnvHwRegionSize=32768, vBaseEnvHwRegionStartAddress=4280287232
            CodeFlash_Ext: vBaseEnvHwRegionSize=1024, vBaseEnvHwRegionStartAddress=16818176
          vBaseEnvClockSettings: vBaseEnvOscClock=16000000, vBaseEnvPeriphClock=40000000, vBaseEnvTimebaseClock=120000000
        RH850_1310: vBaseEnvCpuMaxFrequency=160000000, vBaseEnvAvailableChannels_Flexray=2, vBaseEnvAvailableChannels_Can=2, vBaseEnvAvailableChannels_Lin=2, vBaseEnvAvailableChannels_Ethernet=0, vBaseEnvCpuCoreAmount=1, vBaseEnvTestedDerivative=RH850_1310, vBaseEnvTestedDerivativeDescription=Renesas RH850 P1M Family R7F701310, vBaseEnvCpuCore=G3M
          vBaseEnvAdditionalParameters: vBaseEnvClockGroup=B, vBaseEnvDerivativeGroup=P1M, vBaseEnvPllGroup=B, vBaseEnvProtectionGroup=B, vBaseEnvPortGroup=B, vBaseEnvResetGroup=B
          6 x vBaseEnvMemLayoutHwRegion:
            CodeFlash_A: vBaseEnvHwRegionSize=1048576, vBaseEnvHwRegionStartAddress=0
            LocalRAM_CPU0: vBaseEnvHwRegionSize=131072, vBaseEnvHwRegionStartAddress=4273864704, vBaseEnvHwRegionEccAlignment=4
            DataFlash: vBaseEnvHwRegionSize=32768, vBaseEnvHwRegionStartAddress=4280287232
            CodeFlash_Ext: vBaseEnvHwRegionSize=32768, vBaseEnvHwRegionStartAddress=16777216
            FCU_RAM: vBaseEnvHwRegionSize=4096, vBaseEnvHwRegionStartAddress=4288749568, vBaseEnvHwRegionEccAlignment=4
            LocalRAM_Self: vBaseEnvHwRegionSize=131072, vBaseEnvHwRegionStartAddress=4275961856, vBaseEnvHwRegionEccAlignment=4
          vBaseEnvClockSettings: vBaseEnvOscClock=16000000, vBaseEnvPeriphClock=80000000, vBaseEnvTimebaseClock=160000000
        RH850_1311: vBaseEnvCpuMaxFrequency=160000000, vBaseEnvAvailableChannels_Flexray=2, vBaseEnvAvailableChannels_Can=2, vBaseEnvAvailableChannels_Lin=2, vBaseEnvAvailableChannels_Ethernet=0, vBaseEnvCpuCoreAmount=1, vBaseEnvTestedDerivative=RH850_1311, vBaseEnvTestedDerivativeDescription=Renesas RH850 P1M Family R7F701311, vBaseEnvCpuCore=G3M
          vBaseEnvAdditionalParameters: vBaseEnvClockGroup=B, vBaseEnvDerivativeGroup=P1M, vBaseEnvPllGroup=B, vBaseEnvProtectionGroup=B, vBaseEnvPortGroup=B, vBaseEnvResetGroup=B
          6 x vBaseEnvMemLayoutHwRegion:
            CodeFlash_A: vBaseEnvHwRegionSize=1048576, vBaseEnvHwRegionStartAddress=0
            LocalRAM_CPU0: vBaseEnvHwRegionSize=131072, vBaseEnvHwRegionStartAddress=4273864704, vBaseEnvHwRegionEccAlignment=4
            DataFlash: vBaseEnvHwRegionSize=32768, vBaseEnvHwRegionStartAddress=4280287232
            CodeFlash_Ext: vBaseEnvHwRegionSize=32768, vBaseEnvHwRegionStartAddress=16777216
            FCU_RAM: vBaseEnvHwRegionSize=4096, vBaseEnvHwRegionStartAddress=4288749568, vBaseEnvHwRegionEccAlignment=4
            LocalRAM_Self: vBaseEnvHwRegionSize=131072, vBaseEnvHwRegionStartAddress=4275961856, vBaseEnvHwRegionEccAlignment=4
          vBaseEnvClockSettings: vBaseEnvOscClock=16000000, vBaseEnvPeriphClock=80000000, vBaseEnvTimebaseClock=160000000
        RH850_1312: vBaseEnvCpuMaxFrequency=160000000, vBaseEnvAvailableChannels_Flexray=2, vBaseEnvAvailableChannels_Can=2, vBaseEnvAvailableChannels_Lin=2, vBaseEnvAvailableChannels_Ethernet=0, vBaseEnvCpuCoreAmount=1, vBaseEnvTestedDerivative=RH850_1312, vBaseEnvTestedDerivativeDescription=Renesas RH850 P1M Family R7F701312, vBaseEnvCpuCore=G3M
          vBaseEnvAdditionalParameters: vBaseEnvClockGroup=B, vBaseEnvDerivativeGroup=P1M, vBaseEnvPllGroup=B, vBaseEnvProtectionGroup=B, vBaseEnvPortGroup=B, vBaseEnvResetGroup=B
          6 x vBaseEnvMemLayoutHwRegion:
            CodeFlash_A: vBaseEnvHwRegionSize=1048576, vBaseEnvHwRegionStartAddress=0
            LocalRAM_CPU0: vBaseEnvHwRegionSize=131072, vBaseEnvHwRegionStartAddress=4273864704, vBaseEnvHwRegionEccAlignment=4
            DataFlash: vBaseEnvHwRegionSize=32768, vBaseEnvHwRegionStartAddress=4280287232
            CodeFlash_Ext: vBaseEnvHwRegionSize=32768, vBaseEnvHwRegionStartAddress=16777216
            FCU_RAM: vBaseEnvHwRegionSize=4096, vBaseEnvHwRegionStartAddress=4288749568
            LocalRAM_Self: vBaseEnvHwRegionSize=131072, vBaseEnvHwRegionStartAddress=4275961856, vBaseEnvHwRegionEccAlignment=4
          vBaseEnvClockSettings: vBaseEnvOscClock=16000000, vBaseEnvPeriphClock=80000000, vBaseEnvTimebaseClock=160000000
        RH850_1318: vBaseEnvCpuMaxFrequency=160000000, vBaseEnvAvailableChannels_Flexray=2, vBaseEnvAvailableChannels_Can=3, vBaseEnvAvailableChannels_Lin=2, vBaseEnvAvailableChannels_Ethernet=0, vBaseEnvCpuCoreAmount=1, vBaseEnvTestedDerivative=RH850_1318, vBaseEnvTestedDerivativeDescription=Renesas RH850 P1M Family R7F701318, vBaseEnvCpuCore=G3M
          vBaseEnvAdditionalParameters: vBaseEnvClockGroup=B, vBaseEnvDerivativeGroup=P1M, vBaseEnvPllGroup=B, vBaseEnvProtectionGroup=B, vBaseEnvPortGroup=B, vBaseEnvResetGroup=B
          6 x vBaseEnvMemLayoutHwRegion:
            CodeFlash_A: vBaseEnvHwRegionSize=2097152, vBaseEnvHwRegionStartAddress=0
            LocalRAM_CPU0: vBaseEnvHwRegionSize=131072, vBaseEnvHwRegionStartAddress=4273864704, vBaseEnvHwRegionEccAlignment=4
            DataFlash: vBaseEnvHwRegionSize=65536, vBaseEnvHwRegionStartAddress=4280287232
            CodeFlash_Ext: vBaseEnvHwRegionSize=32768, vBaseEnvHwRegionStartAddress=16777216
            FCU_RAM: vBaseEnvHwRegionSize=4096, vBaseEnvHwRegionStartAddress=4288749568, vBaseEnvHwRegionEccAlignment=4
            LocalRAM_Self: vBaseEnvHwRegionSize=131072, vBaseEnvHwRegionStartAddress=4275961856, vBaseEnvHwRegionEccAlignment=4
          vBaseEnvClockSettings: vBaseEnvOscClock=16000000, vBaseEnvPeriphClock=80000000, vBaseEnvTimebaseClock=160000000
        RH850_1320: vBaseEnvCpuMaxFrequency=160000000, vBaseEnvAvailableChannels_Flexray=2, vBaseEnvAvailableChannels_Can=3, vBaseEnvAvailableChannels_Lin=2, vBaseEnvAvailableChannels_Ethernet=0, vBaseEnvCpuCoreAmount=1, vBaseEnvTestedDerivative=RH850_1320, vBaseEnvTestedDerivativeDescription=Renesas RH850 P1M Family R7F701320, vBaseEnvCpuCore=G3M
          vBaseEnvAdditionalParameters: vBaseEnvClockGroup=B, vBaseEnvDerivativeGroup=P1M, vBaseEnvPllGroup=B, vBaseEnvProtectionGroup=B, vBaseEnvPortGroup=B, vBaseEnvResetGroup=B
          6 x vBaseEnvMemLayoutHwRegion:
            CodeFlash_A: vBaseEnvHwRegionSize=2097152, vBaseEnvHwRegionStartAddress=0
            LocalRAM_CPU0: vBaseEnvHwRegionSize=131072, vBaseEnvHwRegionStartAddress=4273864704, vBaseEnvHwRegionEccAlignment=4
            DataFlash: vBaseEnvHwRegionSize=65536, vBaseEnvHwRegionStartAddress=4280287232
            CodeFlash_Ext: vBaseEnvHwRegionSize=32768, vBaseEnvHwRegionStartAddress=16777216
            FCU_RAM: vBaseEnvHwRegionSize=4096, vBaseEnvHwRegionStartAddress=4288749568, vBaseEnvHwRegionEccAlignment=4
            LocalRAM_Self: vBaseEnvHwRegionSize=131072, vBaseEnvHwRegionStartAddress=4275961856, vBaseEnvHwRegionEccAlignment=4
          vBaseEnvClockSettings: vBaseEnvOscClock=16000000, vBaseEnvPeriphClock=80000000, vBaseEnvTimebaseClock=160000000
        RH850_1363: vBaseEnvCpuMaxFrequency=160000000, vBaseEnvAvailableChannels_Flexray=2, vBaseEnvAvailableChannels_Can=3, vBaseEnvAvailableChannels_Lin=2, vBaseEnvAvailableChannels_Ethernet=0, vBaseEnvCpuCoreAmount=1, vBaseEnvTestedDerivative=RH850_1363, vBaseEnvTestedDerivativeDescription=Renesas RH850 P1M Family R7F701363, vBaseEnvCpuCore=G3M
          vBaseEnvAdditionalParameters: vBaseEnvClockGroup=B, vBaseEnvDerivativeGroup=P1M, vBaseEnvPllGroup=B, vBaseEnvProtectionGroup=B, vBaseEnvPortGroup=B, vBaseEnvResetGroup=B
          6 x vBaseEnvMemLayoutHwRegion:
            CodeFlash_A: vBaseEnvHwRegionSize=2097152, vBaseEnvHwRegionStartAddress=0
            LocalRAM_CPU0: vBaseEnvHwRegionSize=131072, vBaseEnvHwRegionStartAddress=4273864704, vBaseEnvHwRegionEccAlignment=4
            DataFlash: vBaseEnvHwRegionSize=65536, vBaseEnvHwRegionStartAddress=4280287232
            CodeFlash_Ext: vBaseEnvHwRegionSize=32768, vBaseEnvHwRegionStartAddress=16777216
            FCU_RAM: vBaseEnvHwRegionSize=4096, vBaseEnvHwRegionStartAddress=4288749568, vBaseEnvHwRegionEccAlignment=4
            LocalRAM_Self: vBaseEnvHwRegionSize=131072, vBaseEnvHwRegionStartAddress=4275961856, vBaseEnvHwRegionEccAlignment=4
          vBaseEnvClockSettings: vBaseEnvOscClock=16000000, vBaseEnvPeriphClock=80000000, vBaseEnvTimebaseClock=160000000
        RH850_1373: vBaseEnvCpuMaxFrequency=240000000, vBaseEnvAvailableChannels_Flexray=2, vBaseEnvAvailableChannels_Can=3, vBaseEnvAvailableChannels_Lin=2, vBaseEnvAvailableChannels_Ethernet=1, vBaseEnvCpuCoreAmount=1, vBaseEnvTestedDerivative=RH850_1373, vBaseEnvTestedDerivativeDescription=Renesas RH850 P1M_C Family R7F701373, vBaseEnvCpuCore=G3M
          vBaseEnvAdditionalParameters:
            vBaseEnvClockGroup = D
            vBaseEnvDerivativeGroup = P1M_C
            vBaseEnvPllGroup = D
            vBaseEnvProtectionGroup = NONE
            vBaseEnvPortGroup = B2
            vBaseEnvResetGroup = D
            vBaseEnvPowerDownModes = true
          6 x vBaseEnvMemLayoutHwRegion:
            CodeFlash_A: vBaseEnvHwRegionSize=2097152, vBaseEnvHwRegionStartAddress=0
            LocalRAM_CPU0: vBaseEnvHwRegionSize=131072, vBaseEnvHwRegionStartAddress=4273864704, vBaseEnvHwRegionEccAlignment=4
            DataFlash: vBaseEnvHwRegionSize=65536, vBaseEnvHwRegionStartAddress=4280287232
            LocalRAM_Self: vBaseEnvHwRegionSize=131072, vBaseEnvHwRegionStartAddress=4275961856, vBaseEnvHwRegionEccAlignment=4
            GlobalRAM_A: vBaseEnvHwRegionSize=163840, vBaseEnvHwRegionStartAddress=4276977664, vBaseEnvHwRegionEccAlignment=4
            GlobalRAM_B: vBaseEnvHwRegionSize=163840, vBaseEnvHwRegionStartAddress=4277141504, vBaseEnvHwRegionEccAlignment=4
          vBaseEnvClockSettings: vBaseEnvOscClock=16000000, vBaseEnvPeriphClock=120000000, vBaseEnvTimebaseClock=240000000
        RH850_1374: vBaseEnvCpuMaxFrequency=240000000, vBaseEnvAvailableChannels_Flexray=2, vBaseEnvAvailableChannels_Can=3, vBaseEnvAvailableChannels_Lin=2, vBaseEnvAvailableChannels_Ethernet=1, vBaseEnvCpuCoreAmount=1, vBaseEnvTestedDerivative=RH850_1373, vBaseEnvTestedDerivativeDescription=Renesas RH850 P1M_C Family R7F701374, vBaseEnvCpuCore=G3M
          vBaseEnvAdditionalParameters:
            vBaseEnvClockGroup = D
            vBaseEnvDerivativeGroup = P1M_C
            vBaseEnvPllGroup = D
            vBaseEnvProtectionGroup = NONE
            vBaseEnvPortGroup = B2
            vBaseEnvResetGroup = D
            vBaseEnvPowerDownModes = true
          6 x vBaseEnvMemLayoutHwRegion:
            CodeFlash_A: vBaseEnvHwRegionSize=2097152, vBaseEnvHwRegionStartAddress=0
            LocalRAM_CPU0: vBaseEnvHwRegionSize=131072, vBaseEnvHwRegionStartAddress=4273864704, vBaseEnvHwRegionEccAlignment=4
            DataFlash: vBaseEnvHwRegionSize=65536, vBaseEnvHwRegionStartAddress=4280287232
            LocalRAM_Self: vBaseEnvHwRegionSize=131072, vBaseEnvHwRegionStartAddress=4275961856, vBaseEnvHwRegionEccAlignment=4
            GlobalRAM_A: vBaseEnvHwRegionSize=163840, vBaseEnvHwRegionStartAddress=4276977664, vBaseEnvHwRegionEccAlignment=4
            GlobalRAM_B: vBaseEnvHwRegionSize=163840, vBaseEnvHwRegionStartAddress=4277141504, vBaseEnvHwRegionEccAlignment=4
          vBaseEnvClockSettings: vBaseEnvOscClock=16000000, vBaseEnvPeriphClock=120000000, vBaseEnvTimebaseClock=240000000
        RH850_1376: vBaseEnvCpuMaxFrequency=160000000, vBaseEnvAvailableChannels_Flexray=2, vBaseEnvAvailableChannels_Can=3, vBaseEnvAvailableChannels_Lin=2, vBaseEnvAvailableChannels_Ethernet=0, vBaseEnvCpuCoreAmount=1, vBaseEnvTestedDerivative=RH850_1376, vBaseEnvTestedDerivativeDescription=Renesas RH850 P1M_E Family R7F701376, vBaseEnvCpuCore=G3M
          vBaseEnvAdditionalParameters: vBaseEnvClockGroup=B, vBaseEnvDerivativeGroup=P1M_E, vBaseEnvPllGroup=B, vBaseEnvProtectionGroup=NONE, vBaseEnvPortGroup=B, vBaseEnvResetGroup=C
          7 x vBaseEnvMemLayoutHwRegion:
            CodeFlash_A: vBaseEnvHwRegionSize=2097152, vBaseEnvHwRegionStartAddress=0
            LocalRAM_CPU0: vBaseEnvHwRegionSize=131072, vBaseEnvHwRegionStartAddress=4273864704, vBaseEnvHwRegionEccAlignment=4
            DataFlash: vBaseEnvHwRegionSize=65536, vBaseEnvHwRegionStartAddress=4280287232
            CodeFlash_Ext: vBaseEnvHwRegionSize=32768, vBaseEnvHwRegionStartAddress=16777216
            LocalRAM_Self: vBaseEnvHwRegionSize=131072, vBaseEnvHwRegionStartAddress=4275961856, vBaseEnvHwRegionEccAlignment=4
            GlobalRAM_A: vBaseEnvHwRegionSize=32768, vBaseEnvHwRegionStartAddress=4277108736, vBaseEnvHwRegionEccAlignment=4
            GlobalRAM_B: vBaseEnvHwRegionSize=32768, vBaseEnvHwRegionStartAddress=4277141504, vBaseEnvHwRegionEccAlignment=4
          vBaseEnvClockSettings: vBaseEnvOscClock=16000000, vBaseEnvPeriphClock=80000000, vBaseEnvTimebaseClock=160000000
        RH850_1378: vBaseEnvCpuMaxFrequency=160000000, vBaseEnvAvailableChannels_Flexray=2, vBaseEnvAvailableChannels_Can=3, vBaseEnvAvailableChannels_Lin=2, vBaseEnvAvailableChannels_Ethernet=0, vBaseEnvCpuCoreAmount=1, vBaseEnvTestedDerivative=RH850_1378, vBaseEnvTestedDerivativeDescription=Renesas RH850 P1M_E Family R7F701378, vBaseEnvCpuCore=G3M
          vBaseEnvAdditionalParameters: vBaseEnvClockGroup=B, vBaseEnvDerivativeGroup=P1M_E, vBaseEnvPllGroup=B, vBaseEnvProtectionGroup=NONE, vBaseEnvPortGroup=B, vBaseEnvResetGroup=C
          7 x vBaseEnvMemLayoutHwRegion:
            CodeFlash_A: vBaseEnvHwRegionSize=2097152, vBaseEnvHwRegionStartAddress=0
            LocalRAM_CPU0: vBaseEnvHwRegionSize=131072, vBaseEnvHwRegionStartAddress=4273864704, vBaseEnvHwRegionEccAlignment=4
            DataFlash: vBaseEnvHwRegionSize=65536, vBaseEnvHwRegionStartAddress=4280287232
            CodeFlash_Ext: vBaseEnvHwRegionSize=32768, vBaseEnvHwRegionStartAddress=16777216
            LocalRAM_Self: vBaseEnvHwRegionSize=131072, vBaseEnvHwRegionStartAddress=4275961856, vBaseEnvHwRegionEccAlignment=4
            GlobalRAM_A: vBaseEnvHwRegionSize=32768, vBaseEnvHwRegionStartAddress=4277108736, vBaseEnvHwRegionEccAlignment=4
            GlobalRAM_B: vBaseEnvHwRegionSize=32768, vBaseEnvHwRegionStartAddress=4277141504, vBaseEnvHwRegionEccAlignment=4
          vBaseEnvClockSettings: vBaseEnvOscClock=16000000, vBaseEnvPeriphClock=80000000, vBaseEnvTimebaseClock=160000000
        RH850_1379: vBaseEnvCpuMaxFrequency=160000000, vBaseEnvAvailableChannels_Flexray=2, vBaseEnvAvailableChannels_Can=3, vBaseEnvAvailableChannels_Lin=2, vBaseEnvAvailableChannels_Ethernet=0, vBaseEnvCpuCoreAmount=1, vBaseEnvTestedDerivative=RH850_1379, vBaseEnvTestedDerivativeDescription=Renesas RH850 P1M_E Family R7F701379, vBaseEnvCpuCore=G3M
          vBaseEnvAdditionalParameters: vBaseEnvClockGroup=B, vBaseEnvDerivativeGroup=P1M_E, vBaseEnvPllGroup=B, vBaseEnvProtectionGroup=NONE, vBaseEnvPortGroup=B, vBaseEnvResetGroup=C
          7 x vBaseEnvMemLayoutHwRegion:
            CodeFlash_A: vBaseEnvHwRegionSize=2097152, vBaseEnvHwRegionStartAddress=0
            LocalRAM_CPU0: vBaseEnvHwRegionSize=131072, vBaseEnvHwRegionStartAddress=4273864704, vBaseEnvHwRegionEccAlignment=4
            DataFlash: vBaseEnvHwRegionSize=65536, vBaseEnvHwRegionStartAddress=4280287232
            CodeFlash_Ext: vBaseEnvHwRegionSize=32768, vBaseEnvHwRegionStartAddress=16777216
            LocalRAM_Self: vBaseEnvHwRegionSize=131072, vBaseEnvHwRegionStartAddress=4275961856, vBaseEnvHwRegionEccAlignment=4
            GlobalRAM_A: vBaseEnvHwRegionSize=32768, vBaseEnvHwRegionStartAddress=4277108736, vBaseEnvHwRegionEccAlignment=4
            GlobalRAM_B: vBaseEnvHwRegionSize=32768, vBaseEnvHwRegionStartAddress=4277141504, vBaseEnvHwRegionEccAlignment=4
          vBaseEnvClockSettings: vBaseEnvOscClock=16000000, vBaseEnvPeriphClock=80000000, vBaseEnvTimebaseClock=160000000
        RH850_1380: vBaseEnvCpuMaxFrequency=160000000, vBaseEnvAvailableChannels_Flexray=2, vBaseEnvAvailableChannels_Can=3, vBaseEnvAvailableChannels_Lin=2, vBaseEnvAvailableChannels_Ethernet=0, vBaseEnvCpuCoreAmount=1, vBaseEnvTestedDerivative=RH850_1380, vBaseEnvTestedDerivativeDescription=Renesas RH850 P1M_E Family R7F701380, vBaseEnvCpuCore=G3M
          vBaseEnvAdditionalParameters: vBaseEnvClockGroup=B, vBaseEnvDerivativeGroup=P1M_E, vBaseEnvPllGroup=B, vBaseEnvProtectionGroup=NONE, vBaseEnvPortGroup=B, vBaseEnvResetGroup=C
          7 x vBaseEnvMemLayoutHwRegion:
            CodeFlash_A: vBaseEnvHwRegionSize=2097152, vBaseEnvHwRegionStartAddress=0
            LocalRAM_CPU0: vBaseEnvHwRegionSize=131072, vBaseEnvHwRegionStartAddress=4273864704, vBaseEnvHwRegionEccAlignment=4
            DataFlash: vBaseEnvHwRegionSize=65536, vBaseEnvHwRegionStartAddress=4280287232
            CodeFlash_Ext: vBaseEnvHwRegionSize=32768, vBaseEnvHwRegionStartAddress=16777216
            LocalRAM_Self: vBaseEnvHwRegionSize=131072, vBaseEnvHwRegionStartAddress=4275961856, vBaseEnvHwRegionEccAlignment=4
            GlobalRAM_A: vBaseEnvHwRegionSize=32768, vBaseEnvHwRegionStartAddress=4277108736, vBaseEnvHwRegionEccAlignment=4
            GlobalRAM_B: vBaseEnvHwRegionSize=32768, vBaseEnvHwRegionStartAddress=4277141504, vBaseEnvHwRegionEccAlignment=4
          vBaseEnvClockSettings: vBaseEnvOscClock=16000000, vBaseEnvPeriphClock=80000000, vBaseEnvTimebaseClock=160000000
        RH850_1381: vBaseEnvCpuMaxFrequency=160000000, vBaseEnvAvailableChannels_Flexray=2, vBaseEnvAvailableChannels_Can=3, vBaseEnvAvailableChannels_Lin=2, vBaseEnvAvailableChannels_Ethernet=0, vBaseEnvCpuCoreAmount=1, vBaseEnvTestedDerivative=RH850_1381, vBaseEnvTestedDerivativeDescription=Renesas RH850 P1M_E Family R7F701381, vBaseEnvCpuCore=G3M
          vBaseEnvAdditionalParameters: vBaseEnvClockGroup=B, vBaseEnvDerivativeGroup=P1M_E, vBaseEnvPllGroup=B, vBaseEnvProtectionGroup=NONE, vBaseEnvPortGroup=B, vBaseEnvResetGroup=C
          7 x vBaseEnvMemLayoutHwRegion:
            CodeFlash_A: vBaseEnvHwRegionSize=1048576, vBaseEnvHwRegionStartAddress=0
            LocalRAM_CPU0: vBaseEnvHwRegionSize=131072, vBaseEnvHwRegionStartAddress=4273864704, vBaseEnvHwRegionEccAlignment=4
            DataFlash: vBaseEnvHwRegionSize=32768, vBaseEnvHwRegionStartAddress=4280287232
            CodeFlash_Ext: vBaseEnvHwRegionSize=32768, vBaseEnvHwRegionStartAddress=16777216
            LocalRAM_Self: vBaseEnvHwRegionSize=131072, vBaseEnvHwRegionStartAddress=4275961856, vBaseEnvHwRegionEccAlignment=4
            GlobalRAM_A: vBaseEnvHwRegionSize=32768, vBaseEnvHwRegionStartAddress=4277108736, vBaseEnvHwRegionEccAlignment=4
            GlobalRAM_B: vBaseEnvHwRegionSize=32768, vBaseEnvHwRegionStartAddress=4277141504, vBaseEnvHwRegionEccAlignment=4
          vBaseEnvClockSettings: vBaseEnvOscClock=16000000, vBaseEnvPeriphClock=80000000, vBaseEnvTimebaseClock=160000000
        RH850_1382: vBaseEnvCpuMaxFrequency=160000000, vBaseEnvAvailableChannels_Flexray=2, vBaseEnvAvailableChannels_Can=3, vBaseEnvAvailableChannels_Lin=2, vBaseEnvAvailableChannels_Ethernet=0, vBaseEnvCpuCoreAmount=1, vBaseEnvTestedDerivative=RH850_1382, vBaseEnvTestedDerivativeDescription=Renesas RH850 P1M_E Family R7F701382, vBaseEnvCpuCore=G3M
          vBaseEnvAdditionalParameters: vBaseEnvClockGroup=B, vBaseEnvDerivativeGroup=P1M_E, vBaseEnvPllGroup=B, vBaseEnvProtectionGroup=NONE, vBaseEnvPortGroup=B, vBaseEnvResetGroup=C
          7 x vBaseEnvMemLayoutHwRegion:
            CodeFlash_A: vBaseEnvHwRegionSize=1048576, vBaseEnvHwRegionStartAddress=0
            LocalRAM_CPU0: vBaseEnvHwRegionSize=131072, vBaseEnvHwRegionStartAddress=4273864704, vBaseEnvHwRegionEccAlignment=4
            DataFlash: vBaseEnvHwRegionSize=32768, vBaseEnvHwRegionStartAddress=4280287232
            CodeFlash_Ext: vBaseEnvHwRegionSize=32768, vBaseEnvHwRegionStartAddress=16777216
            LocalRAM_Self: vBaseEnvHwRegionSize=131072, vBaseEnvHwRegionStartAddress=4275961856, vBaseEnvHwRegionEccAlignment=4
            GlobalRAM_A: vBaseEnvHwRegionSize=32768, vBaseEnvHwRegionStartAddress=4277108736, vBaseEnvHwRegionEccAlignment=4
            GlobalRAM_B: vBaseEnvHwRegionSize=32768, vBaseEnvHwRegionStartAddress=4277141504, vBaseEnvHwRegionEccAlignment=4
          vBaseEnvClockSettings: vBaseEnvOscClock=16000000, vBaseEnvPeriphClock=80000000, vBaseEnvTimebaseClock=160000000
        RH850_1383: vBaseEnvCpuMaxFrequency=160000000, vBaseEnvAvailableChannels_Flexray=2, vBaseEnvAvailableChannels_Can=3, vBaseEnvAvailableChannels_Lin=2, vBaseEnvAvailableChannels_Ethernet=0, vBaseEnvCpuCoreAmount=1, vBaseEnvTestedDerivative=RH850_1383, vBaseEnvTestedDerivativeDescription=Renesas RH850 P1M_E Family R7F701383, vBaseEnvCpuCore=G3M
          vBaseEnvAdditionalParameters: vBaseEnvClockGroup=B, vBaseEnvDerivativeGroup=P1M_E, vBaseEnvPllGroup=B, vBaseEnvProtectionGroup=NONE, vBaseEnvPortGroup=B, vBaseEnvResetGroup=C
          7 x vBaseEnvMemLayoutHwRegion:
            CodeFlash_A: vBaseEnvHwRegionSize=1048576, vBaseEnvHwRegionStartAddress=0
            LocalRAM_CPU0: vBaseEnvHwRegionSize=131072, vBaseEnvHwRegionStartAddress=4273864704, vBaseEnvHwRegionEccAlignment=4
            DataFlash: vBaseEnvHwRegionSize=32768, vBaseEnvHwRegionStartAddress=4280287232
            CodeFlash_Ext: vBaseEnvHwRegionSize=32768, vBaseEnvHwRegionStartAddress=16777216
            GlobalRAM_A: vBaseEnvHwRegionSize=32768, vBaseEnvHwRegionStartAddress=4277108736, vBaseEnvHwRegionEccAlignment=4
            GlobalRAM_B: vBaseEnvHwRegionSize=32768, vBaseEnvHwRegionStartAddress=4277141504, vBaseEnvHwRegionEccAlignment=4
            LocalRAM_Self: vBaseEnvHwRegionSize=131072, vBaseEnvHwRegionStartAddress=4275961856, vBaseEnvHwRegionEccAlignment=4
          vBaseEnvClockSettings: vBaseEnvOscClock=16000000, vBaseEnvPeriphClock=80000000, vBaseEnvTimebaseClock=160000000
        RH850_1328: vBaseEnvCpuMaxFrequency=240000000, vBaseEnvAvailableChannels_Flexray=2, vBaseEnvAvailableChannels_Can=3, vBaseEnvAvailableChannels_Lin=2, vBaseEnvAvailableChannels_Ethernet=1, vBaseEnvCpuCoreAmount=1, vBaseEnvTestedDerivative=RH850_1328, vBaseEnvTestedDerivativeDescription=Renesas RH850 P1M_C Family R7F701328 D3, vBaseEnvCpuCore=G3M
          vBaseEnvAdditionalParameters:
            vBaseEnvClockGroup = D
            vBaseEnvDerivativeGroup = P1M_C
            vBaseEnvPllGroup = D
            vBaseEnvProtectionGroup = NONE
            vBaseEnvPortGroup = B2
            vBaseEnvResetGroup = D
            vBaseEnvPowerDownModes = true
          6 x vBaseEnvMemLayoutHwRegion:
            CodeFlash_A: vBaseEnvHwRegionSize=2097152, vBaseEnvHwRegionStartAddress=0
            LocalRAM_CPU0: vBaseEnvHwRegionSize=131072, vBaseEnvHwRegionStartAddress=4273864704, vBaseEnvHwRegionEccAlignment=4
            DataFlash: vBaseEnvHwRegionSize=65536, vBaseEnvHwRegionStartAddress=4280287232
            LocalRAM_Self: vBaseEnvHwRegionSize=131072, vBaseEnvHwRegionStartAddress=4275961856, vBaseEnvHwRegionEccAlignment=4
            GlobalRAM_A: vBaseEnvHwRegionSize=163840, vBaseEnvHwRegionStartAddress=4276977664, vBaseEnvHwRegionEccAlignment=4
            GlobalRAM_B: vBaseEnvHwRegionSize=163840, vBaseEnvHwRegionStartAddress=4277141504, vBaseEnvHwRegionEccAlignment=4
          vBaseEnvClockSettings: vBaseEnvOscClock=16000000, vBaseEnvPeriphClock=80000000, vBaseEnvTimebaseClock=240000000
        RH850_1329: vBaseEnvCpuMaxFrequency=240000000, vBaseEnvAvailableChannels_Flexray=2, vBaseEnvAvailableChannels_Can=3, vBaseEnvAvailableChannels_Lin=2, vBaseEnvAvailableChannels_Ethernet=1, vBaseEnvCpuCoreAmount=1, vBaseEnvTestedDerivative=RH850_1329, vBaseEnvTestedDerivativeDescription=Renesas RH850 P1M_C Family R7F701329 D3, vBaseEnvCpuCore=G3M
          vBaseEnvAdditionalParameters:
            vBaseEnvClockGroup = D
            vBaseEnvDerivativeGroup = P1M_C
            vBaseEnvPllGroup = D
            vBaseEnvProtectionGroup = NONE
            vBaseEnvPortGroup = B2
            vBaseEnvResetGroup = D
            vBaseEnvPowerDownModes = true
          6 x vBaseEnvMemLayoutHwRegion:
            CodeFlash_A: vBaseEnvHwRegionSize=2097152, vBaseEnvHwRegionStartAddress=0
            LocalRAM_CPU0: vBaseEnvHwRegionSize=131072, vBaseEnvHwRegionStartAddress=4273864704, vBaseEnvHwRegionEccAlignment=4
            DataFlash: vBaseEnvHwRegionSize=65536, vBaseEnvHwRegionStartAddress=4280287232
            LocalRAM_Self: vBaseEnvHwRegionSize=131072, vBaseEnvHwRegionStartAddress=4275961856, vBaseEnvHwRegionEccAlignment=4
            GlobalRAM_A: vBaseEnvHwRegionSize=163840, vBaseEnvHwRegionStartAddress=4276977664, vBaseEnvHwRegionEccAlignment=4
            GlobalRAM_B: vBaseEnvHwRegionSize=163840, vBaseEnvHwRegionStartAddress=4277141504, vBaseEnvHwRegionEccAlignment=4
          vBaseEnvClockSettings: vBaseEnvOscClock=16000000, vBaseEnvPeriphClock=80000000, vBaseEnvTimebaseClock=240000000
        RH850_1330: vBaseEnvCpuMaxFrequency=240000000, vBaseEnvAvailableChannels_Flexray=2, vBaseEnvAvailableChannels_Can=3, vBaseEnvAvailableChannels_Lin=2, vBaseEnvAvailableChannels_Ethernet=1, vBaseEnvCpuCoreAmount=1, vBaseEnvTestedDerivative=RH850_1330, vBaseEnvTestedDerivativeDescription=Renesas RH850 P1M_C Family R7F701330 D3, vBaseEnvCpuCore=G3M
          vBaseEnvAdditionalParameters:
            vBaseEnvClockGroup = D
            vBaseEnvDerivativeGroup = P1M_C
            vBaseEnvPllGroup = D
            vBaseEnvProtectionGroup = NONE
            vBaseEnvPortGroup = B2
            vBaseEnvResetGroup = D
            vBaseEnvPowerDownModes = true
          6 x vBaseEnvMemLayoutHwRegion:
            CodeFlash_A: vBaseEnvHwRegionSize=2097152, vBaseEnvHwRegionStartAddress=0
            LocalRAM_CPU0: vBaseEnvHwRegionSize=131072, vBaseEnvHwRegionStartAddress=4273864704, vBaseEnvHwRegionEccAlignment=4
            DataFlash: vBaseEnvHwRegionSize=65536, vBaseEnvHwRegionStartAddress=4280287232
            LocalRAM_Self: vBaseEnvHwRegionSize=131072, vBaseEnvHwRegionStartAddress=4275961856, vBaseEnvHwRegionEccAlignment=4
            GlobalRAM_A: vBaseEnvHwRegionSize=163840, vBaseEnvHwRegionStartAddress=4276977664, vBaseEnvHwRegionEccAlignment=4
            GlobalRAM_B: vBaseEnvHwRegionSize=163840, vBaseEnvHwRegionStartAddress=4277141504, vBaseEnvHwRegionEccAlignment=4
          vBaseEnvClockSettings: vBaseEnvOscClock=16000000, vBaseEnvPeriphClock=80000000, vBaseEnvTimebaseClock=240000000
        RH850_1331: vBaseEnvCpuMaxFrequency=240000000, vBaseEnvAvailableChannels_Flexray=2, vBaseEnvAvailableChannels_Can=3, vBaseEnvAvailableChannels_Lin=2, vBaseEnvAvailableChannels_Ethernet=1, vBaseEnvCpuCoreAmount=1, vBaseEnvTestedDerivative=RH850_1331, vBaseEnvTestedDerivativeDescription=Renesas RH850 P1M_C Family R7F701331 D3, vBaseEnvCpuCore=G3M
          vBaseEnvAdditionalParameters:
            vBaseEnvClockGroup = D
            vBaseEnvDerivativeGroup = P1M_C
            vBaseEnvPllGroup = D
            vBaseEnvProtectionGroup = NONE
            vBaseEnvPortGroup = B2
            vBaseEnvResetGroup = D
            vBaseEnvPowerDownModes = true
          6 x vBaseEnvMemLayoutHwRegion:
            CodeFlash_A: vBaseEnvHwRegionSize=2097152, vBaseEnvHwRegionStartAddress=0
            LocalRAM_CPU0: vBaseEnvHwRegionSize=131072, vBaseEnvHwRegionStartAddress=4273864704, vBaseEnvHwRegionEccAlignment=4
            DataFlash: vBaseEnvHwRegionSize=65536, vBaseEnvHwRegionStartAddress=4280287232
            LocalRAM_Self: vBaseEnvHwRegionSize=131072, vBaseEnvHwRegionStartAddress=4275961856, vBaseEnvHwRegionEccAlignment=4
            GlobalRAM_A: vBaseEnvHwRegionSize=163840, vBaseEnvHwRegionStartAddress=4276977664, vBaseEnvHwRegionEccAlignment=4
            GlobalRAM_B: vBaseEnvHwRegionSize=163840, vBaseEnvHwRegionStartAddress=4277141504, vBaseEnvHwRegionEccAlignment=4
          vBaseEnvClockSettings: vBaseEnvOscClock=16000000, vBaseEnvPeriphClock=80000000, vBaseEnvTimebaseClock=240000000
        RH850_1333: vBaseEnvCpuMaxFrequency=240000000, vBaseEnvAvailableChannels_Flexray=2, vBaseEnvAvailableChannels_Can=3, vBaseEnvAvailableChannels_Lin=2, vBaseEnvAvailableChannels_Ethernet=1, vBaseEnvCpuCoreAmount=1, vBaseEnvTestedDerivative=RH850_1333, vBaseEnvTestedDerivativeDescription=Renesas RH850 P1M_C Family R7F701333 D3, vBaseEnvCpuCore=G3M
          vBaseEnvAdditionalParameters:
            vBaseEnvClockGroup = D
            vBaseEnvDerivativeGroup = P1M_C
            vBaseEnvPllGroup = D
            vBaseEnvProtectionGroup = NONE
            vBaseEnvPortGroup = B2
            vBaseEnvResetGroup = D
            vBaseEnvPowerDownModes = true
          6 x vBaseEnvMemLayoutHwRegion:
            CodeFlash_A: vBaseEnvHwRegionSize=2097152, vBaseEnvHwRegionStartAddress=0
            LocalRAM_CPU0: vBaseEnvHwRegionSize=131072, vBaseEnvHwRegionStartAddress=4273864704, vBaseEnvHwRegionEccAlignment=4
            DataFlash: vBaseEnvHwRegionSize=65536, vBaseEnvHwRegionStartAddress=4280287232
            LocalRAM_Self: vBaseEnvHwRegionSize=131072, vBaseEnvHwRegionStartAddress=4275961856, vBaseEnvHwRegionEccAlignment=4
            GlobalRAM_A: vBaseEnvHwRegionSize=163840, vBaseEnvHwRegionStartAddress=4276977664, vBaseEnvHwRegionEccAlignment=4
            GlobalRAM_B: vBaseEnvHwRegionSize=163840, vBaseEnvHwRegionStartAddress=4277141504, vBaseEnvHwRegionEccAlignment=4
          vBaseEnvClockSettings: vBaseEnvOscClock=16000000, vBaseEnvPeriphClock=80000000, vBaseEnvTimebaseClock=240000000
        RH850_1325: vBaseEnvCpuMaxFrequency=240000000, vBaseEnvAvailableChannels_Flexray=4, vBaseEnvAvailableChannels_Can=4, vBaseEnvAvailableChannels_Lin=4, vBaseEnvAvailableChannels_Ethernet=2, vBaseEnvCpuCoreAmount=2, vBaseEnvTestedDerivative=RH850_1325, vBaseEnvTestedDerivativeDescription=Renesas RH850 P1H Family R7F701325, vBaseEnvCpuCore=G3M
          vBaseEnvAdditionalParameters:
            vBaseEnvClockGroup = D
            vBaseEnvDerivativeGroup = P1H
            vBaseEnvPllGroup = D
            vBaseEnvProtectionGroup = NONE
            vBaseEnvPortGroup = B2
            vBaseEnvResetGroup = D
            vBaseEnvPowerDownModes = true
          8 x vBaseEnvMemLayoutHwRegion:
            CodeFlash_A: vBaseEnvHwRegionSize=6291456, vBaseEnvHwRegionStartAddress=0
            CodeFlash_B: vBaseEnvHwRegionSize=4194304, vBaseEnvHwRegionStartAddress=8388608
            LocalRAM_CPU0: vBaseEnvHwRegionSize=65536, vBaseEnvHwRegionStartAddress=4273930240, vBaseEnvHwRegionEccAlignment=4
            LocalRAM_CPU1: vBaseEnvHwRegionSize=65536, vBaseEnvHwRegionStartAddress=4271833088, vBaseEnvHwRegionEccAlignment=4
            GlobalRAM_A: vBaseEnvHwRegionSize=688128, vBaseEnvHwRegionStartAddress=4276453376, vBaseEnvHwRegionEccAlignment=4
            GlobalRAM_B: vBaseEnvHwRegionSize=688128, vBaseEnvHwRegionStartAddress=4277141504, vBaseEnvHwRegionEccAlignment=4
            DataFlash: vBaseEnvHwRegionSize=196608, vBaseEnvHwRegionStartAddress=4280287232
            LocalRAM_Self: vBaseEnvHwRegionSize=65536, vBaseEnvHwRegionStartAddress=4276027392, vBaseEnvHwRegionEccAlignment=4
          vBaseEnvClockSettings: vBaseEnvOscClock=16000000, vBaseEnvPeriphClock=80000000, vBaseEnvTimebaseClock=240000000
        RH850_1327: vBaseEnvCpuMaxFrequency=240000000, vBaseEnvAvailableChannels_Flexray=4, vBaseEnvAvailableChannels_Can=3, vBaseEnvAvailableChannels_Lin=4, vBaseEnvAvailableChannels_Ethernet=2, vBaseEnvCpuCoreAmount=2, vBaseEnvTestedDerivative=RH850_1327, vBaseEnvTestedDerivativeDescription=Renesas RH850 P1H Family R7F701327, vBaseEnvCpuCore=G3M
          vBaseEnvAdditionalParameters:
            vBaseEnvClockGroup = D
            vBaseEnvDerivativeGroup = P1H
            vBaseEnvPllGroup = D
            vBaseEnvProtectionGroup = NONE
            vBaseEnvPortGroup = B2
            vBaseEnvResetGroup = D
            vBaseEnvPowerDownModes = true
          8 x vBaseEnvMemLayoutHwRegion:
            CodeFlash_A: vBaseEnvHwRegionSize=2097152, vBaseEnvHwRegionStartAddress=0
            CodeFlash_B: vBaseEnvHwRegionSize=2097152, vBaseEnvHwRegionStartAddress=8388608
            LocalRAM_CPU0: vBaseEnvHwRegionSize=65536, vBaseEnvHwRegionStartAddress=4273930240, vBaseEnvHwRegionEccAlignment=4
            LocalRAM_CPU1: vBaseEnvHwRegionSize=65536, vBaseEnvHwRegionStartAddress=4271833088, vBaseEnvHwRegionEccAlignment=4
            GlobalRAM_A: vBaseEnvHwRegionSize=491520, vBaseEnvHwRegionStartAddress=4276649984, vBaseEnvHwRegionEccAlignment=4
            GlobalRAM_B: vBaseEnvHwRegionSize=491520, vBaseEnvHwRegionStartAddress=4277141504, vBaseEnvHwRegionEccAlignment=4
            DataFlash: vBaseEnvHwRegionSize=131072, vBaseEnvHwRegionStartAddress=4280287232
            LocalRAM_Self: vBaseEnvHwRegionSize=65536, vBaseEnvHwRegionStartAddress=4276027392, vBaseEnvHwRegionEccAlignment=4
          vBaseEnvClockSettings: vBaseEnvOscClock=16000000, vBaseEnvPeriphClock=80000000, vBaseEnvTimebaseClock=240000000
        RH850_1062: vBaseEnvCpuMaxFrequency=96000000, vBaseEnvAvailableChannels_Flexray=0, vBaseEnvAvailableChannels_Can=2, vBaseEnvAvailableChannels_Lin=2, vBaseEnvAvailableChannels_Ethernet=0, vBaseEnvCpuCoreAmount=1, vBaseEnvTestedDerivative=RH850_1062, vBaseEnvTestedDerivativeDescription=Renesas RH850 R1M Family R7F701062, vBaseEnvCpuCore=G3K
          vBaseEnvAdditionalParameters: vBaseEnvClockGroup=A, vBaseEnvDerivativeGroup=R1L, vBaseEnvPllGroup=A, vBaseEnvProtectionGroup=A, vBaseEnvPortGroup=A1, vBaseEnvResetGroup=A
          5 x vBaseEnvMemLayoutHwRegion:
            CodeFlash_A: vBaseEnvHwRegionSize=524288, vBaseEnvHwRegionStartAddress=0
            LocalRAM_CPU0: vBaseEnvHwRegionSize=32768, vBaseEnvHwRegionStartAddress=4276060160, vBaseEnvHwRegionEccAlignment=4
            DataFlash: vBaseEnvHwRegionSize=32768, vBaseEnvHwRegionStartAddress=4280287232
            CodeFlash_Ext: vBaseEnvHwRegionSize=32768, vBaseEnvHwRegionStartAddress=16777216
            RetentionRAM: vBaseEnvHwRegionSize=16384, vBaseEnvHwRegionStartAddress=4276109312, vBaseEnvHwRegionEccAlignment=4
          vBaseEnvClockSettings: vBaseEnvOscClock=8000000, vBaseEnvPeriphClock=48000000, vBaseEnvTimebaseClock=80000000
        RH850_1070: vBaseEnvCpuMaxFrequency=96000000, vBaseEnvAvailableChannels_Flexray=0, vBaseEnvAvailableChannels_Can=3, vBaseEnvAvailableChannels_Lin=2, vBaseEnvAvailableChannels_Ethernet=0, vBaseEnvCpuCoreAmount=1, vBaseEnvTestedDerivative=RH850_10RH850_, vBaseEnvTestedDerivativeDescription=Renesas RH850 R1M Family R7F701070, vBaseEnvCpuCore=G3K
          vBaseEnvAdditionalParameters: vBaseEnvClockGroup=A, vBaseEnvDerivativeGroup=R1L, vBaseEnvPllGroup=A, vBaseEnvProtectionGroup=A, vBaseEnvPortGroup=A1, vBaseEnvResetGroup=A
          5 x vBaseEnvMemLayoutHwRegion:
            CodeFlash_A: vBaseEnvHwRegionSize=1048576, vBaseEnvHwRegionStartAddress=0
            LocalRAM_CPU0: vBaseEnvHwRegionSize=98304, vBaseEnvHwRegionStartAddress=4275994624, vBaseEnvHwRegionEccAlignment=4
            DataFlash: vBaseEnvHwRegionSize=32768, vBaseEnvHwRegionStartAddress=4280287232
            CodeFlash_Ext: vBaseEnvHwRegionSize=32768, vBaseEnvHwRegionStartAddress=16777216
            RetentionRAM: vBaseEnvHwRegionSize=32768, vBaseEnvHwRegionStartAddress=4276092928, vBaseEnvHwRegionEccAlignment=4
          vBaseEnvClockSettings: vBaseEnvOscClock=8000000, vBaseEnvPeriphClock=48000000, vBaseEnvTimebaseClock=80000000
        RH850_1064: vBaseEnvCpuMaxFrequency=96000000, vBaseEnvAvailableChannels_Flexray=0, vBaseEnvAvailableChannels_Can=2, vBaseEnvAvailableChannels_Lin=2, vBaseEnvAvailableChannels_Ethernet=0, vBaseEnvCpuCoreAmount=1, vBaseEnvTestedDerivative=RH850_1064, vBaseEnvTestedDerivativeDescription=Renesas RH850 R1M Family R7F701064, vBaseEnvCpuCore=G3K
          vBaseEnvAdditionalParameters: vBaseEnvClockGroup=A, vBaseEnvDerivativeGroup=R1L, vBaseEnvPllGroup=A, vBaseEnvProtectionGroup=A, vBaseEnvPortGroup=A1, vBaseEnvResetGroup=A
          5 x vBaseEnvMemLayoutHwRegion:
            CodeFlash_A: vBaseEnvHwRegionSize=1048576, vBaseEnvHwRegionStartAddress=0
            LocalRAM_CPU0: vBaseEnvHwRegionSize=98304, vBaseEnvHwRegionStartAddress=4275994624, vBaseEnvHwRegionEccAlignment=4
            DataFlash: vBaseEnvHwRegionSize=32768, vBaseEnvHwRegionStartAddress=4280287232
            CodeFlash_Ext: vBaseEnvHwRegionSize=32768, vBaseEnvHwRegionStartAddress=16777216
            RetentionRAM: vBaseEnvHwRegionSize=98304, vBaseEnvHwRegionStartAddress=4275994624, vBaseEnvHwRegionEccAlignment=4
          vBaseEnvClockSettings: vBaseEnvOscClock=8000000, vBaseEnvPeriphClock=48000000, vBaseEnvTimebaseClock=80000000
        RH850_1278: vBaseEnvCpuMaxFrequency=240000000, vBaseEnvAvailableChannels_Flexray=0, vBaseEnvAvailableChannels_Can=4, vBaseEnvAvailableChannels_Lin=3, vBaseEnvAvailableChannels_Ethernet=0, vBaseEnvCpuCoreAmount=1, vBaseEnvTestedDerivative=RH850_1278, vBaseEnvTestedDerivativeDescription=Renesas RH850 C1M_AZ Family R7F701278, vBaseEnvCpuCore=G3M
          vBaseEnvAdditionalParameters: vBaseEnvClockGroup=C, vBaseEnvDerivativeGroup=C1M_A1, vBaseEnvPllGroup=C, vBaseEnvProtectionGroup=B, vBaseEnvPortGroup=E, vBaseEnvResetGroup=B
          6 x vBaseEnvMemLayoutHwRegion:
            CodeFlash_A: vBaseEnvHwRegionSize=2097152, vBaseEnvHwRegionStartAddress=0
            LocalRAM_CPU0: vBaseEnvHwRegionSize=65536, vBaseEnvHwRegionStartAddress=4273930240, vBaseEnvHwRegionEccAlignment=4
            GlobalRAM_A: vBaseEnvHwRegionSize=65536, vBaseEnvHwRegionStartAddress=4277075968, vBaseEnvHwRegionEccAlignment=4
            DataFlash: vBaseEnvHwRegionSize=65536, vBaseEnvHwRegionStartAddress=4280287232
            FCU_RAM: vBaseEnvHwRegionSize=4096, vBaseEnvHwRegionStartAddress=4288749568, vBaseEnvHwRegionEccAlignment=4
            LocalRAM_Self: vBaseEnvHwRegionSize=65536, vBaseEnvHwRegionStartAddress=4276027392, vBaseEnvHwRegionEccAlignment=4
          vBaseEnvClockSettings: vBaseEnvPeriphClock=40000000, vBaseEnvOscClock=20000000, vBaseEnvTimebaseClock=240000000
        RH850_1282: vBaseEnvCpuMaxFrequency=240000000, vBaseEnvAvailableChannels_Flexray=0, vBaseEnvAvailableChannels_Can=4, vBaseEnvAvailableChannels_Lin=0, vBaseEnvAvailableChannels_Ethernet=0, vBaseEnvCpuCoreAmount=2, vBaseEnvTestedDerivative=RH850_1282, vBaseEnvTestedDerivativeDescription=Renesas RH850 C1M_AZ Family R7F701282, vBaseEnvCpuCore=G3M
          vBaseEnvAdditionalParameters: vBaseEnvClockGroup=C, vBaseEnvDerivativeGroup=C1M_AZ, vBaseEnvPllGroup=C, vBaseEnvProtectionGroup=B, vBaseEnvPortGroup=E, vBaseEnvResetGroup=B
          8 x vBaseEnvMemLayoutHwRegion:
            CodeFlash_A: vBaseEnvHwRegionSize=786432, vBaseEnvHwRegionStartAddress=0
            CodeFlash_B: vBaseEnvHwRegionSize=786432, vBaseEnvHwRegionStartAddress=2097152
            LocalRAM_CPU0: vBaseEnvHwRegionSize=65536, vBaseEnvHwRegionStartAddress=4273930240, vBaseEnvHwRegionEccAlignment=4
            LocalRAM_CPU1: vBaseEnvHwRegionSize=65536, vBaseEnvHwRegionStartAddress=4271833088, vBaseEnvHwRegionEccAlignment=4
            GlobalRAM_A: vBaseEnvHwRegionSize=65536, vBaseEnvHwRegionStartAddress=4277075968, vBaseEnvHwRegionEccAlignment=4
            DataFlash: vBaseEnvHwRegionSize=32768, vBaseEnvHwRegionStartAddress=4280287232
            FCU_RAM: vBaseEnvHwRegionSize=4096, vBaseEnvHwRegionStartAddress=4288749568, vBaseEnvHwRegionEccAlignment=4
            LocalRAM_Self: vBaseEnvHwRegionSize=65536, vBaseEnvHwRegionStartAddress=4276027392, vBaseEnvHwRegionEccAlignment=4
          vBaseEnvClockSettings: vBaseEnvPeriphClock=40000000, vBaseEnvOscClock=20000000, vBaseEnvTimebaseClock=240000000
        RH850_1422: vBaseEnvCpuMaxFrequency=120000000, vBaseEnvAvailableChannels_Flexray=0, vBaseEnvAvailableChannels_Can=3, vBaseEnvAvailableChannels_Lin=4, vBaseEnvAvailableChannels_Ethernet=0, vBaseEnvCpuCoreAmount=1, vBaseEnvTestedDerivative=RH850_1422, vBaseEnvTestedDerivativeDescription=Renesas RH850 D1L Family R7F701422, vBaseEnvCpuCore=G3M
          vBaseEnvAdditionalParameters: vBaseEnvClockGroup=A1, vBaseEnvDerivativeGroup=D1L, vBaseEnvPllGroup=A2, vBaseEnvProtectionGroup=A, vBaseEnvPortGroup=C, vBaseEnvResetGroup=A
          5 x vBaseEnvMemLayoutHwRegion:
            CodeFlash_A: vBaseEnvHwRegionSize=4194304, vBaseEnvHwRegionStartAddress=0
            LocalRAM_CPU0: vBaseEnvHwRegionSize=524288, vBaseEnvHwRegionStartAddress=4273471488, vBaseEnvHwRegionEccAlignment=4
            DataFlash: vBaseEnvHwRegionSize=65536, vBaseEnvHwRegionStartAddress=4280287232
            CodeFlash_Ext: vBaseEnvHwRegionSize=32768, vBaseEnvHwRegionStartAddress=16777216
            RetentionRAM: vBaseEnvHwRegionSize=16384, vBaseEnvHwRegionStartAddress=1070481408, vBaseEnvHwRegionEccAlignment=4
          vBaseEnvClockSettings: vBaseEnvOscClock=16000000, vBaseEnvPeriphClock=60000000, vBaseEnvTimebaseClock=120000000
        RH850_1A40: vBaseEnvCpuMaxFrequency=96000000, vBaseEnvAvailableChannels_Flexray=0, vBaseEnvAvailableChannels_Can=3, vBaseEnvAvailableChannels_Lin=4, vBaseEnvAvailableChannels_Ethernet=0, vBaseEnvCpuCoreAmount=1, vBaseEnvTestedDerivative=RH850_1A40, vBaseEnvTestedDerivativeDescription=Renesas RH850 F1L Family R7F701A40, vBaseEnvCpuCore=G3K
          vBaseEnvAdditionalParameters: vBaseEnvClockGroup=A, vBaseEnvDerivativeGroup=F1L, vBaseEnvPllGroup=A, vBaseEnvProtectionGroup=A, vBaseEnvPortGroup=A, vBaseEnvResetGroup=A
          5 x vBaseEnvMemLayoutHwRegion:
            CodeFlash_A: vBaseEnvHwRegionSize=524288, vBaseEnvHwRegionStartAddress=0
            LocalRAM_CPU0: vBaseEnvHwRegionSize=32768, vBaseEnvHwRegionStartAddress=4276060160, vBaseEnvHwRegionEccAlignment=4
            DataFlash: vBaseEnvHwRegionSize=32768, vBaseEnvHwRegionStartAddress=4280287232
            CodeFlash_Ext: vBaseEnvHwRegionSize=32768, vBaseEnvHwRegionStartAddress=16777216
            RetentionRAM: vBaseEnvHwRegionSize=32768, vBaseEnvHwRegionStartAddress=4276092928, vBaseEnvHwRegionEccAlignment=4
          vBaseEnvClockSettings: vBaseEnvOscClock=8000000, vBaseEnvPeriphClock=40000000, vBaseEnvTimebaseClock=80000000
        RH850_1634: vBaseEnvCpuMaxFrequency=160000000, vBaseEnvAvailableChannels_Flexray=2, vBaseEnvAvailableChannels_Can=8, vBaseEnvAvailableChannels_Lin=6, vBaseEnvAvailableChannels_Ethernet=0, vBaseEnvCpuCoreAmount=1, vBaseEnvTestedDerivative=RH850_1634, vBaseEnvTestedDerivativeDescription=Renesas RH850 F1KM_S4 Family R7F701634, vBaseEnvCpuCore=G3KH
          vBaseEnvAdditionalParameters: vBaseEnvClockGroup=A2, vBaseEnvDerivativeGroup=F1KM_S4, vBaseEnvPllGroup=A4, vBaseEnvProtectionGroup=A, vBaseEnvPortGroup=A, vBaseEnvResetGroup=A
          8 x vBaseEnvMemLayoutHwRegion:
            CodeFlash_A: vBaseEnvHwRegionSize=3145728, vBaseEnvHwRegionStartAddress=0
            LocalRAM_CPU0: vBaseEnvHwRegionSize=196608, vBaseEnvHwRegionStartAddress=4273799168, vBaseEnvHwRegionEccAlignment=4
            GlobalRAM_A: vBaseEnvHwRegionSize=49152, vBaseEnvHwRegionStartAddress=4277092352, vBaseEnvHwRegionEccAlignment=4
            GlobalRAM_B: vBaseEnvHwRegionSize=49152, vBaseEnvHwRegionStartAddress=4278140928, vBaseEnvHwRegionEccAlignment=4
            DataFlash: vBaseEnvHwRegionSize=98304, vBaseEnvHwRegionStartAddress=4280287232
            CodeFlash_Ext: vBaseEnvHwRegionSize=32768, vBaseEnvHwRegionStartAddress=16777216
            RetentionRAM: vBaseEnvHwRegionSize=65536, vBaseEnvHwRegionStartAddress=4277141504, vBaseEnvHwRegionEccAlignment=4
            LocalRAM_Self: vBaseEnvHwRegionSize=163840, vBaseEnvHwRegionStartAddress=4275929088, vBaseEnvHwRegionEccAlignment=4
          vBaseEnvClockSettings: vBaseEnvOscClock=16000000, vBaseEnvPeriphClock=40000000, vBaseEnvTimebaseClock=160000000
        RH850_1652: vBaseEnvCpuMaxFrequency=240000000, vBaseEnvAvailableChannels_Flexray=2, vBaseEnvAvailableChannels_Can=8, vBaseEnvAvailableChannels_Lin=20, vBaseEnvAvailableChannels_Ethernet=1, vBaseEnvCpuCoreAmount=1, vBaseEnvTestedDerivative=RH850_1652, vBaseEnvTestedDerivativeDescription=Renesas RH850 F1KM_S4 Family R7F701652, vBaseEnvCpuCore=G3KH
          vBaseEnvAdditionalParameters: vBaseEnvClockGroup=A2, vBaseEnvDerivativeGroup=F1KM_S4, vBaseEnvPllGroup=A4, vBaseEnvProtectionGroup=A, vBaseEnvPortGroup=A, vBaseEnvResetGroup=A
          8 x vBaseEnvMemLayoutHwRegion:
            CodeFlash_A: vBaseEnvHwRegionSize=3145728, vBaseEnvHwRegionStartAddress=0
            LocalRAM_CPU0: vBaseEnvHwRegionSize=196608, vBaseEnvHwRegionStartAddress=4273799168, vBaseEnvHwRegionEccAlignment=4
            GlobalRAM_A: vBaseEnvHwRegionSize=65536, vBaseEnvHwRegionStartAddress=4277075968, vBaseEnvHwRegionEccAlignment=4
            GlobalRAM_B: vBaseEnvHwRegionSize=65536, vBaseEnvHwRegionStartAddress=4278124544, vBaseEnvHwRegionEccAlignment=4
            DataFlash: vBaseEnvHwRegionSize=131072, vBaseEnvHwRegionStartAddress=4280287232
            CodeFlash_Ext: vBaseEnvHwRegionSize=32768, vBaseEnvHwRegionStartAddress=16777216
            RetentionRAM: vBaseEnvHwRegionSize=65536, vBaseEnvHwRegionStartAddress=4277141504, vBaseEnvHwRegionEccAlignment=4
            LocalRAM_Self: vBaseEnvHwRegionSize=196608, vBaseEnvHwRegionStartAddress=4275896320, vBaseEnvHwRegionEccAlignment=4
          vBaseEnvClockSettings: vBaseEnvOscClock=16000000, vBaseEnvPeriphClock=40000000, vBaseEnvTimebaseClock=160000000
        RH850_1A55: vBaseEnvCpuMaxFrequency=240000000, vBaseEnvAvailableChannels_Flexray=2, vBaseEnvAvailableChannels_Can=8, vBaseEnvAvailableChannels_Lin=6, vBaseEnvAvailableChannels_Ethernet=0, vBaseEnvCpuCoreAmount=1, vBaseEnvTestedDerivative=RH850_1A55, vBaseEnvTestedDerivativeDescription=Renesas RH850 F1KM_S4 Family R7F701A55, vBaseEnvCpuCore=G3KH
          vBaseEnvAdditionalParameters: vBaseEnvClockGroup=A2, vBaseEnvDerivativeGroup=F1KM_S4, vBaseEnvPllGroup=A4, vBaseEnvProtectionGroup=A, vBaseEnvPortGroup=A, vBaseEnvResetGroup=A
          8 x vBaseEnvMemLayoutHwRegion:
            CodeFlash_A: vBaseEnvHwRegionSize=3145728, vBaseEnvHwRegionStartAddress=0
            LocalRAM_CPU0: vBaseEnvHwRegionSize=196608, vBaseEnvHwRegionStartAddress=4273799168, vBaseEnvHwRegionEccAlignment=4
            GlobalRAM_A: vBaseEnvHwRegionSize=65536, vBaseEnvHwRegionStartAddress=4277075968, vBaseEnvHwRegionEccAlignment=4
            GlobalRAM_B: vBaseEnvHwRegionSize=65536, vBaseEnvHwRegionStartAddress=4278124544, vBaseEnvHwRegionEccAlignment=4
            DataFlash: vBaseEnvHwRegionSize=131072, vBaseEnvHwRegionStartAddress=4280287232
            CodeFlash_Ext: vBaseEnvHwRegionSize=32768, vBaseEnvHwRegionStartAddress=16777216
            RetentionRAM: vBaseEnvHwRegionSize=65536, vBaseEnvHwRegionStartAddress=4277141504, vBaseEnvHwRegionEccAlignment=4
            LocalRAM_Self: vBaseEnvHwRegionSize=196608, vBaseEnvHwRegionStartAddress=4275896320, vBaseEnvHwRegionEccAlignment=4
          vBaseEnvClockSettings: vBaseEnvOscClock=16000000, vBaseEnvPeriphClock=40000000, vBaseEnvTimebaseClock=160000000
        RH850_1A57: vBaseEnvCpuMaxFrequency=240000000, vBaseEnvAvailableChannels_Flexray=2, vBaseEnvAvailableChannels_Can=8, vBaseEnvAvailableChannels_Lin=12, vBaseEnvAvailableChannels_Ethernet=0, vBaseEnvCpuCoreAmount=1, vBaseEnvTestedDerivative=RH850_1A57, vBaseEnvTestedDerivativeDescription=Renesas RH850 F1KM_S4 Family R7F701A57, vBaseEnvCpuCore=G3KH
          vBaseEnvAdditionalParameters: vBaseEnvClockGroup=A2, vBaseEnvDerivativeGroup=F1KM_S4, vBaseEnvPllGroup=A4, vBaseEnvProtectionGroup=A, vBaseEnvPortGroup=A, vBaseEnvResetGroup=A
          8 x vBaseEnvMemLayoutHwRegion:
            CodeFlash_A: vBaseEnvHwRegionSize=3145728, vBaseEnvHwRegionStartAddress=0
            LocalRAM_CPU0: vBaseEnvHwRegionSize=196608, vBaseEnvHwRegionStartAddress=4273799168, vBaseEnvHwRegionEccAlignment=4
            GlobalRAM_A: vBaseEnvHwRegionSize=65536, vBaseEnvHwRegionStartAddress=4277075968, vBaseEnvHwRegionEccAlignment=4
            GlobalRAM_B: vBaseEnvHwRegionSize=65536, vBaseEnvHwRegionStartAddress=4278124544, vBaseEnvHwRegionEccAlignment=4
            DataFlash: vBaseEnvHwRegionSize=131072, vBaseEnvHwRegionStartAddress=4280287232
            CodeFlash_Ext: vBaseEnvHwRegionSize=32768, vBaseEnvHwRegionStartAddress=16777216
            RetentionRAM: vBaseEnvHwRegionSize=65536, vBaseEnvHwRegionStartAddress=4277141504, vBaseEnvHwRegionEccAlignment=4
            LocalRAM_Self: vBaseEnvHwRegionSize=196608, vBaseEnvHwRegionStartAddress=4275896320, vBaseEnvHwRegionEccAlignment=4
          vBaseEnvClockSettings: vBaseEnvOscClock=16000000, vBaseEnvPeriphClock=40000000, vBaseEnvTimebaseClock=160000000
        RH850_1A59: vBaseEnvCpuMaxFrequency=240000000, vBaseEnvAvailableChannels_Flexray=2, vBaseEnvAvailableChannels_Can=8, vBaseEnvAvailableChannels_Lin=18, vBaseEnvAvailableChannels_Ethernet=1, vBaseEnvCpuCoreAmount=1, vBaseEnvTestedDerivative=RH850_1A59, vBaseEnvTestedDerivativeDescription=Renesas RH850 F1KM_S4 Family R7F701A59, vBaseEnvCpuCore=G3KH
          vBaseEnvAdditionalParameters: vBaseEnvClockGroup=A2, vBaseEnvDerivativeGroup=F1KM_S4, vBaseEnvPllGroup=A4, vBaseEnvProtectionGroup=A, vBaseEnvPortGroup=A, vBaseEnvResetGroup=A
          8 x vBaseEnvMemLayoutHwRegion:
            CodeFlash_A: vBaseEnvHwRegionSize=3145728, vBaseEnvHwRegionStartAddress=0
            LocalRAM_CPU0: vBaseEnvHwRegionSize=196608, vBaseEnvHwRegionStartAddress=4273799168, vBaseEnvHwRegionEccAlignment=4
            GlobalRAM_A: vBaseEnvHwRegionSize=65536, vBaseEnvHwRegionStartAddress=4277075968, vBaseEnvHwRegionEccAlignment=4
            GlobalRAM_B: vBaseEnvHwRegionSize=65536, vBaseEnvHwRegionStartAddress=4278124544, vBaseEnvHwRegionEccAlignment=4
            DataFlash: vBaseEnvHwRegionSize=131072, vBaseEnvHwRegionStartAddress=4280287232
            CodeFlash_Ext: vBaseEnvHwRegionSize=32768, vBaseEnvHwRegionStartAddress=16777216
            RetentionRAM: vBaseEnvHwRegionSize=65536, vBaseEnvHwRegionStartAddress=4277141504, vBaseEnvHwRegionEccAlignment=4
            LocalRAM_Self: vBaseEnvHwRegionSize=196608, vBaseEnvHwRegionStartAddress=4275896320, vBaseEnvHwRegionEccAlignment=4
          vBaseEnvClockSettings: vBaseEnvOscClock=16000000, vBaseEnvPeriphClock=40000000, vBaseEnvTimebaseClock=160000000
        RH850_1A56: vBaseEnvCpuMaxFrequency=240000000, vBaseEnvAvailableChannels_Flexray=2, vBaseEnvAvailableChannels_Can=8, vBaseEnvAvailableChannels_Lin=6, vBaseEnvAvailableChannels_Ethernet=0, vBaseEnvCpuCoreAmount=1, vBaseEnvTestedDerivative=RH850_1A56, vBaseEnvTestedDerivativeDescription=Renesas RH850 F1KM_S4 Family R7F701A56, vBaseEnvCpuCore=G3KH
          vBaseEnvAdditionalParameters: vBaseEnvClockGroup=A2, vBaseEnvDerivativeGroup=F1KM_S4, vBaseEnvPllGroup=A4, vBaseEnvProtectionGroup=A, vBaseEnvPortGroup=A, vBaseEnvResetGroup=A
          8 x vBaseEnvMemLayoutHwRegion:
            CodeFlash_A: vBaseEnvHwRegionSize=4194304, vBaseEnvHwRegionStartAddress=0
            LocalRAM_CPU0: vBaseEnvHwRegionSize=262144, vBaseEnvHwRegionStartAddress=4273733632, vBaseEnvHwRegionEccAlignment=4
            GlobalRAM_A: vBaseEnvHwRegionSize=98304, vBaseEnvHwRegionStartAddress=4277043200, vBaseEnvHwRegionEccAlignment=4
            GlobalRAM_B: vBaseEnvHwRegionSize=98304, vBaseEnvHwRegionStartAddress=4278091776, vBaseEnvHwRegionEccAlignment=4
            DataFlash: vBaseEnvHwRegionSize=131072, vBaseEnvHwRegionStartAddress=4280287232
            CodeFlash_Ext: vBaseEnvHwRegionSize=32768, vBaseEnvHwRegionStartAddress=16777216
            RetentionRAM: vBaseEnvHwRegionSize=65536, vBaseEnvHwRegionStartAddress=4277141504, vBaseEnvHwRegionEccAlignment=4
            LocalRAM_Self: vBaseEnvHwRegionSize=262144, vBaseEnvHwRegionStartAddress=4275830784, vBaseEnvHwRegionEccAlignment=4
          vBaseEnvClockSettings: vBaseEnvOscClock=16000000, vBaseEnvPeriphClock=40000000, vBaseEnvTimebaseClock=160000000
        RH850_1A58: vBaseEnvCpuMaxFrequency=240000000, vBaseEnvAvailableChannels_Flexray=2, vBaseEnvAvailableChannels_Can=8, vBaseEnvAvailableChannels_Lin=12, vBaseEnvAvailableChannels_Ethernet=0, vBaseEnvCpuCoreAmount=1, vBaseEnvTestedDerivative=RH850_1A58, vBaseEnvTestedDerivativeDescription=Renesas RH850 F1KM_S4 Family R7F701A58, vBaseEnvCpuCore=G3KH
          vBaseEnvAdditionalParameters: vBaseEnvClockGroup=A2, vBaseEnvDerivativeGroup=F1KM_S4, vBaseEnvPllGroup=A4, vBaseEnvProtectionGroup=A, vBaseEnvPortGroup=A, vBaseEnvResetGroup=A
          8 x vBaseEnvMemLayoutHwRegion:
            CodeFlash_A: vBaseEnvHwRegionSize=4194304, vBaseEnvHwRegionStartAddress=0
            LocalRAM_CPU0: vBaseEnvHwRegionSize=262144, vBaseEnvHwRegionStartAddress=4273733632, vBaseEnvHwRegionEccAlignment=4
            GlobalRAM_A: vBaseEnvHwRegionSize=98304, vBaseEnvHwRegionStartAddress=4277043200, vBaseEnvHwRegionEccAlignment=4
            GlobalRAM_B: vBaseEnvHwRegionSize=98304, vBaseEnvHwRegionStartAddress=4278091776, vBaseEnvHwRegionEccAlignment=4
            DataFlash: vBaseEnvHwRegionSize=131072, vBaseEnvHwRegionStartAddress=4280287232
            CodeFlash_Ext: vBaseEnvHwRegionSize=32768, vBaseEnvHwRegionStartAddress=16777216
            RetentionRAM: vBaseEnvHwRegionSize=65536, vBaseEnvHwRegionStartAddress=4277141504, vBaseEnvHwRegionEccAlignment=4
            LocalRAM_Self: vBaseEnvHwRegionSize=262144, vBaseEnvHwRegionStartAddress=4275830784, vBaseEnvHwRegionEccAlignment=4
          vBaseEnvClockSettings: vBaseEnvOscClock=16000000, vBaseEnvPeriphClock=40000000, vBaseEnvTimebaseClock=160000000
        RH850_1A60: vBaseEnvCpuMaxFrequency=240000000, vBaseEnvAvailableChannels_Flexray=2, vBaseEnvAvailableChannels_Can=8, vBaseEnvAvailableChannels_Lin=18, vBaseEnvAvailableChannels_Ethernet=1, vBaseEnvCpuCoreAmount=1, vBaseEnvTestedDerivative=RH850_1A60, vBaseEnvTestedDerivativeDescription=Renesas RH850 F1KM_S4 Family R7F701A60, vBaseEnvCpuCore=G3KH
          vBaseEnvAdditionalParameters: vBaseEnvClockGroup=A2, vBaseEnvDerivativeGroup=F1KM_S4, vBaseEnvPllGroup=A4, vBaseEnvProtectionGroup=A, vBaseEnvPortGroup=A, vBaseEnvResetGroup=A
          8 x vBaseEnvMemLayoutHwRegion:
            CodeFlash_A: vBaseEnvHwRegionSize=4194304, vBaseEnvHwRegionStartAddress=0
            LocalRAM_CPU0: vBaseEnvHwRegionSize=262144, vBaseEnvHwRegionStartAddress=4273733632, vBaseEnvHwRegionEccAlignment=4
            GlobalRAM_A: vBaseEnvHwRegionSize=98304, vBaseEnvHwRegionStartAddress=4277043200, vBaseEnvHwRegionEccAlignment=4
            GlobalRAM_B: vBaseEnvHwRegionSize=98304, vBaseEnvHwRegionStartAddress=4278091776, vBaseEnvHwRegionEccAlignment=4
            DataFlash: vBaseEnvHwRegionSize=131072, vBaseEnvHwRegionStartAddress=4280287232
            CodeFlash_Ext: vBaseEnvHwRegionSize=32768, vBaseEnvHwRegionStartAddress=16777216
            RetentionRAM: vBaseEnvHwRegionSize=65536, vBaseEnvHwRegionStartAddress=4277141504, vBaseEnvHwRegionEccAlignment=4
            LocalRAM_Self: vBaseEnvHwRegionSize=262144, vBaseEnvHwRegionStartAddress=4275830784, vBaseEnvHwRegionEccAlignment=4
          vBaseEnvClockSettings: vBaseEnvOscClock=16000000, vBaseEnvPeriphClock=40000000, vBaseEnvTimebaseClock=160000000
        RH850_1650: vBaseEnvCpuMaxFrequency=240000000, vBaseEnvAvailableChannels_Flexray=2, vBaseEnvAvailableChannels_Can=8, vBaseEnvAvailableChannels_Lin=20, vBaseEnvAvailableChannels_Ethernet=1, vBaseEnvCpuCoreAmount=1, vBaseEnvTestedDerivative=RH850_1650, vBaseEnvTestedDerivativeDescription=Renesas RH850 F1KM_S4 Family R7F701650, vBaseEnvCpuCore=G3KH
          vBaseEnvAdditionalParameters: vBaseEnvClockGroup=A2, vBaseEnvDerivativeGroup=F1KM_S4, vBaseEnvPllGroup=A4, vBaseEnvProtectionGroup=A, vBaseEnvPortGroup=A, vBaseEnvResetGroup=A
          8 x vBaseEnvMemLayoutHwRegion:
            CodeFlash_A: vBaseEnvHwRegionSize=3145728, vBaseEnvHwRegionStartAddress=0
            LocalRAM_CPU0: vBaseEnvHwRegionSize=196608, vBaseEnvHwRegionStartAddress=4273799168, vBaseEnvHwRegionEccAlignment=4
            GlobalRAM_A: vBaseEnvHwRegionSize=65536, vBaseEnvHwRegionStartAddress=4277075968, vBaseEnvHwRegionEccAlignment=4
            GlobalRAM_B: vBaseEnvHwRegionSize=65536, vBaseEnvHwRegionStartAddress=4278124544, vBaseEnvHwRegionEccAlignment=4
            DataFlash: vBaseEnvHwRegionSize=131072, vBaseEnvHwRegionStartAddress=4280287232
            CodeFlash_Ext: vBaseEnvHwRegionSize=32768, vBaseEnvHwRegionStartAddress=16777216
            RetentionRAM: vBaseEnvHwRegionSize=65536, vBaseEnvHwRegionStartAddress=4277141504, vBaseEnvHwRegionEccAlignment=4
            LocalRAM_Self: vBaseEnvHwRegionSize=196608, vBaseEnvHwRegionStartAddress=4275896320, vBaseEnvHwRegionEccAlignment=4
          vBaseEnvClockSettings: vBaseEnvOscClock=16000000, vBaseEnvPeriphClock=40000000, vBaseEnvTimebaseClock=160000000
        RH850_1326: vBaseEnvCpuMaxFrequency=240000000, vBaseEnvAvailableChannels_Flexray=4, vBaseEnvAvailableChannels_Can=4, vBaseEnvAvailableChannels_Lin=4, vBaseEnvAvailableChannels_Ethernet=2, vBaseEnvCpuCoreAmount=2, vBaseEnvTestedDerivative=RH850_1326, vBaseEnvTestedDerivativeDescription=Renesas RH850 P1H Family R7F701326, vBaseEnvCpuCore=G3M
          vBaseEnvAdditionalParameters:
            vBaseEnvClockGroup = D
            vBaseEnvDerivativeGroup = P1H
            vBaseEnvPllGroup = D
            vBaseEnvProtectionGroup = NONE
            vBaseEnvPortGroup = B2
            vBaseEnvResetGroup = D
            vBaseEnvPowerDownModes = true
          8 x vBaseEnvMemLayoutHwRegion:
            CodeFlash_A: vBaseEnvHwRegionSize=4194304, vBaseEnvHwRegionStartAddress=0
            CodeFlash_B: vBaseEnvHwRegionSize=4194304, vBaseEnvHwRegionStartAddress=8388608
            LocalRAM_CPU0: vBaseEnvHwRegionSize=65536, vBaseEnvHwRegionStartAddress=4273930240, vBaseEnvHwRegionEccAlignment=4
            LocalRAM_CPU1: vBaseEnvHwRegionSize=65536, vBaseEnvHwRegionStartAddress=4271833088, vBaseEnvHwRegionEccAlignment=4
            GlobalRAM_A: vBaseEnvHwRegionSize=491520, vBaseEnvHwRegionStartAddress=4276649984, vBaseEnvHwRegionEccAlignment=4
            GlobalRAM_B: vBaseEnvHwRegionSize=491520, vBaseEnvHwRegionStartAddress=4277141504, vBaseEnvHwRegionEccAlignment=4
            DataFlash: vBaseEnvHwRegionSize=196608, vBaseEnvHwRegionStartAddress=4280287232
            LocalRAM_Self: vBaseEnvHwRegionSize=65536, vBaseEnvHwRegionStartAddress=4276027392, vBaseEnvHwRegionEccAlignment=4
          vBaseEnvClockSettings: vBaseEnvOscClock=16000000, vBaseEnvPeriphClock=80000000, vBaseEnvTimebaseClock=240000000
        RH850_1388: vBaseEnvCpuMaxFrequency=120000000, vBaseEnvAvailableChannels_Flexray=0, vBaseEnvAvailableChannels_Can=2, vBaseEnvAvailableChannels_Lin=2, vBaseEnvAvailableChannels_Ethernet=0, vBaseEnvCpuCoreAmount=1, vBaseEnvTestedDerivative=RH850_1388, vBaseEnvTestedDerivativeDescription=Renesas RH850 P1L-C Family R7F701388, vBaseEnvCpuCore=G3M
          vBaseEnvAdditionalParameters: vBaseEnvClockGroup=D, vBaseEnvDerivativeGroup=P1L_C, vBaseEnvPllGroup=E, vBaseEnvProtectionGroup=A, vBaseEnvPortGroup=F, vBaseEnvResetGroup=C
          4 x vBaseEnvMemLayoutHwRegion:
            CodeFlash_A: vBaseEnvHwRegionSize=1048576, vBaseEnvHwRegionStartAddress=0
            LocalRAM_CPU0: vBaseEnvHwRegionSize=102400, vBaseEnvHwRegionStartAddress=4273893376, vBaseEnvHwRegionEccAlignment=4
            DataFlash: vBaseEnvHwRegionSize=65536, vBaseEnvHwRegionStartAddress=4280287232
            CodeFlash_Ext: vBaseEnvHwRegionSize=1024, vBaseEnvHwRegionStartAddress=16818176
          vBaseEnvClockSettings: vBaseEnvOscClock=16000000, vBaseEnvPeriphClock=40000000, vBaseEnvTimebaseClock=120000000
        RH850_1389: vBaseEnvCpuMaxFrequency=120000000, vBaseEnvAvailableChannels_Flexray=0, vBaseEnvAvailableChannels_Can=2, vBaseEnvAvailableChannels_Lin=2, vBaseEnvAvailableChannels_Ethernet=0, vBaseEnvCpuCoreAmount=1, vBaseEnvTestedDerivative=RH850_1389, vBaseEnvTestedDerivativeDescription=Renesas RH850 P1L-C Family R7F701389, vBaseEnvCpuCore=G3M
          vBaseEnvAdditionalParameters: vBaseEnvClockGroup=D, vBaseEnvDerivativeGroup=P1L_C, vBaseEnvPllGroup=E, vBaseEnvProtectionGroup=A, vBaseEnvPortGroup=F, vBaseEnvResetGroup=C
          4 x vBaseEnvMemLayoutHwRegion:
            CodeFlash_A: vBaseEnvHwRegionSize=1048576, vBaseEnvHwRegionStartAddress=0
            LocalRAM_CPU0: vBaseEnvHwRegionSize=102400, vBaseEnvHwRegionStartAddress=4273893376, vBaseEnvHwRegionEccAlignment=4
            DataFlash: vBaseEnvHwRegionSize=65536, vBaseEnvHwRegionStartAddress=4280287232
            CodeFlash_Ext: vBaseEnvHwRegionSize=1024, vBaseEnvHwRegionStartAddress=16818176
          vBaseEnvClockSettings: vBaseEnvOscClock=16000000, vBaseEnvPeriphClock=40000000, vBaseEnvTimebaseClock=120000000
