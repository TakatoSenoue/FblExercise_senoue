AUTOSAR XML (schema 00053)
package /ActiveEcuC
  module config Port: implementation-config-variant=VARIANT-POST-BUILD-LOADABLE, module-description=Port_Impl
    PortGeneral:
      PortVersionCheckExternalModules = false
      PortDevErrorDetect = true
      PortSetPinDirectionApi = false
      PortSetPinModeApi = false
      PortVersionInfoApi = false
      PortCriticalSectionProtection = true
      PortDeviceName = R7F701649
      PortUnlockSequenceCount = 5
      PortMaxMode = 7
      PortPinStatusBackUp = false
      PortRAMMirror = DISABLE
      PortSetPinDefaultDirectionApi = false
      PortSetPinDefaultModeApi = false
      PortSetToDioAltModeApi = false
      PortUseWriteVerifyErrorInterface = false
      PortWriteVerify = WV_DISABLE
    PortConfigSet
      PortContainer: PortNumberOfPortPins=1
        PortPin:
          PortPinDirection = PORT_PIN_IN
          PortPinDirectionChangeable = false
          PortPinId = 1
          PortPinInitialMode = PORT_PIN_MODE_ADC
          PortPinLevelValue = PORT_PIN_LEVEL_HIGH
          PortPinMode = PORT_PIN_MODE_ADC
          PortPinModeChangeable = false
      PortFilterGroupConfig
      PortGroup10
        PortPin0:
          PortBiDirectionControl = false
          PortDriveStrengthControl = false
          PortInputBufferControl = false
          PortInputSelection = TYPE_2_SUPP_PIS
          PortIpControl = false
          PortOpenDrainControl = false
          PortPinDioAltModeChangeable = false
          PortPinDirection = PORT_PIN_IN
          PortPinDirectionChangeable = false
          PortPinInitialMode = CAN0RX_AT2IN
          PortPinLevelValue = PORT_PIN_LEVEL_LOW
          PortPinModeChangeable = false
          PortPullDownOption = false
          PortPullUpOption = false
        PortPin1:
          PortBiDirectionControl = false
          PortDriveStrengthControl = false
          PortInputBufferControl = false
          PortInputSelection = TYPE_2_SUPP_PIS
          PortIpControl = false
          PortOpenDrainControl = false
          PortPinDioAltModeChangeable = false
          PortPinDirection = PORT_PIN_OUT
          PortPinDirectionChangeable = false
          PortPinInitialMode = CAN0TX_AT2OUT
          PortPinLevelValue = PORT_PIN_LEVEL_LOW
          PortPinModeChangeable = false
          PortPullDownOption = false
          PortPullUpOption = false
    PortDemEventParameterRefs: PORT_E_WRITE_TIMEOUT_FAILURE=DemEventParameter
