AUTOSAR XML (schema 00053)
package /ActiveEcuC
  module config vLinkGen: implementation-config-variant=VARIANT-PRE-COMPILE, module-description=vLinkGen_Impl
    vLinkGenGeneral: vLinkGenFileGeneration=ONE_FILE_PER_VARIANT, vLinkGen64BitMemoryMode=false, vLinkGenEntrySymbol=
    vLinkGenVariantHandling
      6 x vLinkGenVariant:
        vLinkGenVariant_FirstExecInst: vLinkGenVariant_isFirstExec=true, vLinkGenVariant_isStandardAppl=false
        vLinkGenVariant_DemoFbl: vLinkGenVariant_isStandardAppl=true, vLinkGenVariant_isFirstExec=false
        vLinkGenVariant_DemoAppl: vLinkGenVariant_isStandardAppl=true, vLinkGenVariant_isFirstExec=false
        vLinkGenVariant_DemoUpd: vLinkGenVariant_isStandardAppl=true, vLinkGenVariant_isFirstExec=false
        vLinkGenVariant_FlashDrv: vLinkGenVariant_isFirstExec=false, vLinkGenVariant_isStandardAppl=false
        DemoBm: vLinkGenVariant_isFirstExec=false, vLinkGenVariant_isStandardAppl=true
    vLinkGenMemLayout
      3 x vLinkGenMemoryRegion, all with vLinkGenMemoryRegionAvailable=true:
        Var_EepDummyArea: vLinkGenMemoryRegionSize=256, vLinkGenMemoryRegionAddrOffset=12296, vLinkGenMemoryRegionAddress=4277153800, vLinkGenMemoryRegionHwRegion=RetentionRAM
          EepDummy (vLinkGenMemoryRegionBlock):
            vLinkGenMemoryRegionBlockPosition = 0
            vLinkGenMemoryRegionBlockSize = 256
            vLinkGenMemoryRegionBlockBoundary = LOWER
            vLinkGenMemoryRegionBlockInitStage = NONE
            vLinkGenMemoryRegionBlockAddress = 4277153800
        Var_MagicFlagArea: vLinkGenMemoryRegionSize=8, vLinkGenMemoryRegionAddrOffset=12288, vLinkGenMemoryRegionAddress=4277153792, vLinkGenMemoryRegionHwRegion=RetentionRAM
          MagicFlag (vLinkGenMemoryRegionBlock):
            vLinkGenMemoryRegionBlockSize = 8
            vLinkGenMemoryRegionBlockBoundary = LOWER
            vLinkGenMemoryRegionBlockInitStage = NONE
            vLinkGenMemoryRegionBlockPosition = 0
            vLinkGenMemoryRegionBlockAddress = 4277153792
        Const_Application: vLinkGenMemoryRegionAddrOffset=327680, vLinkGenMemoryRegionSize=327680, vLinkGenMemoryRegionAddress=327680, vLinkGenMemoryRegionHwRegion=CodeFlash_A
          5 x vLinkGenMemoryRegionBlock, all with vLinkGenMemoryRegionBlockInitStage=NONE:
            ApplVect: vLinkGenMemoryRegionBlockBoundary=LOWER, vLinkGenMemoryRegionBlockPosition=0, vLinkGenMemoryRegionBlockSize=8, vLinkGenMemoryRegionBlockAddress=327680
            ApplApplicationEntry: vLinkGenMemoryRegionBlockPosition=1, vLinkGenMemoryRegionBlockSize=256, vLinkGenMemoryRegionBlockAddress=327688, vLinkGenMemoryRegionBlockBoundary=LOWER
            ApplRomArea: vLinkGenMemoryRegionBlockBoundary=LOWER, vLinkGenMemoryRegionBlockPosition=2, vLinkGenMemoryRegionBlockSize=262144, vLinkGenMemoryRegionBlockAddress=327944
            ApplBmHdrHeader: vLinkGenMemoryRegionBlockBoundary=UPPER, vLinkGenMemoryRegionBlockPosition=0, vLinkGenMemoryRegionBlockSize=32, vLinkGenMemoryRegionBlockAddress=654304
            ApplReserved: vLinkGenMemoryRegionBlockBoundary=UPPER, vLinkGenMemoryRegionBlockPosition=1, vLinkGenMemoryRegionBlockSize=1024, vLinkGenMemoryRegionBlockAddress=654336
      4 x vLinkGenLogicalVarGroup, all with vLinkGenVarGroupInitCore=0, vLinkGenVarGroupVariant=vLinkGenVariant_DemoFbl, vLinkGenVarGroupVariant=vLinkGenVariant_FirstExecInst, vLinkGenVarGroupVariant=vLinkGenVariant_DemoUpd, vLinkGenVarGroupVariant=vLinkGenVariant_DemoAppl, vLinkGenVarGroupContentType=GLOBAL_DATA, vLinkGenVarGroupRegion=GLOBAL_RAM_A/GLOBAL_RAM_A, vLinkGenVarGroupRomRegion=BmRomArea:
        Data_Default: vLinkGenVarGroupPosition=1000, vLinkGenVarGroupVariant=DemoBm
          vLinkGenVarGroupVariantHandling
            DemoFbl (vLinkGenVarGroupVariantSpecifics): vLinkGenVarGroupSpecificRomRegion=FblRomArea, vLinkGenVarGroupSpecificVariant=vLinkGenVariant_DemoFbl
            DemoUpd_DemoAppl (vLinkGenVarGroupVariantSpecifics):
              vLinkGenVarGroupSpecificRomRegion = ApplRomArea
              vLinkGenVarGroupSpecificVariant = vLinkGenVariant_DemoUpd
              vLinkGenVarGroupSpecificVariant = vLinkGenVariant_DemoAppl
          9 x vLinkGenVarSectionGroup, all with vLinkGenVarSectionGroupPosition=0, vLinkGenVarSectionGroupInitStage=ONE:
            data: vLinkGenVarSectionGroupInit=INIT, vLinkGenVarSectionGroupAlignment=4, vLinkGenVarSectionGroupEndAlignment=4, vLinkGenVarSectionGroupRef=vLinkGenLinkerSections/data
            sdabase: vLinkGenVarSectionGroupInit=NONE, vLinkGenVarSectionGroupAlignment=4, vLinkGenVarSectionGroupRef=vLinkGenLinkerSections/sdabase
            sdata: vLinkGenVarSectionGroupInit=INIT, vLinkGenVarSectionGroupAlignment=4, vLinkGenVarSectionGroupEndAlignment=4, vLinkGenVarSectionGroupRef=vLinkGenLinkerSections/sdata
            zdata: vLinkGenVarSectionGroupInit=INIT, vLinkGenVarSectionGroupAlignment=4, vLinkGenVarSectionGroupEndAlignment=4, vLinkGenVarSectionGroupRef=vLinkGenLinkerSections/zdata, vLinkGenVarSectionGroupRef=PPC_EMB_SDATA0
            bss: vLinkGenVarSectionGroupInit=ZERO_INIT, vLinkGenVarSectionGroupAlignment=4, vLinkGenVarSectionGroupEndAlignment=4, vLinkGenVarSectionGroupRef=vLinkGenLinkerSections/bss, vLinkGenVarSectionGroupRef=COMMON, vLinkGenVarSectionGroupFlag=vLinkGenVarGroupFlags/CLEAR
            sbss: vLinkGenVarSectionGroupInit=ZERO_INIT, vLinkGenVarSectionGroupAlignment=4, vLinkGenVarSectionGroupEndAlignment=4, vLinkGenVarSectionGroupRef=vLinkGenLinkerSections/sbss, vLinkGenVarSectionGroupRef=SMALLCOMMON, vLinkGenVarSectionGroupFlag=vLinkGenVarGroupFlags/CLEAR
            zbss: vLinkGenVarSectionGroupInit=ZERO_INIT, vLinkGenVarSectionGroupAlignment=4, vLinkGenVarSectionGroupEndAlignment=4, vLinkGenVarSectionGroupRef=vLinkGenLinkerSections/zbss, vLinkGenVarSectionGroupRef=PPC_EMB_SBSS0, vLinkGenVarSectionGroupRef=ZEROCOMMON, vLinkGenVarSectionGroupFlag=vLinkGenVarGroupFlags/CLEAR
            stack: vLinkGenVarSectionGroupInit=NONE, vLinkGenVarSectionGroupAlignment=4, vLinkGenVarSectionGroupRef=vLinkGenLinkerSections/stack
            heap: vLinkGenVarSectionGroupAlignment=16, vLinkGenVarSectionGroupSize=1024, vLinkGenVarSectionGroupInit=NONE, vLinkGenVarSectionGroupFlag=vLinkGenVarGroupFlags/NOCLEAR
        MSR_PBCFG_VAR: vLinkGenVarGroupPosition=0
          vLinkGenVarGroupVariantHandling
            DemoFbl (vLinkGenVarGroupVariantSpecifics): vLinkGenVarGroupSpecificRomRegion=FblRomArea, vLinkGenVarGroupSpecificVariant=vLinkGenVariant_DemoFbl
            DemoUpd_DemoAppl (vLinkGenVarGroupVariantSpecifics):
              vLinkGenVarGroupSpecificRomRegion = ApplRomArea
              vLinkGenVarGroupSpecificVariant = vLinkGenVariant_DemoUpd
              vLinkGenVarGroupSpecificVariant = vLinkGenVariant_DemoAppl
          3 x vLinkGenVarSectionGroup, all with vLinkGenVarSectionGroupPosition=0, vLinkGenVarSectionGroupInitStage=ONE, vLinkGenVarSectionGroupAlignment=4:
            MSR_PBCFG_VAR_INIT: vLinkGenVarSectionGroupInit=INIT, vLinkGenVarSectionGroupEndAlignment=4, vLinkGenVarSectionGroupRef=vLinkGenLinkerSections/MSR_PBCFG_VAR, vLinkGenVarSectionGroupRef=MSR_PBCFG_VAR_FAST
            MSR_PBCFG_VAR_NO_INIT: vLinkGenVarSectionGroupInit=NONE, vLinkGenVarSectionGroupRef=vLinkGenLinkerSections/MSR_PBCFG_VAR_NO_INIT, vLinkGenVarSectionGroupRef=MSR_PBCFG_VAR_FAST_NO_INIT
            MSR_PBCFG_VAR_CLEARED: vLinkGenVarSectionGroupInit=ZERO_INIT, vLinkGenVarSectionGroupEndAlignment=4, vLinkGenVarSectionGroupRef=vLinkGenLinkerSections/MSR_PBCFG_VAR_CLEARED, vLinkGenVarSectionGroupRef=MSR_PBCFG_VAR_FAST_CLEARED
        MSR_VAR: vLinkGenVarGroupPosition=0
          vLinkGenVarGroupVariantHandling
            DemoFbl (vLinkGenVarGroupVariantSpecifics): vLinkGenVarGroupSpecificRomRegion=FblRomArea, vLinkGenVarGroupSpecificVariant=vLinkGenVariant_DemoFbl
            DemoUpd_DemoAppl (vLinkGenVarGroupVariantSpecifics):
              vLinkGenVarGroupSpecificRomRegion = ApplRomArea
              vLinkGenVarGroupSpecificVariant = vLinkGenVariant_DemoUpd
              vLinkGenVarGroupSpecificVariant = vLinkGenVariant_DemoAppl
          5 x vLinkGenVarSectionGroup, all with vLinkGenVarSectionGroupPosition=0, vLinkGenVarSectionGroupAlignment=4:
            MSR_VAR_CLEARED: vLinkGenVarSectionGroupInit=ZERO_INIT, vLinkGenVarSectionGroupInitStage=ONE, vLinkGenVarSectionGroupEndAlignment=4, vLinkGenVarSectionGroupRef=vLinkGenLinkerSections/MSR_VAR_CLEARED, vLinkGenVarSectionGroupRef=MSR_VAR_FAST_CLEARED
            MSR_VAR_INIT: vLinkGenVarSectionGroupInit=INIT, vLinkGenVarSectionGroupInitStage=ONE, vLinkGenVarSectionGroupEndAlignment=4, vLinkGenVarSectionGroupRef=vLinkGenLinkerSections/MSR_VAR_INIT, vLinkGenVarSectionGroupRef=MSR_VAR_FAST_INIT
            MSR_VAR_NO_INIT: vLinkGenVarSectionGroupInit=NONE, vLinkGenVarSectionGroupInitStage=ONE, vLinkGenVarSectionGroupRef=vLinkGenLinkerSections/MSR_VAR_NO_INIT, vLinkGenVarSectionGroupRef=MSR_VAR_FAST_NO_INIT
            MSR_VAR_POWER_ON_CLEARED: vLinkGenVarSectionGroupInit=ZERO_INIT, vLinkGenVarSectionGroupInitStage=POWER_ON, vLinkGenVarSectionGroupEndAlignment=4, vLinkGenVarSectionGroupRef=vLinkGenLinkerSections/MSR_VAR_POWER_ON_CLEARED, vLinkGenVarSectionGroupRef=MSR_VAR_FAST_POWER_ON_CLEARED
            MSR_VAR_POWER_ON_INIT: vLinkGenVarSectionGroupInit=INIT, vLinkGenVarSectionGroupInitStage=POWER_ON, vLinkGenVarSectionGroupEndAlignment=4, vLinkGenVarSectionGroupRef=vLinkGenLinkerSections/MSR_VAR_POWER_ON_INIT, vLinkGenVarSectionGroupRef=MSR_VAR_FAST_POWER_ON_INIT
        MSR_VAR_SAVED_ZONE: vLinkGenVarGroupPosition=0
          vLinkGenVarGroupVariantHandling
            DemoFbl (vLinkGenVarGroupVariantSpecifics): vLinkGenVarGroupSpecificRomRegion=FblRomArea, vLinkGenVarGroupSpecificVariant=vLinkGenVariant_DemoFbl
            DemoUpd_DemoAppl (vLinkGenVarGroupVariantSpecifics):
              vLinkGenVarGroupSpecificRomRegion = ApplRomArea
              vLinkGenVarGroupSpecificVariant = vLinkGenVariant_DemoUpd
              vLinkGenVarGroupSpecificVariant = vLinkGenVariant_DemoAppl
          MSR_VAR_SAVED_ZONE_POWER_ON_INIT (vLinkGenVarSectionGroup):
            vLinkGenVarSectionGroupInit = INIT
            vLinkGenVarSectionGroupInitStage = POWER_ON
            vLinkGenVarSectionGroupPosition = 0
            vLinkGenVarSectionGroupAlignment = 4
            vLinkGenVarSectionGroupEndAlignment = 4
            vLinkGenVarSectionGroupRef = vLinkGenLinkerSections/MSR_VAR_SAVED_ZONE_POWER_ON_INIT
            vLinkGenVarSectionGroupRef = MSR_VAR_SAVED_ZONE_FAST_POWER_ON_INIT
          MSR_VAR_SAVED_ZONE_POWER_ON_CLEARED (vLinkGenVarSectionGroup):
            vLinkGenVarSectionGroupInit = ZERO_INIT
            vLinkGenVarSectionGroupInitStage = POWER_ON
            vLinkGenVarSectionGroupPosition = 0
            vLinkGenVarSectionGroupAlignment = 4
            vLinkGenVarSectionGroupEndAlignment = 4
            vLinkGenVarSectionGroupRef = vLinkGenLinkerSections/MSR_VAR_SAVED_ZONE_POWER_ON_CLEARED
            vLinkGenVarSectionGroupRef = MSR_VAR_SAVED_ZONE_FAST_POWER_ON_CLEARED
      Brs_Startup_Code (vLinkGenLogicalConstGroup):
        vLinkGenConstGroupPosition = 1
        vLinkGenConstGroupContentType = STARTUP_CODE
        vLinkGenConstGroupVariant = vLinkGenVariant_FirstExecInst
        vLinkGenConstGroupRegion = StartupCode_FirstExecInst
        vLinkGenConstGroupVariant = vLinkGenVariant_DemoUpd
        vLinkGenConstGroupVariant = DemoBm
        vLinkGenConstGroupVariantHandling
          DemoUpd (vLinkGenConstGroupVariantSpecifics): vLinkGenConstGroupSpecificRegion=StartupCode_FirstExecInst, vLinkGenConstGroupSpecificVariant=vLinkGenVariant_DemoUpd
        Brs_Startup_Code (vLinkGenConstSectionGroup):
          vLinkGenConstSectionGroupPosition = 0
          vLinkGenConstSectionGroupInit = NONE
          vLinkGenConstSectionGroupInitStage = ONE
          vLinkGenConstSectionGroupAlignment = 4
          vLinkGenConstSectionGroupRef = brsStartup
        BrsMain_Startup_Code (vLinkGenConstSectionGroup):
          vLinkGenConstSectionGroupPosition = 1
          vLinkGenConstSectionGroupInit = NONE
          vLinkGenConstSectionGroupInitStage = ONE
          vLinkGenConstSectionGroupAlignment = 4
          vLinkGenConstSectionGroupRef = brsMainStartup
      Brs_Shared_Var (vLinkGenLogicalVarGroup):
        vLinkGenVarGroupPosition = 5
        vLinkGenVarGroupContentType = SHARED_DATA
        vLinkGenVarGroupVariant = vLinkGenVariant_FirstExecInst
        vLinkGenVarGroupVariant = vLinkGenVariant_DemoAppl
        vLinkGenVarGroupVariant = vLinkGenVariant_DemoFbl
        vLinkGenVarGroupVariant = vLinkGenVariant_DemoUpd
        vLinkGenVarGroupRegion = Variables_Shared
        Brs_Shared_Var (vLinkGenVarSectionGroup):
          vLinkGenVarSectionGroupPosition = 0
          vLinkGenVarSectionGroupInit = NONE
          vLinkGenVarSectionGroupInitStage = ONE
          vLinkGenVarSectionGroupAlignment = 4
          vLinkGenVarSectionGroupRef = brsSharedVar
      8 x vLinkGenLogicalConstGroup, all with vLinkGenConstGroupVariant=DemoBm:
        Brs_Shared_Const: vLinkGenConstGroupPosition=5, vLinkGenConstGroupVariant=vLinkGenVariant_FirstExecInst, vLinkGenConstGroupContentType=GLOBAL_CONST, vLinkGenConstGroupRegion=BmRomArea
          Brs_Shared_Const (vLinkGenConstSectionGroup):
            vLinkGenConstSectionGroupPosition = 0
            vLinkGenConstSectionGroupInit = NONE
            vLinkGenConstSectionGroupInitStage = ONE
            vLinkGenConstSectionGroupAlignment = 4
            vLinkGenConstSectionGroupRef = brsSharedConst
        Brs_ExcVect: vLinkGenConstGroupPosition=1, vLinkGenConstGroupContentType=GLOBAL_EXCVEC_CONST, vLinkGenConstGroupVariant=vLinkGenVariant_FirstExecInst, vLinkGenConstGroupVariant=vLinkGenVariant_DemoAppl, vLinkGenConstGroupRegion=CoreExceptions_FirstExecInst, vLinkGenConstGroupVariant=vLinkGenVariant_DemoUpd, vLinkGenConstGroupVariant=vLinkGenVariant_DemoFbl
          vLinkGenConstGroupVariantHandling
            DemoUpd (vLinkGenConstGroupVariantSpecifics): vLinkGenConstGroupSpecificRegion=CoreExceptions_FirstExecInst, vLinkGenConstGroupSpecificVariant=vLinkGenVariant_DemoUpd
          Brs_ExcVect (vLinkGenConstSectionGroup):
            vLinkGenConstSectionGroupPosition = 0
            vLinkGenConstSectionGroupInit = NONE
            vLinkGenConstSectionGroupInitStage = ONE
            vLinkGenConstSectionGroupAlignment = 4
            vLinkGenConstSectionGroupRef = brsExcVect
            vLinkGenConstSectionGroupRef = brsExcVectConst
        Brs_ExcVectRam: vLinkGenConstGroupInitCore=0, vLinkGenConstGroupPosition=5, vLinkGenConstGroupContentType=RAM_CONST, vLinkGenConstGroupVariant=vLinkGenVariant_FirstExecInst, vLinkGenConstGroupVariant=vLinkGenVariant_DemoAppl, vLinkGenConstGroupVariant=vLinkGenVariant_DemoFbl, vLinkGenConstGroupVariant=vLinkGenVariant_DemoUpd, vLinkGenConstGroupRegion=BmRomArea, vLinkGenConstGroupRamRegion=GLOBAL_RAM_A/GLOBAL_RAM_A
          vLinkGenConstGroupVariantHandling
            DemoFbl (vLinkGenConstGroupVariantSpecifics): vLinkGenConstGroupSpecificRegion=FblRomArea, vLinkGenConstGroupSpecificVariant=vLinkGenVariant_DemoFbl
            DemoUpd_DemoAppl (vLinkGenConstGroupVariantSpecifics):
              vLinkGenConstGroupSpecificRegion = ApplRomArea
              vLinkGenConstGroupSpecificVariant = vLinkGenVariant_DemoUpd
              vLinkGenConstGroupSpecificVariant = vLinkGenVariant_DemoAppl
          Brs_ExcVectRam (vLinkGenConstSectionGroup):
            vLinkGenConstSectionGroupInit = COPY_TO_RAM
            vLinkGenConstSectionGroupInitStage = ONE
            vLinkGenConstSectionGroupPosition = 0
            vLinkGenConstSectionGroupAlignment = 4
            vLinkGenConstSectionGroupEndAlignment = 4
            vLinkGenConstSectionGroupRef = brsExcVectRam
            vLinkGenConstSectionGroupRef = brsExcVectRamConst
        Brs_ApplicationEntry: vLinkGenConstGroupPosition=1, vLinkGenConstGroupContentType=APPLICATION_ENTRY, vLinkGenConstGroupRegion=BmApplicationEntry, vLinkGenConstGroupVariant=vLinkGenVariant_DemoAppl, vLinkGenConstGroupVariant=vLinkGenVariant_DemoUpd, vLinkGenConstGroupVariant=vLinkGenVariant_DemoFbl
          vLinkGenConstGroupVariantHandling
            DemoFbl (vLinkGenConstGroupVariantSpecifics): vLinkGenConstGroupSpecificRegion=FblApplicationEntry, vLinkGenConstGroupSpecificVariant=vLinkGenVariant_DemoFbl
            DemoUpd_DemoAppl (vLinkGenConstGroupVariantSpecifics):
              vLinkGenConstGroupSpecificRegion = ApplApplicationEntry
              vLinkGenConstGroupSpecificVariant = vLinkGenVariant_DemoUpd
              vLinkGenConstGroupSpecificVariant = vLinkGenVariant_DemoAppl
          Brs_ApplicationEntry (vLinkGenConstSectionGroup):
            vLinkGenConstSectionGroupPosition = 0
            vLinkGenConstSectionGroupInit = NONE
            vLinkGenConstSectionGroupInitStage = ONE
            vLinkGenConstSectionGroupAlignment = 4
            vLinkGenConstSectionGroupRef = brsApplicationEntry
        Const_Default: vLinkGenConstGroupPosition=1000, vLinkGenConstGroupVariant=vLinkGenVariant_DemoFbl, vLinkGenConstGroupVariant=vLinkGenVariant_FirstExecInst, vLinkGenConstGroupVariant=vLinkGenVariant_DemoAppl, vLinkGenConstGroupVariant=vLinkGenVariant_DemoUpd, vLinkGenConstGroupContentType=GLOBAL_CONST, vLinkGenConstGroupRegion=BmRomArea
          vLinkGenConstGroupVariantHandling
            DemoFbl (vLinkGenConstGroupVariantSpecifics): vLinkGenConstGroupSpecificRegion=FblRomArea, vLinkGenConstGroupSpecificVariant=vLinkGenVariant_DemoFbl
            DemoUpd_DemoAppl (vLinkGenConstGroupVariantSpecifics):
              vLinkGenConstGroupSpecificRegion = ApplRomArea
              vLinkGenConstGroupSpecificVariant = vLinkGenVariant_DemoUpd
              vLinkGenConstGroupSpecificVariant = vLinkGenVariant_DemoAppl
          7 x vLinkGenConstSectionGroup, all with vLinkGenConstSectionGroupPosition=0, vLinkGenConstSectionGroupInit=NONE, vLinkGenConstSectionGroupInitStage=ONE, vLinkGenConstSectionGroupAlignment=4:
            text: vLinkGenConstSectionGroupRef=vLinkGenLinkerSections/text, vLinkGenConstSectionGroupRef=text_vle, vLinkGenConstSectionGroupRef=syscall, vLinkGenConstSectionGroupRef=fixaddr, vLinkGenConstSectionGroupRef=fixtype, vLinkGenConstSectionGroupRef=picbase, vLinkGenConstSectionGroupRef=pidbase
            secinfo: vLinkGenConstSectionGroupRef=vLinkGenLinkerSections/secinfo
            rodata: vLinkGenConstSectionGroupRef=vLinkGenLinkerSections/rodata
            rozdata: vLinkGenConstSectionGroupRef=vLinkGenLinkerSections/rozdata, vLinkGenConstSectionGroupRef=zrodata
            tdata: vLinkGenConstSectionGroupRef=vLinkGenLinkerSections/tdata
            rosdata: vLinkGenConstSectionGroupRef=vLinkGenLinkerSections/rosdata, vLinkGenConstSectionGroupRef=ldata
            sdata2: vLinkGenConstSectionGroupRef=vLinkGenLinkerSections/sdata2
        MSR_CODE: vLinkGenConstGroupPosition=5, vLinkGenConstGroupVariant=vLinkGenVariant_DemoFbl, vLinkGenConstGroupVariant=vLinkGenVariant_FirstExecInst, vLinkGenConstGroupVariant=vLinkGenVariant_DemoAppl, vLinkGenConstGroupVariant=vLinkGenVariant_DemoUpd, vLinkGenConstGroupContentType=GLOBAL_CODE, vLinkGenConstGroupRegion=BmRomArea
          vLinkGenConstGroupVariantHandling
            DemoFbl (vLinkGenConstGroupVariantSpecifics): vLinkGenConstGroupSpecificRegion=FblRomArea, vLinkGenConstGroupSpecificVariant=vLinkGenVariant_DemoFbl
            DemoUpd_DemoAppl (vLinkGenConstGroupVariantSpecifics):
              vLinkGenConstGroupSpecificRegion = ApplRomArea
              vLinkGenConstGroupSpecificVariant = vLinkGenVariant_DemoUpd
              vLinkGenConstGroupSpecificVariant = vLinkGenVariant_DemoAppl
          MSR_CODE (vLinkGenConstSectionGroup):
            vLinkGenConstSectionGroupPosition = 0
            vLinkGenConstSectionGroupInit = NONE
            vLinkGenConstSectionGroupInitStage = ONE
            vLinkGenConstSectionGroupAlignment = 4
            vLinkGenConstSectionGroupRef = vLinkGenLinkerSections/MSR_CODE
        MSR_CONST: vLinkGenConstGroupPosition=5, vLinkGenConstGroupVariant=vLinkGenVariant_DemoFbl, vLinkGenConstGroupVariant=vLinkGenVariant_FirstExecInst, vLinkGenConstGroupVariant=vLinkGenVariant_DemoAppl, vLinkGenConstGroupVariant=vLinkGenVariant_DemoUpd, vLinkGenConstGroupContentType=GLOBAL_CONST, vLinkGenConstGroupRegion=BmRomArea
          vLinkGenConstGroupVariantHandling
            DemoFbl (vLinkGenConstGroupVariantSpecifics): vLinkGenConstGroupSpecificRegion=FblRomArea, vLinkGenConstGroupSpecificVariant=vLinkGenVariant_DemoFbl
            DemoUpd_DemoAppl (vLinkGenConstGroupVariantSpecifics):
              vLinkGenConstGroupSpecificRegion = ApplRomArea
              vLinkGenConstGroupSpecificVariant = vLinkGenVariant_DemoUpd
              vLinkGenConstGroupSpecificVariant = vLinkGenVariant_DemoAppl
          MSR_CONST (vLinkGenConstSectionGroup):
            vLinkGenConstSectionGroupPosition = 0
            vLinkGenConstSectionGroupInit = NONE
            vLinkGenConstSectionGroupInitStage = ONE
            vLinkGenConstSectionGroupAlignment = 4
            vLinkGenConstSectionGroupRef = vLinkGenLinkerSections/MSR_CONST
            vLinkGenConstSectionGroupRef = MSR_CONST_FAST
        MSR_PBCFG_CONST: vLinkGenConstGroupPosition=5, vLinkGenConstGroupVariant=vLinkGenVariant_DemoFbl, vLinkGenConstGroupVariant=vLinkGenVariant_FirstExecInst, vLinkGenConstGroupVariant=vLinkGenVariant_DemoAppl, vLinkGenConstGroupVariant=vLinkGenVariant_DemoUpd, vLinkGenConstGroupContentType=GLOBAL_CONST, vLinkGenConstGroupRegion=BmRomArea
          vLinkGenConstGroupVariantHandling
            DemoFbl (vLinkGenConstGroupVariantSpecifics): vLinkGenConstGroupSpecificRegion=FblRomArea, vLinkGenConstGroupSpecificVariant=vLinkGenVariant_DemoFbl
            DemoUpd_DemoAppl (vLinkGenConstGroupVariantSpecifics):
              vLinkGenConstGroupSpecificRegion = ApplRomArea
              vLinkGenConstGroupSpecificVariant = vLinkGenVariant_DemoUpd
              vLinkGenConstGroupSpecificVariant = vLinkGenVariant_DemoAppl
          MSR_PBCFG_CONST (vLinkGenConstSectionGroup):
            vLinkGenConstSectionGroupPosition = 0
            vLinkGenConstSectionGroupInit = NONE
            vLinkGenConstSectionGroupInitStage = ONE
            vLinkGenConstSectionGroupAlignment = 4
            vLinkGenConstSectionGroupRef = vLinkGenLinkerSections/MSR_PBCFG_CONST
            vLinkGenConstSectionGroupRef = MSR_PBCFG_CONST_FAST
      4 x vLinkGenLogicalVarGroup, all with vLinkGenVarGroupPosition=0:
        Fbl_EepDummy_Shared: vLinkGenVarGroupInitCore=0, vLinkGenVarGroupRegion=EepDummy, vLinkGenVarGroupVariant=vLinkGenVariant_FirstExecInst, vLinkGenVarGroupVariant=vLinkGenVariant_DemoUpd, vLinkGenVarGroupVariant=DemoBm
          EepDummySection (vLinkGenVarSectionGroup):
            vLinkGenVarSectionGroupPosition = 0
            vLinkGenVarSectionGroupInit = ZERO_INIT
            vLinkGenVarSectionGroupInitStage = HARD_RESET_ONLY
            vLinkGenVarSectionGroupAlignment = 4
            vLinkGenVarSectionGroupEndAlignment = 4
            vLinkGenVarSectionGroupRef = vLinkGenLinkerSections/EepDummySection
        Fbl_MagicFlag_Shared: vLinkGenVarGroupInitCore=0, vLinkGenVarGroupRegion=MagicFlag, vLinkGenVarGroupVariant=DemoBm
          MagicFlagSection (vLinkGenVarSectionGroup):
            vLinkGenVarSectionGroupPosition = 0
            vLinkGenVarSectionGroupInit = ZERO_INIT
            vLinkGenVarSectionGroupInitStage = HARD_RESET_ONLY
            vLinkGenVarSectionGroupAlignment = 4
            vLinkGenVarSectionGroupEndAlignment = 4
            vLinkGenVarSectionGroupRef = vLinkGenLinkerSections/MagicFlagSection
        Fbl_EepDummy_SharedNoinit: vLinkGenVarGroupRegion=EepDummy, vLinkGenVarGroupVariant=vLinkGenVariant_DemoAppl, vLinkGenVarGroupVariant=vLinkGenVariant_DemoFbl
          EepDummySectionNoinit (vLinkGenVarSectionGroup):
            vLinkGenVarSectionGroupPosition = 0
            vLinkGenVarSectionGroupInit = NONE
            vLinkGenVarSectionGroupInitStage = NONE
            vLinkGenVarSectionGroupAlignment = 4
            vLinkGenVarSectionGroupRef = vLinkGenLinkerSections/EepDummySection
        Fbl_MagicFlag_SharedNoinit: vLinkGenVarGroupRegion=MagicFlag, vLinkGenVarGroupVariant=vLinkGenVariant_DemoAppl
          MagicFlagSectionNoinit (vLinkGenVarSectionGroup):
            vLinkGenVarSectionGroupPosition = 0
            vLinkGenVarSectionGroupInit = NONE
            vLinkGenVarSectionGroupInitStage = NONE
            vLinkGenVarSectionGroupAlignment = 4
            vLinkGenVarSectionGroupRef = vLinkGenLinkerSections/MagicFlagSection
      7 x vLinkGenLogicalConstGroup:
        Fbl_FblHeader: vLinkGenConstGroupPosition=0, vLinkGenConstGroupRegion=FblHeader, vLinkGenConstGroupVariant=vLinkGenVariant_DemoFbl, vLinkGenConstGroupVariant=DemoBm
          FblHeaderSectionGroup (vLinkGenConstSectionGroup):
            vLinkGenConstSectionGroupPosition = 0
            vLinkGenConstSectionGroupInit = NONE
            vLinkGenConstSectionGroupInitStage = ONE
            vLinkGenConstSectionGroupAlignment = 4
            vLinkGenConstSectionGroupRef = FblHeaderSection
        FblAppl_BmHdrHeader: vLinkGenConstGroupPosition=0, vLinkGenConstGroupRegion=FblBmHdrHeader, vLinkGenConstGroupVariant=vLinkGenVariant_DemoFbl, vLinkGenConstGroupVariant=vLinkGenVariant_DemoUpd, vLinkGenConstGroupVariant=vLinkGenVariant_DemoAppl, vLinkGenConstGroupVariant=DemoBm
          FblBmHdrHeaderGroup (vLinkGenConstSectionGroup):
            vLinkGenConstSectionGroupPosition = 0
            vLinkGenConstSectionGroupInit = NONE
            vLinkGenConstSectionGroupInitStage = ONE
            vLinkGenConstSectionGroupAlignment = 4
            vLinkGenConstSectionGroupRef = BmHdrHeaderSection
          vLinkGenConstGroupVariantHandling
            DemoFbl (vLinkGenConstGroupVariantSpecifics): vLinkGenConstGroupSpecificRegion=FblBmHdrHeader, vLinkGenConstGroupSpecificVariant=vLinkGenVariant_DemoFbl
            DemoUpd_DemoAppl (vLinkGenConstGroupVariantSpecifics):
              vLinkGenConstGroupSpecificRegion = ApplBmHdrHeader
              vLinkGenConstGroupSpecificVariant = vLinkGenVariant_DemoUpd
              vLinkGenConstGroupSpecificVariant = vLinkGenVariant_DemoAppl
        Fbl_PresencePattern: vLinkGenConstGroupPosition=0, vLinkGenConstGroupRegion=FblBlockValPresencePattern, vLinkGenConstGroupVariant=vLinkGenVariant_DemoFbl, vLinkGenConstGroupVariant=DemoBm
          Fbl_PP (vLinkGenConstSectionGroup):
            vLinkGenConstSectionGroupPosition = 0
            vLinkGenConstSectionGroupInit = NONE
            vLinkGenConstSectionGroupInitStage = ONE
            vLinkGenConstSectionGroupAlignment = 4
            vLinkGenConstSectionGroupRef = FblPresencePatternSection
        Appl_ApplVect: vLinkGenConstGroupPosition=5, vLinkGenConstGroupRegion=ApplVect, vLinkGenConstGroupVariant=vLinkGenVariant_DemoFbl, vLinkGenConstGroupVariant=vLinkGenVariant_DemoAppl, vLinkGenConstGroupVariant=vLinkGenVariant_DemoUpd, vLinkGenConstGroupVariant=vLinkGenVariant_FirstExecInst
          APPLVECT (vLinkGenConstSectionGroup):
            vLinkGenConstSectionGroupSize = 8
            vLinkGenConstSectionGroupAlignment = 4
            vLinkGenConstSectionGroupPosition = 0
            vLinkGenConstSectionGroupInit = NONE
            vLinkGenConstSectionGroupInitStage = ONE
            vLinkGenConstSectionGroupRef = ApplVectSection
        Bm_BmHeader: vLinkGenConstGroupPosition=0, vLinkGenConstGroupRegion=BmHeader, vLinkGenConstGroupVariant=vLinkGenVariant_FirstExecInst, vLinkGenConstGroupVariant=DemoBm
          BmHeaderSectionGroup (vLinkGenConstSectionGroup):
            vLinkGenConstSectionGroupPosition = 0
            vLinkGenConstSectionGroupInit = NONE
            vLinkGenConstSectionGroupInitStage = ONE
            vLinkGenConstSectionGroupAlignment = 4
            vLinkGenConstSectionGroupRef = BmHeaderSection
        FblUpd_RamCode: vLinkGenConstGroupPosition=1, vLinkGenConstGroupInitCore=0, vLinkGenConstGroupVariant=vLinkGenVariant_DemoFbl, vLinkGenConstGroupVariant=vLinkGenVariant_FirstExecInst, vLinkGenConstGroupVariant=vLinkGenVariant_DemoUpd, vLinkGenConstGroupVariant=vLinkGenVariant_DemoAppl, vLinkGenConstGroupContentType=RAM_CODE, vLinkGenConstGroupRegion=BmRomArea, vLinkGenConstGroupRamRegion=GLOBAL_RAM_A/GLOBAL_RAM_A, vLinkGenConstGroupVariant=DemoBm
          RamCodeSection (vLinkGenConstSectionGroup):
            vLinkGenConstSectionGroupPosition = 0
            vLinkGenConstSectionGroupInit = COPY_TO_RAM
            vLinkGenConstSectionGroupInitStage = ONE
            vLinkGenConstSectionGroupAlignment = 4
            vLinkGenConstSectionGroupEndAlignment = 4
            vLinkGenConstSectionGroupRef = vLinkGenLinkerSections/RamCodeSection
          vLinkGenConstGroupVariantHandling
            DemoFbl (vLinkGenConstGroupVariantSpecifics): vLinkGenConstGroupSpecificRegion=FblRomArea, vLinkGenConstGroupSpecificVariant=vLinkGenVariant_DemoFbl
            DemoUpd_DemoAppl (vLinkGenConstGroupVariantSpecifics):
              vLinkGenConstGroupSpecificRegion = ApplRomArea
              vLinkGenConstGroupSpecificVariant = vLinkGenVariant_DemoUpd
              vLinkGenConstGroupSpecificVariant = vLinkGenVariant_DemoAppl
        FblUpd_RamConst: vLinkGenConstGroupPosition=0, vLinkGenConstGroupInitCore=0, vLinkGenConstGroupVariant=vLinkGenVariant_DemoFbl, vLinkGenConstGroupVariant=vLinkGenVariant_FirstExecInst, vLinkGenConstGroupVariant=vLinkGenVariant_DemoUpd, vLinkGenConstGroupVariant=vLinkGenVariant_DemoAppl, vLinkGenConstGroupContentType=RAM_CONST, vLinkGenConstGroupRegion=BmRomArea, vLinkGenConstGroupRamRegion=GLOBAL_RAM_A/GLOBAL_RAM_A, vLinkGenConstGroupVariant=DemoBm
          3 x vLinkGenConstSectionGroup, all with vLinkGenConstSectionGroupInitStage=ONE, vLinkGenConstSectionGroupAlignment=4:
            RamConstSection: vLinkGenConstSectionGroupPosition=0, vLinkGenConstSectionGroupInit=COPY_TO_RAM, vLinkGenConstSectionGroupEndAlignment=4, vLinkGenConstSectionGroupRef=vLinkGenLinkerSections/RamConstSection
            vMemHeaderSectionGroup: vLinkGenConstSectionGroupPosition=100, vLinkGenConstSectionGroupInit=NONE, vLinkGenConstSectionGroupRef=FlashDrvHeaderSection
            vMemFooterSectionGroup: vLinkGenConstSectionGroupPosition=100, vLinkGenConstSectionGroupInit=NONE, vLinkGenConstSectionGroupRef=FlashDrvFooterSection
          vLinkGenConstGroupVariantHandling
            DemoFbl (vLinkGenConstGroupVariantSpecifics): vLinkGenConstGroupSpecificRegion=FblRomArea, vLinkGenConstGroupSpecificVariant=vLinkGenVariant_DemoFbl
            DemoUpd_DemoAppl (vLinkGenConstGroupVariantSpecifics):
              vLinkGenConstGroupSpecificRegion = ApplRomArea
              vLinkGenConstGroupSpecificVariant = vLinkGenVariant_DemoUpd
              vLinkGenConstGroupSpecificVariant = vLinkGenVariant_DemoAppl
      Startup_Labels_NoFirstExec (vLinkGenLogicalSymbolGroup):
        vLinkGenSymbolGroupPosition = 0
        vLinkGenSymbolGroupVariant = vLinkGenVariant_DemoFbl
        vLinkGenSymbolGroupVariant = vLinkGenVariant_DemoAppl
        vLinkGenSymbolGroupVariant = vLinkGenVariant_DemoUpd
        Startup_Label_NoFirstExec (vLinkGenLinkerSymbol): vLinkGenLinkerSymbolName=brsStartupEntry, vLinkGenLinkerSymbolValue=_Brs_ApplicationEntry, vLinkGenLinkerSymbolPosition=0
      ApplVectSymbols (vLinkGenLogicalSymbolGroup):
        vLinkGenSymbolGroupPosition = 5
        vLinkGenSymbolGroupVariant = vLinkGenVariant_DemoFbl
        vLinkGenSymbolGroupVariant = vLinkGenVariant_DemoUpd
        vLinkGenSymbolGroupVariant = vLinkGenVariant_DemoAppl
        vLinkGenSymbolGroupVariant = vLinkGenVariant_FirstExecInst
        3 x vLinkGenLinkerSymbol, all with vLinkGenLinkerSymbolValue=brsStartupEntry, vLinkGenLinkerSymbolPosition=0:
          RESETVECT: vLinkGenLinkerSymbolName=RESETVECT
          RESETVECT_1: vLinkGenLinkerSymbolName=_START
          RESETVECT_2: vLinkGenLinkerSymbolName=Startup_Handler
      vLinkGenLinkerSections
        RamCodeSection (vLinkGenLinkerCodeSection): vLinkGenLinkerCodeSectionName=RamCodeSection, vLinkGenLinkerCodeSectionFast=false, vLinkGenLinkerCodeSectionAlignment=0
        EepDummySection (vLinkGenLinkerVarSection): vLinkGenLinkerVarSectionName=EepDummySection, vLinkGenLinkerVarSectionFast=false, vLinkGenLinkerVarSectionAlignment=0
        4 x vLinkGenLinkerConstSection, all with vLinkGenLinkerConstSectionFast=false, vLinkGenLinkerConstSectionAlignment=0:
          BmHeaderSection: vLinkGenLinkerConstSectionName=BmHeaderSection
          RamConstSection: vLinkGenLinkerConstSectionName=RamConstSection
          FblHeaderSection: vLinkGenLinkerConstSectionName=FblHeaderSection
          BmHdrHeaderSection: vLinkGenLinkerConstSectionName=BmHdrHeaderSection
        MagicFlagSection (vLinkGenLinkerVarSection): vLinkGenLinkerVarSectionName=MagicFlagSection, vLinkGenLinkerVarSectionFast=false, vLinkGenLinkerVarSectionAlignment=0
        FblPresencePatternSection (vLinkGenLinkerConstSection): vLinkGenLinkerConstSectionName=FblPresencePatternSection, vLinkGenLinkerConstSectionFast=false
        ApplVectSection (vLinkGenLinkerConstSection): vLinkGenLinkerConstSectionFast=false, vLinkGenLinkerConstSectionName=ApplVectSection
        FblFlashDrvSection (vLinkGenLinkerVarSection): vLinkGenLinkerVarSectionName=FblFlashDrvSection, vLinkGenLinkerVarSectionFast=false, vLinkGenLinkerVarSectionAlignment=0
        FlashDrvHeaderSection (vLinkGenLinkerConstSection): vLinkGenLinkerConstSectionName=FlashDrvHeaderSection, vLinkGenLinkerConstSectionFast=false
        FlashDrvFooterSection (vLinkGenLinkerConstSection): vLinkGenLinkerConstSectionName=FlashDrvFooterSection, vLinkGenLinkerConstSectionFast=false
        6 x vLinkGenLinkerCodeSection, all with vLinkGenLinkerCodeSectionFast=false:
          R_FCL_CODE_RAM: vLinkGenLinkerCodeSectionName=R_FCL_CODE_RAM, vLinkGenLinkerCodeSectionAlignment=4
          R_FCL_CODE_RAM_EX_PROT: vLinkGenLinkerCodeSectionName=R_FCL_CODE_RAM_EX_PROT
          R_FCL_CODE_ROM: vLinkGenLinkerCodeSectionName=R_FCL_CODE_ROM
          R_FCL_CODE_ROMRAM: vLinkGenLinkerCodeSectionName=R_FCL_CODE_ROMRAM
          R_FCL_CODE_USR: vLinkGenLinkerCodeSectionName=R_FCL_CODE_USR
          R_FCL_CODE_USRINT: vLinkGenLinkerCodeSectionName=R_FCL_CODE_USRINT
        R_FCL_CONST (vLinkGenLinkerConstSection): vLinkGenLinkerConstSectionName=R_FCL_CONST, vLinkGenLinkerConstSectionFast=false
        R_FCL_DATA (vLinkGenLinkerVarSection): vLinkGenLinkerVarSectionName=R_FCL_DATA, vLinkGenLinkerVarSectionFast=false
        MSR_CODE (vLinkGenLinkerCodeSection): vLinkGenLinkerCodeSectionName=MSR_CODE, vLinkGenLinkerCodeSectionFast=false
        MSR_CONST (vLinkGenLinkerConstSection): vLinkGenLinkerConstSectionName=MSR_CONST, vLinkGenLinkerConstSectionFast=false
        MSR_PBCFG_CONST (vLinkGenLinkerConstSection): vLinkGenLinkerConstSectionName=MSR_PBCFG_CONST, vLinkGenLinkerConstSectionFast=false
        4 x vLinkGenLinkerVarSection, all with vLinkGenLinkerVarSectionFast=false:
          MSR_PBCFG_VAR: vLinkGenLinkerVarSectionName=MSR_PBCFG_VAR
          MSR_VAR_CLEARED: vLinkGenLinkerVarSectionName=MSR_VAR_CLEARED
          MSR_VAR_INIT: vLinkGenLinkerVarSectionName=MSR_VAR_INIT
          MSR_VAR_NO_INIT: vLinkGenLinkerVarSectionName=MSR_VAR_NO_INIT
        MSR_CONST_FAST (vLinkGenLinkerConstSection): vLinkGenLinkerConstSectionFast=true, vLinkGenLinkerConstSectionName=MSR_CONST_FAST
        3 x vLinkGenLinkerVarSection, all with vLinkGenLinkerVarSectionFast=true:
          MSR_VAR_FAST_CLEARED: vLinkGenLinkerVarSectionName=MSR_VAR_FAST_CLEARED
          MSR_VAR_FAST_INIT: vLinkGenLinkerVarSectionName=MSR_VAR_FAST_INIT
          MSR_VAR_FAST_NO_INIT: vLinkGenLinkerVarSectionName=MSR_VAR_FAST_NO_INIT
        MSR_PBCFG_CONST_FAST (vLinkGenLinkerConstSection): vLinkGenLinkerConstSectionFast=true, vLinkGenLinkerConstSectionName=MSR_PBCFG_CONST_FAST
        13 x vLinkGenLinkerVarSection:
          MSR_PBCFG_VAR_FAST: vLinkGenLinkerVarSectionFast=true, vLinkGenLinkerVarSectionName=MSR_PBCFG_VAR_FAST
          MSR_PBCFG_VAR_FAST_NO_INIT: vLinkGenLinkerVarSectionFast=true, vLinkGenLinkerVarSectionName=MSR_PBCFG_VAR_FAST_NO_INIT
          MSR_PBCFG_VAR_NO_INIT: vLinkGenLinkerVarSectionName=MSR_PBCFG_VAR_NO_INIT, vLinkGenLinkerVarSectionFast=false
          MSR_VAR_SAVED_ZONE_POWER_ON_INIT: vLinkGenLinkerVarSectionName=MSR_VAR_SAVED_ZONE_POWER_ON_INIT, vLinkGenLinkerVarSectionFast=false
          MSR_VAR_SAVED_ZONE_POWER_ON_CLEARED: vLinkGenLinkerVarSectionName=MSR_VAR_SAVED_ZONE_POWER_ON_CLEARED, vLinkGenLinkerVarSectionFast=false
          MSR_VAR_SAVED_ZONE_FAST_POWER_ON_INIT: vLinkGenLinkerVarSectionFast=true, vLinkGenLinkerVarSectionName=MSR_VAR_SAVED_ZONE_FAST_POWER_ON_INIT
          MSR_VAR_SAVED_ZONE_FAST_POWER_ON_CLEARED: vLinkGenLinkerVarSectionFast=true, vLinkGenLinkerVarSectionName=MSR_VAR_SAVED_ZONE_FAST_POWER_ON_CLEARED
          MSR_PBCFG_VAR_CLEARED: vLinkGenLinkerVarSectionName=MSR_PBCFG_VAR_CLEARED, vLinkGenLinkerVarSectionFast=false
          MSR_PBCFG_VAR_FAST_CLEARED: vLinkGenLinkerVarSectionName=MSR_PBCFG_VAR_FAST_CLEARED, vLinkGenLinkerVarSectionFast=true
          MSR_VAR_POWER_ON_INIT: vLinkGenLinkerVarSectionName=MSR_VAR_POWER_ON_INIT, vLinkGenLinkerVarSectionFast=false
          MSR_VAR_FAST_POWER_ON_INIT: vLinkGenLinkerVarSectionName=MSR_VAR_FAST_POWER_ON_INIT, vLinkGenLinkerVarSectionFast=false
          MSR_VAR_POWER_ON_CLEARED: vLinkGenLinkerVarSectionName=MSR_VAR_POWER_ON_CLEARED, vLinkGenLinkerVarSectionFast=false
          MSR_VAR_FAST_POWER_ON_CLEARED: vLinkGenLinkerVarSectionName=MSR_VAR_FAST_POWER_ON_CLEARED, vLinkGenLinkerVarSectionFast=false
        3 x vLinkGenLinkerCodeSection, all with vLinkGenLinkerCodeSectionFast=false:
          bcode0: vLinkGenLinkerCodeSectionName=bcode0
          bcode1: vLinkGenLinkerCodeSectionName=bcode1
          brsExcVectRam: vLinkGenLinkerCodeSectionName=brsExcVectRam
        brsExcVectRamConst (vLinkGenLinkerConstSection): vLinkGenLinkerConstSectionName=brsExcVectRamConst, vLinkGenLinkerConstSectionFast=false
        5 x vLinkGenLinkerCodeSection, all with vLinkGenLinkerCodeSectionFast=false:
          brsExcVect: vLinkGenLinkerCodeSectionName=brsExcVect
          brsStartup: vLinkGenLinkerCodeSectionName=brsStartup
          brsMainStartup: vLinkGenLinkerCodeSectionName=brsMainStartup
          brsSharedConst: vLinkGenLinkerCodeSectionName=brsSharedConst
          brsApplicationEntry: vLinkGenLinkerCodeSectionName=brsApplicationEntry
        brsExcVectConst (vLinkGenLinkerConstSection): vLinkGenLinkerConstSectionName=brsExcVectConst, vLinkGenLinkerConstSectionFast=false
        brsSharedVar (vLinkGenLinkerVarSection): vLinkGenLinkerVarSectionName=brsSharedVar, vLinkGenLinkerVarSectionFast=false
        text (vLinkGenLinkerCodeSection): vLinkGenLinkerCodeSectionName=text, vLinkGenLinkerCodeSectionFast=false
        text_vle (vLinkGenLinkerCodeSection): vLinkGenLinkerCodeSectionName=vletext, vLinkGenLinkerCodeSectionFast=false
        6 x vLinkGenLinkerSpecSection, all with vLinkGenLinkerSpecSectionPad=0:
          secinfo: vLinkGenLinkerSpecSectionValue=.secinfo
          syscall: vLinkGenLinkerSpecSectionValue=.syscall
          fixaddr: vLinkGenLinkerSpecSectionValue=.fixaddr
          fixtype: vLinkGenLinkerSpecSectionValue=.fixtype
          picbase: vLinkGenLinkerSpecSectionValue=.picbase
          pidbase: vLinkGenLinkerSpecSectionValue=.pidbase
        6 x vLinkGenLinkerConstSection:
          rodata: vLinkGenLinkerConstSectionName=rodata, vLinkGenLinkerConstSectionFast=false
          rosdata: vLinkGenLinkerConstSectionName=rosdata, vLinkGenLinkerConstSectionFast=true
          ldata: vLinkGenLinkerConstSectionName=ldata, vLinkGenLinkerConstSectionFast=true
          sdata2: vLinkGenLinkerConstSectionName=sdata2, vLinkGenLinkerConstSectionFast=true
          rozdata: vLinkGenLinkerConstSectionName=rozdata, vLinkGenLinkerConstSectionFast=true
          zrodata: vLinkGenLinkerConstSectionName=zrodata, vLinkGenLinkerConstSectionFast=true
        data (vLinkGenLinkerVarSection): vLinkGenLinkerVarSectionName=data, vLinkGenLinkerVarSectionFast=false
        sdabase (vLinkGenLinkerSpecSection): vLinkGenLinkerSpecSectionValue=.sdabase, vLinkGenLinkerSpecSectionPad=0
        sdata (vLinkGenLinkerVarSection): vLinkGenLinkerVarSectionName=sdata, vLinkGenLinkerVarSectionFast=true
        tdata (vLinkGenLinkerSpecSection): vLinkGenLinkerSpecSectionValue=.tdata, vLinkGenLinkerSpecSectionPad=0
        zdata (vLinkGenLinkerVarSection): vLinkGenLinkerVarSectionName=zdata, vLinkGenLinkerVarSectionFast=true
        PPC_EMB_SDATA0 (vLinkGenLinkerSpecSection): vLinkGenLinkerSpecSectionValue=.PPC.EMB.sdata0, vLinkGenLinkerSpecSectionPad=0
        bss (vLinkGenLinkerVarSection): vLinkGenLinkerVarSectionName=bss, vLinkGenLinkerVarSectionFast=false
        COMMON (vLinkGenLinkerSpecSection): vLinkGenLinkerSpecSectionValue=COMMON, vLinkGenLinkerSpecSectionPad=0
        sbss (vLinkGenLinkerVarSection): vLinkGenLinkerVarSectionName=sbss, vLinkGenLinkerVarSectionFast=true
        SMALLCOMMON (vLinkGenLinkerSpecSection): vLinkGenLinkerSpecSectionValue=SMALLCOMMON, vLinkGenLinkerSpecSectionPad=0
        zbss (vLinkGenLinkerVarSection): vLinkGenLinkerVarSectionName=zbss, vLinkGenLinkerVarSectionFast=true
        PPC_EMB_SBSS0 (vLinkGenLinkerSpecSection): vLinkGenLinkerSpecSectionValue=.PPC.EMB.sbss0, vLinkGenLinkerSpecSectionPad=0
        ZEROCOMMON (vLinkGenLinkerSpecSection): vLinkGenLinkerSpecSectionValue=ZEROCOMMON, vLinkGenLinkerSpecSectionPad=0
        stack (vLinkGenLinkerVarSection): vLinkGenLinkerVarSectionName=stack, vLinkGenLinkerVarSectionFast=false
      FlashDrv_CodeConst (vLinkGenLogicalConstGroup): vLinkGenConstGroupPosition=1000, vLinkGenConstGroupRegion=FlashDrvArea, vLinkGenConstGroupVariant=vLinkGenVariant_FlashDrv
        16 x vLinkGenConstSectionGroup, all with vLinkGenConstSectionGroupInit=NONE, vLinkGenConstSectionGroupInitStage=ONE, vLinkGenConstSectionGroupAlignment=4:
          text: vLinkGenConstSectionGroupPosition=500, vLinkGenConstSectionGroupRef=vLinkGenLinkerSections/text, vLinkGenConstSectionGroupRef=text_vle, vLinkGenConstSectionGroupRef=syscall, vLinkGenConstSectionGroupRef=fixaddr, vLinkGenConstSectionGroupRef=fixtype, vLinkGenConstSectionGroupRef=picbase, vLinkGenConstSectionGroupRef=pidbase
          secinfo: vLinkGenConstSectionGroupPosition=500, vLinkGenConstSectionGroupRef=vLinkGenLinkerSections/secinfo
          rodata: vLinkGenConstSectionGroupPosition=500, vLinkGenConstSectionGroupRef=vLinkGenLinkerSections/rodata
          rozdata: vLinkGenConstSectionGroupPosition=500, vLinkGenConstSectionGroupRef=vLinkGenLinkerSections/rozdata, vLinkGenConstSectionGroupRef=zrodata
          tdata: vLinkGenConstSectionGroupPosition=500, vLinkGenConstSectionGroupRef=vLinkGenLinkerSections/tdata
          rosdata: vLinkGenConstSectionGroupPosition=500, vLinkGenConstSectionGroupRef=vLinkGenLinkerSections/rosdata, vLinkGenConstSectionGroupRef=ldata
          sdata2: vLinkGenConstSectionGroupPosition=500, vLinkGenConstSectionGroupRef=vLinkGenLinkerSections/sdata2
          FlashDrv_RamCodeSection: vLinkGenConstSectionGroupPosition=500, vLinkGenConstSectionGroupRef=vLinkGenLinkerSections/RamCodeSection
          FlashDrv_RamConstSection: vLinkGenConstSectionGroupPosition=500, vLinkGenConstSectionGroupRef=vLinkGenLinkerSections/RamConstSection
          R_FCL_CODE_RAM: vLinkGenConstSectionGroupPosition=0, vLinkGenConstSectionGroupRef=vLinkGenLinkerSections/R_FCL_CODE_RAM
          R_FCL_CODE_RAM_EX_PROT: vLinkGenConstSectionGroupPosition=0, vLinkGenConstSectionGroupRef=vLinkGenLinkerSections/R_FCL_CODE_RAM_EX_PROT
          R_FCL_CODE_ROM: vLinkGenConstSectionGroupPosition=0, vLinkGenConstSectionGroupRef=vLinkGenLinkerSections/R_FCL_CODE_ROM
          R_FCL_CODE_ROMRAM: vLinkGenConstSectionGroupPosition=0, vLinkGenConstSectionGroupRef=vLinkGenLinkerSections/R_FCL_CODE_ROMRAM
          R_FCL_CODE_USR: vLinkGenConstSectionGroupPosition=0, vLinkGenConstSectionGroupRef=vLinkGenLinkerSections/R_FCL_CODE_USR
          R_FCL_CODE_USRINT: vLinkGenConstSectionGroupPosition=0, vLinkGenConstSectionGroupRef=vLinkGenLinkerSections/R_FCL_CODE_USRINT
          R_FCL_CONST: vLinkGenConstSectionGroupPosition=0, vLinkGenConstSectionGroupRef=vLinkGenLinkerSections/R_FCL_CONST
      FlashDrv_Data (vLinkGenLogicalVarGroup): vLinkGenVarGroupPosition=250, vLinkGenVarGroupRegion=FlashDrvArea, vLinkGenVarGroupVariant=vLinkGenVariant_FlashDrv
        9 x vLinkGenVarSectionGroup, all with vLinkGenVarSectionGroupInit=NONE, vLinkGenVarSectionGroupInitStage=ONE, vLinkGenVarSectionGroupAlignment=4:
          data: vLinkGenVarSectionGroupPosition=500, vLinkGenVarSectionGroupRef=vLinkGenLinkerSections/data
          sdabase: vLinkGenVarSectionGroupPosition=500, vLinkGenVarSectionGroupRef=vLinkGenLinkerSections/sdabase
          sdata: vLinkGenVarSectionGroupPosition=500, vLinkGenVarSectionGroupRef=vLinkGenLinkerSections/sdata
          zdata: vLinkGenVarSectionGroupPosition=500, vLinkGenVarSectionGroupRef=vLinkGenLinkerSections/zdata, vLinkGenVarSectionGroupRef=PPC_EMB_SDATA0
          bss: vLinkGenVarSectionGroupPosition=500, vLinkGenVarSectionGroupRef=vLinkGenLinkerSections/bss, vLinkGenVarSectionGroupRef=COMMON
          sbss: vLinkGenVarSectionGroupPosition=500, vLinkGenVarSectionGroupRef=vLinkGenLinkerSections/sbss, vLinkGenVarSectionGroupRef=SMALLCOMMON
          zbss: vLinkGenVarSectionGroupPosition=500, vLinkGenVarSectionGroupRef=vLinkGenLinkerSections/zbss, vLinkGenVarSectionGroupRef=PPC_EMB_SBSS0, vLinkGenVarSectionGroupRef=ZEROCOMMON
          stack: vLinkGenVarSectionGroupPosition=500, vLinkGenVarSectionGroupRef=vLinkGenLinkerSections/stack
          R_FCL_DATA: vLinkGenVarSectionGroupPosition=0, vLinkGenVarSectionGroupRef=vLinkGenLinkerSections/R_FCL_DATA
      Var_FlashDrvArea (vLinkGenMemoryRegion):
        vLinkGenMemoryRegionAddrOffset = 245760
        vLinkGenMemoryRegionSize = 12288
        vLinkGenMemoryRegionAddress = 4273979392
        vLinkGenMemoryRegionAvailable = true
        vLinkGenMemoryRegionHwRegion = LocalRAM_CPU0
        FlashDrvArea (vLinkGenMemoryRegionBlock):
          vLinkGenMemoryRegionBlockPosition = 0
          vLinkGenMemoryRegionBlockBoundary = LOWER
          vLinkGenMemoryRegionBlockInitStage = HARD_RESET_ONLY
          vLinkGenMemoryRegionBlockSize = 12288
          vLinkGenMemoryRegionBlockAddress = 4273979392
          vLinkGenMemoryRegionBlockInitCore = 0
      FlashDrv_Header (vLinkGenLogicalConstGroup): vLinkGenConstGroupPosition=0, vLinkGenConstGroupVariant=vLinkGenVariant_FlashDrv, vLinkGenConstGroupRegion=FlashDrvArea
        FlashDrvHeaderSectionGroup (vLinkGenConstSectionGroup):
          vLinkGenConstSectionGroupPosition = 0
          vLinkGenConstSectionGroupInit = NONE
          vLinkGenConstSectionGroupInitStage = ONE
          vLinkGenConstSectionGroupAlignment = 4
          vLinkGenConstSectionGroupRef = FlashDrvHeaderSection
      FlashDrv_Footer (vLinkGenLogicalConstGroup): vLinkGenConstGroupPosition=2000, vLinkGenConstGroupVariant=vLinkGenVariant_FlashDrv, vLinkGenConstGroupRegion=FlashDrvArea
        FlashDrvFooterSectionGroup (vLinkGenConstSectionGroup):
          vLinkGenConstSectionGroupPosition = 0
          vLinkGenConstSectionGroupInit = NONE
          vLinkGenConstSectionGroupInitStage = ONE
          vLinkGenConstSectionGroupAlignment = 4
          vLinkGenConstSectionGroupRef = FlashDrvFooterSection
      FblUpd_FlashDrv (vLinkGenLogicalVarGroup):
        vLinkGenVarGroupPosition = 0
        vLinkGenVarGroupRegion = FlashDrvArea
        vLinkGenVarGroupVariant = vLinkGenVariant_DemoFbl
        vLinkGenVarGroupVariant = vLinkGenVariant_DemoUpd
        vLinkGenVarGroupVariant = vLinkGenVariant_FirstExecInst
        vLinkGenVarGroupVariant = vLinkGenVariant_DemoAppl
        FblFlashDrvSection (vLinkGenVarSectionGroup):
          vLinkGenVarSectionGroupPosition = 0
          vLinkGenVarSectionGroupInit = NONE
          vLinkGenVarSectionGroupAlignment = 4
          vLinkGenVarSectionGroupInitStage = ONE
          vLinkGenVarSectionGroupRef = vLinkGenLinkerSections/FblFlashDrvSection
      FlashDrvSymbols (vLinkGenLogicalSymbolGroup): vLinkGenSymbolGroupPosition=3, vLinkGenSymbolGroupVariant=vLinkGenVariant_FlashDrv
        StartupEntry (vLinkGenLinkerSymbol): vLinkGenLinkerSymbolPosition=0, vLinkGenLinkerSymbolName=brsStartupEntry, vLinkGenLinkerSymbolValue=0
      STARTUP_LABELS (vLinkGenLogicalSymbolGroup): vLinkGenSymbolGroupPosition=5
        STARTUP_LABEL1 (vLinkGenLinkerSymbol): vLinkGenLinkerSymbolName=_RESET_CORE0, vLinkGenLinkerSymbolValue=brsStartupEntry, vLinkGenLinkerSymbolPosition=0
        STARTUP_LABEL2 (vLinkGenLinkerSymbol): vLinkGenLinkerSymbolName=_RESET_CORE1, vLinkGenLinkerSymbolValue=brsStartupEntry, vLinkGenLinkerSymbolPosition=0
      4 x vLinkGenMemoryRegion, all with vLinkGenMemoryRegionAvailable=true:
        Const_BootManager: vLinkGenMemoryRegionAddrOffset=0, vLinkGenMemoryRegionSize=65536, vLinkGenMemoryRegionAddress=0, vLinkGenMemoryRegionHwRegion=CodeFlash_A
          6 x vLinkGenMemoryRegionBlock, all with vLinkGenMemoryRegionBlockInitStage=NONE:
            BCODE0: vLinkGenMemoryRegionBlockSize=32, vLinkGenMemoryRegionBlockCore=0, vLinkGenMemoryRegionBlockPosition=1, vLinkGenMemoryRegionBlockAddress=512, vLinkGenMemoryRegionBlockBoundary=LOWER, vLinkGenMemoryRegionBlockContentType=LOCAL_CODE
            StartupCode_FirstExecInst: vLinkGenMemoryRegionBlockPosition=2, vLinkGenMemoryRegionBlockSize=1024, vLinkGenMemoryRegionBlockAddress=544, vLinkGenMemoryRegionBlockBoundary=LOWER, vLinkGenMemoryRegionBlockContentType=STARTUP_CODE
            CoreExceptions_FirstExecInst: vLinkGenMemoryRegionBlockPosition=0, vLinkGenMemoryRegionBlockSize=512, vLinkGenMemoryRegionBlockAddress=0, vLinkGenMemoryRegionBlockBoundary=LOWER, vLinkGenMemoryRegionBlockContentType=GLOBAL_EXCVEC_CONST
            BmApplicationEntry: vLinkGenMemoryRegionBlockPosition=3, vLinkGenMemoryRegionBlockSize=256, vLinkGenMemoryRegionBlockAddress=1568, vLinkGenMemoryRegionBlockBoundary=LOWER, vLinkGenMemoryRegionBlockContentType=APPLICATION_ENTRY
            BmRomArea: vLinkGenMemoryRegionBlockPosition=4, vLinkGenMemoryRegionBlockSize=63680, vLinkGenMemoryRegionBlockAddress=1824, vLinkGenMemoryRegionBlockBoundary=LOWER, vLinkGenMemoryRegionBlockContentType=GLOBAL_EXCVEC_CODE, vLinkGenMemoryRegionBlockContentType=LOCAL_EXCVEC_CODE, vLinkGenMemoryRegionBlockContentType=LOCAL_EXCVEC_CONST, vLinkGenMemoryRegionBlockContentType=LOCAL_INTVEC_CODE, vLinkGenMemoryRegionBlockContentType=LOCAL_INTVEC_CONST, vLinkGenMemoryRegionBlockContentType=GLOBAL_INTVEC_CODE, vLinkGenMemoryRegionBlockContentType=GLOBAL_INTVEC_CONST, vLinkGenMemoryRegionBlockContentType=GLOBAL_CODE, vLinkGenMemoryRegionBlockContentType=GLOBAL_CONST, vLinkGenMemoryRegionBlockContentType=LOCAL_CODE, vLinkGenMemoryRegionBlockContentType=LOCAL_CONST, vLinkGenMemoryRegionBlockContentType=RAM_CODE, vLinkGenMemoryRegionBlockContentType=RAM_CONST
            BmHeader: vLinkGenMemoryRegionBlockPosition=0, vLinkGenMemoryRegionBlockSize=32, vLinkGenMemoryRegionBlockAddress=65504, vLinkGenMemoryRegionBlockBoundary=UPPER
        Const_FlashBootloader: vLinkGenMemoryRegionAddrOffset=65536, vLinkGenMemoryRegionSize=262144, vLinkGenMemoryRegionAddress=65536, vLinkGenMemoryRegionHwRegion=CodeFlash_A
          6 x vLinkGenMemoryRegionBlock, all with vLinkGenMemoryRegionBlockInitStage=NONE:
            FblHeader: vLinkGenMemoryRegionBlockPosition=0, vLinkGenMemoryRegionBlockSize=32, vLinkGenMemoryRegionBlockAddress=65536, vLinkGenMemoryRegionBlockBoundary=LOWER
            FblBmHdrHeader: vLinkGenMemoryRegionBlockPosition=1, vLinkGenMemoryRegionBlockSize=32, vLinkGenMemoryRegionBlockAddress=65568, vLinkGenMemoryRegionBlockBoundary=LOWER
            FblApplicationEntry: vLinkGenMemoryRegionBlockPosition=2, vLinkGenMemoryRegionBlockSize=256, vLinkGenMemoryRegionBlockAddress=65600, vLinkGenMemoryRegionBlockBoundary=LOWER
            FblRomArea: vLinkGenMemoryRegionBlockPosition=3, vLinkGenMemoryRegionBlockSize=257728, vLinkGenMemoryRegionBlockAddress=65856, vLinkGenMemoryRegionBlockBoundary=LOWER
            FblBlockValPresencePattern: vLinkGenMemoryRegionBlockPosition=0, vLinkGenMemoryRegionBlockSize=512, vLinkGenMemoryRegionBlockAddress=326656, vLinkGenMemoryRegionBlockBoundary=UPPER
            FblReserved: vLinkGenMemoryRegionBlockPosition=1, vLinkGenMemoryRegionBlockSize=512, vLinkGenMemoryRegionBlockAddress=327168, vLinkGenMemoryRegionBlockBoundary=UPPER
        GLOBAL_RAM_A: vLinkGenMemoryRegionAddrOffset=0, vLinkGenMemoryRegionSize=98304, vLinkGenMemoryRegionAddress=4277043200, vLinkGenMemoryRegionHwRegion=GlobalRAM_A
          GLOBAL_RAM_A (vLinkGenMemoryRegionBlock):
            vLinkGenMemoryRegionBlockInitCore = 0
            vLinkGenMemoryRegionBlockCore = 1
            vLinkGenMemoryRegionBlockInitStage = HARD_RESET_ONLY
            vLinkGenMemoryRegionBlockPosition = 0
            vLinkGenMemoryRegionBlockSize = 98304
            vLinkGenMemoryRegionBlockAddress = 4277043200
            vLinkGenMemoryRegionBlockBoundary = LOWER
            vLinkGenMemoryRegionBlockContentType = GLOBAL_DATA
            vLinkGenMemoryRegionBlockContentType = RAM_CODE_COPY
            vLinkGenMemoryRegionBlockContentType = RAM_CONST_COPY
            vLinkGenMemoryRegionBlockContentType = RETENTION_DATA
        LOCAL_RAM_CPU0: vLinkGenMemoryRegionAddrOffset=0, vLinkGenMemoryRegionSize=245760, vLinkGenMemoryRegionAddress=4273733632, vLinkGenMemoryRegionHwRegion=LocalRAM_CPU0
          3 x vLinkGenMemoryRegionBlock, all with vLinkGenMemoryRegionBlockInitCore=0:
            LOCAL_RAM_CPU0: vLinkGenMemoryRegionBlockCore=0, vLinkGenMemoryRegionBlockInitStage=HARD_RESET_ONLY, vLinkGenMemoryRegionBlockPosition=0, vLinkGenMemoryRegionBlockSize=244464, vLinkGenMemoryRegionBlockAddress=4273733632, vLinkGenMemoryRegionBlockBoundary=LOWER, vLinkGenMemoryRegionBlockContentType=GLOBAL_DATA, vLinkGenMemoryRegionBlockContentType=RAM_CODE_COPY, vLinkGenMemoryRegionBlockContentType=RAM_CONST_COPY, vLinkGenMemoryRegionBlockContentType=RETENTION_DATA, vLinkGenMemoryRegionBlockContentType=LOCAL_DATA, vLinkGenMemoryRegionBlockContentType=STACKS
            Variables_Shared: vLinkGenMemoryRegionBlockSize=16, vLinkGenMemoryRegionBlockBoundary=UPPER, vLinkGenMemoryRegionBlockInitStage=EARLY, vLinkGenMemoryRegionBlockPosition=0, vLinkGenMemoryRegionBlockAddress=4273978352, vLinkGenMemoryRegionBlockContentType=SHARED_DATA
            StartupStack_Shared: vLinkGenMemoryRegionBlockPosition=1, vLinkGenMemoryRegionBlockSize=1024, vLinkGenMemoryRegionBlockCore=0, vLinkGenMemoryRegionBlockBoundary=UPPER, vLinkGenMemoryRegionBlockInitStage=EARLY, vLinkGenMemoryRegionBlockAddress=4273978368, vLinkGenMemoryRegionBlockContentType=STARTUP_STACK
      Startup_Code_Core0 (vLinkGenLogicalConstGroup):
        vLinkGenConstGroupPosition = 0
        vLinkGenConstGroupCore = 0
        vLinkGenConstGroupContentType = LOCAL_CODE
        vLinkGenConstGroupRegion = BCODE0
        vLinkGenConstGroupVariant = vLinkGenVariant_FirstExecInst
        vLinkGenConstGroupVariant = DemoBm
        Startup_Code_Core0 (vLinkGenConstSectionGroup):
          vLinkGenConstSectionGroupPosition = 0
          vLinkGenConstSectionGroupInit = NONE
          vLinkGenConstSectionGroupInitStage = ONE
          vLinkGenConstSectionGroupAlignment = 4
          vLinkGenConstSectionGroupRef = bcode0
      Startup_Code_Core1 (vLinkGenLogicalConstGroup):
        vLinkGenConstGroupPosition = 0
        vLinkGenConstGroupCore = 1
        vLinkGenConstGroupContentType = LOCAL_CODE
        vLinkGenConstGroupVariant = vLinkGenVariant_FirstExecInst
        vLinkGenConstGroupRegion = BmRomArea
        Startup_Code_Core1 (vLinkGenConstSectionGroup):
          vLinkGenConstSectionGroupPosition = 0
          vLinkGenConstSectionGroupInit = NONE
          vLinkGenConstSectionGroupInitStage = ONE
          vLinkGenConstSectionGroupAlignment = 4
          vLinkGenConstSectionGroupRef = bcode1
      STACK_C0 (vLinkGenLogicalVarGroup):
        vLinkGenVarGroupPosition = 5
        vLinkGenVarGroupCore = 0
        vLinkGenVarGroupRegion = StartupStack_Shared
        vLinkGenVarGroupContentType = STARTUP_STACK
        vLinkGenVarGroupModule = vBRS
        vLinkGenVarGroupVariant = vLinkGenVariant_FirstExecInst
        vLinkGenVarGroupVariant = vLinkGenVariant_DemoFbl
        vLinkGenVarGroupVariant = vLinkGenVariant_DemoAppl
        vLinkGenVarGroupVariant = vLinkGenVariant_DemoUpd
        vLinkGenVarGroupVariant = DemoBm
        STACK_C0 (vLinkGenVarSectionGroup):
          vLinkGenVarSectionGroupPosition = 0
          vLinkGenVarSectionGroupInit = NONE
          vLinkGenVarSectionGroupInitStage = ONE
          vLinkGenVarSectionGroupAlignment = 4
          vLinkGenVarSectionGroupEndAlignment = 4
          vLinkGenVarSectionGroupSize = 1024
    vLinkGenPublishedInformation: vLinkGenDuplicatedLabels=true, vLinkGenDefaultVarGroupAlignment=4, vLinkGenDefaultConstGroupAlignment=4, vLinkGenGeneration=2
      vLinkGenConstGroupFlags
        5 x vLinkGenConstGroupFlag:
          ABS
          CLEAR
          NOCLEAR
          NOLOAD
          NOCHECKSUM
      vLinkGenVarGroupFlags
        5 x vLinkGenVarGroupFlag:
          ABS
          CLEAR
          NOCLEAR
          NOLOAD
          NOCHECKSUM
    vLinkGenContentTypes
      RAM_CODE (vLinkGenConstContentType): vLinkGenConstContentTypeLocal=false, vLinkGenConstContentTypeCopyRef=RAM_CODE_COPY
      RAM_CONST (vLinkGenConstContentType): vLinkGenConstContentTypeLocal=false, vLinkGenConstContentTypeCopyRef=RAM_CONST_COPY
      3 x vLinkGenVarContentType:
        GLOBAL_DATA: vLinkGenVarContentTypeLocal=false, vLinkGenVarContentTypeCopyRef=GLOBAL_CONST
        LOCAL_DATA: vLinkGenVarContentTypeLocal=true, vLinkGenVarContentTypeCopyRef=LOCAL_CONST
        RETENTION_DATA: vLinkGenVarContentTypeLocal=false, vLinkGenVarContentTypeCopyRef=GLOBAL_CONST
      13 x vLinkGenConstContentType:
        GLOBAL_CODE: vLinkGenConstContentTypeLocal=false
        LOCAL_CODE: vLinkGenConstContentTypeLocal=true
        GLOBAL_CONST: vLinkGenConstContentTypeLocal=false
        LOCAL_CONST: vLinkGenConstContentTypeLocal=true
        GLOBAL_EXCVEC_CODE: vLinkGenConstContentTypeLocal=false
        LOCAL_EXCVEC_CODE: vLinkGenConstContentTypeLocal=true
        GLOBAL_EXCVEC_CONST: vLinkGenConstContentTypeLocal=false
        LOCAL_EXCVEC_CONST: vLinkGenConstContentTypeLocal=true
        GLOBAL_INTVEC_CODE: vLinkGenConstContentTypeLocal=false
        LOCAL_INTVEC_CODE: vLinkGenConstContentTypeLocal=true
        GLOBAL_INTVEC_CONST: vLinkGenConstContentTypeLocal=false
        LOCAL_INTVEC_CONST: vLinkGenConstContentTypeLocal=true
        STARTUP_CODE: vLinkGenConstContentTypeLocal=false
      5 x vLinkGenVarContentType:
        STARTUP_STACK: vLinkGenVarContentTypeLocal=true
        STACKS: vLinkGenVarContentTypeLocal=true
        RAM_CODE_COPY: vLinkGenVarContentTypeLocal=false
        RAM_CONST_COPY: vLinkGenVarContentTypeLocal=false
        SHARED_DATA: vLinkGenVarContentTypeLocal=false
      APPLICATION_ENTRY (vLinkGenConstContentType): vLinkGenConstContentTypeLocal=false
