AUTOSAR XML (schema 00053)
package /ActiveEcuC
  ecuc value collection ActiveEcuC: ecuc-values=[MemMap, vLinkGen, vBRS, FblBm, vBaseEnv, FblHal, FblMio, Det, EcuC, Fbl, FblBmHdr, vSet, Mcu, Dem, FblAsrStubs, Port]
