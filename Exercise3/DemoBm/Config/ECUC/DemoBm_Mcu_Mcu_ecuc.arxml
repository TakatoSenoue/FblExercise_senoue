AUTOSAR XML (schema 00053)
package /ActiveEcuC
  module config Mcu: implementation-config-variant=VARIANT-POST-BUILD-LOADABLE, module-description=Mcu_Impl
    McuGeneralConfiguration:
      McuVersionCheckExternalModules = false
      McuClm0MonitoringClockAccuracy = 9
      McuClm0Operation = false
      McuClm0SamplingClockAccuracy = 9
      McuClm1MonitoringClockAccuracy = 9
      McuClm1Operation = false
      McuClm1SamplingClockAccuracy = 9
      McuClm2MonitoringClockAccuracy = 14
      McuClm2Operation = false
      McuClm2SamplingClockAccuracy = 14
      McuClm3MonitoringClockAccuracy = 14
      McuClm3Operation = false
      McuClm3SamplingClockAccuracy = 14
      McuCopyToSection = true
      McuCriticalSectionProtection = true
      McuCvmHighVoltageDetect = false
      McuCvmLowVoltageDetect = false
      McuDevErrorDetect = false
      McuDeviceName = R7F701649
      McuGetRamStateApi = false
      McuInitClock = true
      McuLoopCount = 5
      McuLowPowerSequencerOperation = false
      McuNoPll = false
      McuPerformResetApi = false
      McuPortGroupStatusBackUp = false
      McuRAMMirror = DISABLE
      McuResetReasonMultipleResets = true
      McuRetentionRamSourceAddress = 65536
      McuSwResetCallApi = false
      McuUseWriteVerifyErrorInterface = false
      McuVersionInfoApi = false
      McuWakeUpFactorClearIsr = false
      McuWakeUpFactorsClearCentralised = true
      McuWriteVerify = WV_DISABLE
    McuModuleConfiguration:
      McuClockSrcFailureNotification = DISABLED
      McuCyclicRunModeBaseAddress = 4273963008
      McuLviDetectionLevel = DETECTION_LEVEL_0
      McuLviResetMask = RESET_REQUEST
      McuNumberOfMcuModes = 1
      McuRamSectors = 0
      McuRetentionRamAddress = 4273963008
      McuClockSettingConfig:
        Mcu8MhzRingStopRequestMask = true
        McuClkModeSelect = MCU_CPLL0CLK_ID_0
        McuClockSettingId = 0
        McuCpuClockDivider = DIVBY_1_ID_1
        McuCpuMainSysClk = 240000000
        McuOPBT0 = 3123183567
        McuUnitName = CPUCLK
        McuClockReferencePoint: McuClockReferencePointFrequency=40000000
        McuMainOscSetting: McuMainOscAmplificationGain=LOW_ID_2, McuMainOsciFrequency=16000000, McuMainOscStabTimeSetting=1, McuMainOscStopRequestMask=true
        McuPll0Setting:
          McuCpll0Clk = 240000000
          McuCpllDivider = P_VALUE_2
          McuPll0Divider = DIV_BY_6
          McuPll0InputClockSelection = MCU_SELECT_MOSC
          McuPll0MrValue = 2
          McuPll0NrValue = NR_VAL_60
          McuPll0Out = 80000000
          McuPllFreqModCycleSetting = 0
          McuPllFreqModRange = 0
        McuPllSetting:
          McuCpllClk = 80000000
          McuCpllDivider = P_VALUE_2
          McuPllInputClockSelection = MCU_SELECT_MOSC
          McuPllMrValue = 2
          McuPllNrValue = NR_VAL_60
          McuPpllClk = 80000000
          McuPpllDivider = DIV_BY_6
          McuPpllOut = 80000000
          McuPpllSrcClock = MCU_PPLLOUT_ID_3
        McuSubOscSetting: McuSubOscFrequency=32768, McuSubOscStabTimeSetting=1
      McuDemEventParameterRefs:
        MCU_E_CLOCK_FAILURE = DemEventParameter
        MCU_E_CVM_SETTING_FAILURE = DemEventParameter
        MCU_E_INCONCISTENCY_RESF_FAILURE = DemEventParameter
        MCU_E_LVI_FAILURE = DemEventParameter
        MCU_E_WRITE_TIMEOUT_FAILURE = DemEventParameter
      McuModeSettingConf:
        McuMainOscOperation = true
        McuMode = 0
        McuModeTransitionReq = true
        McuModeType = RUN_MODE
        McuWakeUpFactor{0..2} = false
        McuWakeUpFactorIso0 = false
    McuPublishedInformation
      McuResetReasonConf: McuResetReason=0
      McuRstRsnConfClm0: McuResetReason=4
      McuRstRsnConfClm1: McuResetReason=5
      McuRstRsnConfClm3: McuResetReason=15
      McuRstRsnConfCvm: McuResetReason=8
      McuRstRsnConfIso: McuResetReason=11
      McuRstRsnConfLvi: McuResetReason=7
      McuRstRsnConfMultipleResets: McuResetReason=17
      McuRstRsnConfPOR: McuResetReason=10
      McuRstRsnConfResf11: McuResetReason=12
      McuRstRsnConfResf12: McuResetReason=13
      McuRstRsnConfResf13: McuResetReason=14
      McuRstRsnConfSwRst: McuResetReason=1
      McuRstRsnConfTer: McuResetReason=9
      McuRstRsnConfUndef: McuResetReason=16
      McuRstRsnConfUnknown: McuResetReason=18
      McuRstRsnConfWdta0: McuResetReason=2
      McuRstRsnConfWdta1: McuResetReason=3
      McuRstRsnConfClm2: McuResetReason=6
    McuRamInitConfiguration: McuRamInitBaseAddress=4273733632, McuRamInitSize=256, McuRamInitValue=255, McuRamTypeSelection=CPU_LOCAL_RAM, McuRamWriteSizeSel=BIT_8
