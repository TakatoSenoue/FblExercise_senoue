AUTOSAR XML (schema 00053)
package /ActiveEcuC
  module config FblAsrStubs: implementation-config-variant=VARIANT-LINK-TIME, module-description=FblAsrStubs_Impl
    FblAsrStubsModuleConfigDefines: FblAsrStubsCreateGptConfigDefines=false, FblAsrStubsCreateDemConfigDefines=true, FblAsrStubsCreateComConfigDefines=false
